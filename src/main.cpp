// SPDX-License-Identifier: GPL-3.0-or-later
// Copyright (c) 2026 Matěj "Wolf" Holyszewski, OK2MTB

/*
  microHAMCLOCK for the Heltec WiFi LoRa 32 V3
  ---------------------------------------
  ESP32-S3 + 0.96" SSD1306 128×64 OLED (I2C) + Wi-Fi.
  A PlatformIO project (see platformio.ini), needs no extra
  libraries.

  Screens:
    CLOCK       – UTC in big digits, local time, callsign and locator
    PROPAGATION – SFI, SN, A, K, X-ray and band conditions (N0NBH, hamqsl.com)
    PSK LIST    – who heard me in the last hour (PSKReporter via MQTT)
    PSK MAP     – the same on a world map with the grey line (day/night)

  PRG button:
    short press   – next screen
    double click  – automatic screen rotation on/off
    triple click  – status screen (Wi-Fi, MQTT, data)
    long press    – (after holding 0.7 s) list: sort by time / distance
                    map: view AUTO → WORLD → EUROPE → CZECHIA → GERMANY → UK → USA
                    (the country views only when switched on in the settings)
                    status: power off (deep sleep, the RST button starts the board again)
    hold 10 s     – setup mode (hotspot), works even while waiting for Wi-Fi

  Settings (language, Wi-Fi, callsign, locator) can be entered in two ways:
    – via the hotspot: the board creates an open Wi-Fi MICROHAMCLOCK-xxxx with a form
      at http://4.3.2.1 (by itself only while unconfigured, otherwise by holding
      the button; stored values are not erased),
    – via the serial console at 115200 Bd with the "setup" command; the board asks for everything.
  Everything is stored in NVS. The "status" command prints what is going on.

  The display and web are in English (default), Czech or German, texts are in src/lang/*.inc
  (see i18n.h). The serial console is English only.
*/

#include <Arduino.h>
#include <Wire.h>
#include <SPI.h>
#include <WiFi.h>
#include <WiFiClientSecure.h>
#include <HTTPClient.h>
#include <WebServer.h>
#include <WiFiUdp.h>
#include <Preferences.h>
#include <nvs_flash.h>
#include <time.h>
#include <math.h>
#include <esp_sntp.h>
#include <esp_netif.h>
#include <esp_wifi.h>
#include <dhcpserver/dhcpserver.h>
#include <esp_sleep.h>
#include <driver/gpio.h>
#if __has_include(<esp_random.h>)
#include <esp_random.h>               // core 3.x (pioarduino); in 2.x esp_random() is in esp_system.h
#endif
#include "maps.h"
#include "i18n.h"
#include "tz.h"
#include "life.h"

// ============================ SETTINGS ============================

#include "fw_version.h"                            // generated by tools/version.py from git
static const char *const FW_VERSION      = MICROHAMCLOCK_VERSION;       // e.g. 0.5.1-3-g1a2b3c4
static const char *const FW_VERSION_OLED = MICROHAMCLOCK_VERSION_OLED;  // on the OLED 0.5.1+3 (no hash)

static const bool     DEFAULT_ROTATE    = true;    // automatic screen rotation, changed by double click or on the web
static const uint8_t  DEFAULT_ROTATE_S  = 15;      // how long a screen stays up in automatic rotation (web: Advanced)
static const uint8_t  MIN_ROTATE_S      = 5;
static const uint8_t  MAX_ROTATE_S      = 120;
static const uint8_t  MAP_EMPTY_S       = 5;       // in automatic switching the map without spots stays up only this long (at most the set time)
static const uint16_t SPOT_WINDOW_MIN   = 60;      // how old spots are still shown
static const uint16_t LIST_PAGE_MS      = 5000;    // paging of a long spot list
static const uint16_t NEW_SPOT_BLINK_S  = 60;      // how long a new spot blinks on the map
static const uint16_t SOLAR_REFRESH_MIN = 60;      // N0NBH asks for hourly updates (flux hourly, the rest 3-hourly)
static const uint8_t  CONTRAST_DAY      = 0xCF;    // default display brightness 0–255, changed on the web (Advanced)
static const uint8_t  CONTRAST_NIGHT    = 0x08;    // at night
static const uint8_t  CONTRAST_DIM      = 0x08;    // "dim and shift" saver
static const uint8_t  CONTRAST_LIFE     = 0x30;    // Game of Life saver
static const uint16_t BRIGHT_PREVIEW_MS = 5000;    // brightness preview from the web
static const bool     FLIP_SCREEN       = false;   // rotate the image by 180°

// Default settings (changed on the web or in the console).
static const uint8_t  DEFAULT_SAVER_MIN  = 10;     // saver after this many idle minutes, 0 = never
static const uint8_t  MAX_SAVER_MIN      = 240;
static const uint8_t  DEFAULT_NIGHT_FROM = 22;     // night (local time): display dimmed, spots as configured
static const uint8_t  DEFAULT_NIGHT_TO   = 6;
static const uint8_t  MAX_NVIS_MARGIN    = 50;     // NVIS margin below foF2 in %, default 0
static const uint16_t SPOT_WAKE_MAX_AGE_MIN = 15;  // older (late-reported) spots do not wake the display
static const uint16_t LIFE_STEP_MS       = 120;    // Game of Life speed in the saver
static const uint16_t DIM_SHIFT_S        = 60;     // "dim and shift" saver: shift the image every minute
static const uint16_t SPOT_LED_MS        = 500;    // one blink on a spot wake-up
static const uint8_t  DEFAULT_LIFE_DAYS  = 2;      // Game of Life saver: display off after this many days (if enabled)
static const uint8_t  MAX_LIFE_DAYS      = 30;     // keeps the millis() difference far below its 49-day wrap

// Local time: NTP sends only UTC, the zone is picked in settings (see tz.h).
// A board configured before 0.4.0 had no zone stored and ran on CET/CEST.
static const char *const DEFAULT_TZ        = "Etc/UTC";
static const char *const LEGACY_TZ         = "Europe/Prague";
static const char *const NTP_1      = "ntp.ufe.cz";     // Institute of Photonics and Electronics, Czech Academy of Sciences (national time standard)
static const char *const NTP_2       = "tik.cesnet.cz";  // fallback: CESNET
static const char *const NTP_3       = "pool.ntp.org";
// NOTE: every board fetches from the public data servers below (PSKReporter, hamqsl.com, KC2G) directly.
// This is provisional. It is fine for a modest number of boards that behave politely (long intervals,
// jitter, back-off, an identifying User-Agent), but with wider use an own intermediate layer between the
// servers and the boards will be needed, so the load on these volunteer-run servers does not grow with
// the number of boards.
static const char *const MQTT_HOST   = "mqtt.pskreporter.info";
static const uint16_t    MQTT_PORT   = 1883;
// The bridge that feeds PSKReporter spots to the broker publishes, once a second, when it last got a spot
// from PSKReporter. When that time stops moving, the feed is down at the provider's end, not here.
static const char *const FEED_TOPIC  = "pskr2mqtt/stats/last_spot_received_at";
static const uint16_t    FEED_DOWN_MIN = 5;     // normally thousands of spots arrive every minute
static const char *const SOLAR_URL   = "https://www.hamqsl.com/solarxml.php";

// Downloads from the data servers: a failed one is retried after FETCH_RETRY_MIN_MS, the wait doubling
// up to FETCH_RETRY_MAX_MS. The first downloads after Wi-Fi comes up are spread over START_SPREAD_MS.
static const uint32_t    FETCH_RETRY_MIN_MS = 120000UL;
static const uint32_t    FETCH_RETRY_MAX_MS = 3600000UL;
static const uint32_t    START_SPREAD_MS    = 60000UL;

// Besides the entered callsign, spots are also subscribed for its base form with these suffixes
// (OK2MTB, OK2MTB/P, OK2MTB/M), so it does not matter whether you operate from home or a hilltop.
static const char *const CALL_SUFFIXES[] = {"P", "M"};

// foF2 and MUF(3000) from an ionosonde (GIRO data via KC2G). The nearest ionosonde
// to the locator with a fresh measurement is used, or the one the user entered by code (e.g. PQ052 = Pruhonice).
static const char *const IONO_URL       = "https://prop.kc2g.com/api/stations.json";
static const uint16_t    IONO_REFRESH_MIN = 15;   // the ionosonde measures every 5 minutes; 15 min keeps the load down
static const uint16_t    IONO_MAX_AGE_MIN = 90;   // older measurements are no longer shown
static const uint16_t    IONO_MAX_KM      = 1500; // a more distant ionosonde says little about local conditions
static const uint16_t    IONO_STICKY_KM   = 300;  // the current ionosonde stays unless it is this much farther than the nearest

// Battery (a Li-ion cell on the JST connector). The board charges it but never disconnects it when flat.
// The automatic power off is ready but switched off: the board cannot tell whether USB is plugged in.
// Without a cell the charger output is measured instead, about 4 V (one random V3 on USB: 4.13 V on the
// connector, read as 3.95 V; other boards will differ a little).
static const bool     BAT_AUTO_OFF      = false;   // power off on a flat battery
static const uint16_t BAT_CHECK_S       = 30;      // how often the voltage is measured
static const uint16_t BAT_NONE_MV       = 2500;    // lower readings mean no cell (but a missing cell may read higher)
static const uint16_t BAT_OFF_MV        = 3300;    // flat (under load), BAT_OFF_COUNT readings in a row
static const uint8_t  BAT_OFF_COUNT     = 4;
// After a power off for a flat battery: false = sleep until RST, like the manual power off (lowest draw);
// true = wake every BAT_RECHECK_MIN and start again once the cell is charged to BAT_ON_MV.
static const bool     BAT_FLAT_RECHECK  = false;
static const uint16_t BAT_ON_MV         = 3600;    // charged enough to run (with BAT_FLAT_RECHECK)
static const uint16_t BAT_RECHECK_MIN   = 30;      // ... checked this often from deep sleep

// ============================ HARDWARE ============================

static const uint8_t  PIN_OLED_SDA = 17;
static const uint8_t  PIN_OLED_SCL = 18;
static const uint8_t  PIN_OLED_RST = 21;
static const uint8_t  PIN_VEXT     = 36;   // LOW = display power on
static const uint8_t  PIN_BUTTON   = 0;    // PRG button
static const uint8_t  PIN_VBAT     = 1;    // battery voltage through a 390k/100k divider
static const uint8_t  PIN_VBAT_CTRL = 37;  // switches the divider on: LOW on V3 and V3.1, HIGH on V3.2
static const float    VBAT_DIVIDER = 4.9f;
// The SX1262 LoRa radio is not used, but it must be put to sleep before powering off,
// otherwise its standby draws far more than the sleeping ESP32.
static const uint8_t  PIN_LORA_NSS = 8, PIN_LORA_SCK = 9, PIN_LORA_MOSI = 10, PIN_LORA_MISO = 11;
static const uint8_t  PIN_LORA_RST = 12, PIN_LORA_BUSY = 13;
static const uint8_t  OLED_ADDR    = 0x3C;
static const uint32_t I2C_HZ       = 700000;

static const uint16_t LONG_PRESS_MS   = 700;
static const uint16_t CONFIG_HOLD_MS  = 10000; // button hold → setup mode (hotspot)
static const uint16_t CONFIG_HINT_MS  = 2000;  // from when the countdown shows while held
static const uint16_t PORTAL_IDLE_MIN = 10;    // a configured board leaves the hotspot by itself when idle
static const uint16_t SCAN_TIMEOUT_MS = 20000; // Wi-Fi scan; with the hotspot on it takes about 8 s
static const uint8_t  SCAN_RETRIES    = 2;     // an empty or failed scan is repeated this many times
static const uint16_t DOUBLE_CLICK_MS = 300;
static const uint16_t FLASH_MS        = 1200;  // how long a message stays up after a button press
static const uint16_t FRAME_MS        = 200;   // how often the display is redrawn
static const uint16_t DATA_BLINK_MS   = 300;   // the propagation screen briefly inverts on new data

// ============================ DISPLAY ============================

static uint8_t fb[128 * 64 / 8];   // frame: 8 pages of 128 bytes, 1 bit = 1 pixel

static void oledCommands(const uint8_t *cmd, size_t len) {
  Wire.beginTransmission(OLED_ADDR);
  Wire.write(0x00);                 // commands follow
  Wire.write(cmd, len);
  Wire.endTransmission();
}

static void oledInit() {
  pinMode(PIN_VEXT, OUTPUT);
  digitalWrite(PIN_VEXT, LOW);
  delay(50);
  pinMode(PIN_OLED_RST, OUTPUT);
  digitalWrite(PIN_OLED_RST, LOW);
  delay(20);
  digitalWrite(PIN_OLED_RST, HIGH);
  delay(20);

  Wire.begin(PIN_OLED_SDA, PIN_OLED_SCL, I2C_HZ);
  const uint8_t init[] = {
    0xAE,                           // display off
    0xD5, 0x80,                     // clock
    0xA8, 0x3F,                     // 64 rows
    0xD3, 0x00,                     // no vertical offset
    0x40,                           // start at row 0
    0x8D, 0x14,                     // charge pump on
    0x20, 0x00,                     // horizontal addressing
    FLIP_SCREEN ? 0xA0 : 0xA1,      // column direction
    FLIP_SCREEN ? 0xC0 : 0xC8,      // row direction
    0xDA, 0x12,                     // COM pin wiring for 128×64
    0x81, CONTRAST_DAY,
    0xD9, 0xF1,                     // pre-charge
    0xDB, 0x40,                     // VCOMH
    0xA4,                           // display RAM contents
    0xA6,                           // not inverted
    0x2E,                           // no scrolling
    0xAF,                           // display on
  };
  oledCommands(init, sizeof init);
}

static void oledContrast(uint8_t c) {
  const uint8_t cmd[] = {0x81, c};
  oledCommands(cmd, sizeof cmd);
}

// A switched-off display does not light at all (no burn-in) and draws almost no current.
static void oledPower(bool on) {
  static const uint8_t cmdOn[] = {0x8D, 0x14, 0xAF}, cmdOff[] = {0xAE, 0x8D, 0x10};
  oledCommands(on ? cmdOn : cmdOff, 3);
}

static void oledFlush() {
  static const uint8_t window[] = {0x21, 0, 127, 0x22, 0, 7};
  oledCommands(window, sizeof window);
  for (size_t i = 0; i < sizeof fb; i += 64) {
    Wire.beginTransmission(OLED_ADDR);
    Wire.write(0x40);               // data follows
    Wire.write(fb + i, 64);
    Wire.endTransmission();
  }
}

static void setPixel(int x, int y, bool on = true) {
  if ((unsigned)x >= 128 || (unsigned)y >= 64) return;
  uint8_t mask = 1 << (y & 7);
  if (on) fb[(y >> 3) * 128 + x] |= mask;
  else    fb[(y >> 3) * 128 + x] &= ~mask;
}

static void fillRect(int x, int y, int w, int h, bool on = true) {
  for (int j = 0; j < h; j++)
    for (int i = 0; i < w; i++) setPixel(x + i, y + j, on);
}

static void hLine(int x, int y, int w) { fillRect(x, y, w, 1); }

// ============================ FONT ============================
// 5×7 px glyphs, '#' = lit. Each glyph takes 6 columns (5 + gap).
// Missing glyphs are drawn as a space – feel free to draw more.

struct FontSheet { const char *chars; const char *rows[7]; };
static const FontSheet FONT[] = {
  {"ABCDEFGHIJKLM", {
    ".###. ####. .###. ###.. ##### ##### .###. #...# .###. ..### #...# #.... #...#",
    "#...# #...# #...# #..#. #.... #.... #...# #...# ..#.. ...#. #..#. #.... ##.##",
    "#...# #...# #.... #...# #.... #.... #.... #...# ..#.. ...#. #.#.. #.... #.#.#",
    "##### ####. #.... #...# ####. ####. #.### ##### ..#.. ...#. ##... #.... #.#.#",
    "#...# #...# #.... #...# #.... #.... #...# #...# ..#.. ...#. #.#.. #.... #...#",
    "#...# #...# #...# #..#. #.... #.... #...# #...# ..#.. #..#. #..#. #.... #...#",
    "#...# ####. .###. ###.. ##### #.... .#### #...# .###. .##.. #...# ##### #...#",
  }},
  {"NOPQRSTUVWXYZ", {
    "#...# .###. ####. .###. ####. .#### ##### #...# #...# #...# #...# #...# #####",
    "#...# #...# #...# #...# #...# #.... ..#.. #...# #...# #...# #...# #...# ....#",
    "##..# #...# #...# #...# #...# #.... ..#.. #...# #...# #...# .#.#. .#.#. ...#.",
    "#.#.# #...# ####. #...# ####. .###. ..#.. #...# #...# #.#.# ..#.. ..#.. ..#..",
    "#..## #...# #.... #.#.# #.#.. ....# ..#.. #...# #...# #.#.# .#.#. ..#.. .#...",
    "#...# #...# #.... #..#. #..#. ....# ..#.. #...# .#.#. #.#.# #...# ..#.. #....",
    "#...# .###. #.... .##.# #...# ####. ..#.. .###. ..#.. .#.#. #...# ..#.. #####",
  }},
  {"0123456789%-.", {
    ".###. ..#.. .###. ##### ...#. ##### ..##. ##### .###. .###. ##... ..... .....",
    "#...# .##.. #...# ...#. ..##. #.... .#... ....# #...# #...# ##..# ..... .....",
    "#..## ..#.. ....# ..#.. .#.#. ####. #.... ...#. #...# #...# ...#. ..... .....",
    "#.#.# ..#.. ...#. ...#. #..#. ....# ####. ..#.. .###. .#### ..#.. .###. .....",
    "##..# ..#.. ..#.. ....# ##### ....# #...# .#... #...# ....# .#... ..... .....",
    "#...# ..#.. .#... #...# ...#. #...# #...# .#... #...# ...#. #..## ..... .##..",
    ".###. .###. ##### .###. ...#. .###. .###. .#... .###. .##.. ...## ..... .##..",
  }},
  {":/!?+()<>", {
    "..... ..... ..#.. .###. ..... ...#. .#... ...#. .#...",
    ".##.. ....# ..#.. #...# ..#.. ..#.. ..#.. ..#.. ..#..",
    ".##.. ...#. ..#.. ....# ..#.. .#... ...#. .#... ...#.",
    "..... ..#.. ..#.. ...#. ##### .#... ...#. #.... ....#",
    ".##.. .#... ..#.. ..#.. ..#.. .#... ...#. .#... ...#.",
    ".##.. #.... ..... ..... ..#.. ..#.. ..#.. ..#.. ..#..",
    "..... ..... ..#.. ..#.. ..... ...#. .#... ...#. .#...",
  }},
  // Lowercase "s" only for the seconds unit (10s), lowercase "v" only before the version number (v0.5.1);
  // other lowercase letters are drawn as uppercase.
  {"=sv", {
    "..... ..... .....",
    "..... ..... .....",
    "##### .#### #...#",
    "..... #.... #...#",
    "##### .###. #...#",
    "..... ....# .#.#.",
    "..... ####. ..#..",
  }},
};

static bool findGlyph(char c, const FontSheet *&sheet, int &col) {
  for (const FontSheet &sh : FONT) {
    const char *hit = strchr(sh.chars, c);
    if (!hit) continue;
    sheet = &sh;
    col = (hit - sh.chars) * 6;
    return true;
  }
  return false;
}

// Draws one line of text; scale = magnification (2 → 10×14 px glyph),
// on = false draws in black (text on a light background).
// A char is looked up exactly, and if the font lacks it, its uppercase form.
// So draw user data (locator, SSID) through upperCopy().
static void drawText(const char *s, int x, int y, int scale = 1, bool on = true) {
  for (; *s && *s != '\n'; s++, x += 6 * scale) {
    const FontSheet *sheet;
    int col;
    if (!findGlyph(*s, sheet, col) && !findGlyph(toupper((unsigned char)*s), sheet, col)) continue;
    for (int r = 0; r < 7; r++)
      for (int i = 0; i < 5; i++)
        if (sheet->rows[r][col + i] == '#') fillRect(x + i * scale, y + r * scale, scale, scale, on);
  }
}

static const char *upperCopy(const char *s, char *out, size_t n) {
  size_t i = 0;
  for (; s[i] && i + 1 < n; i++) out[i] = toupper((unsigned char)s[i]);
  out[i] = 0;
  return out;
}

static int textWidth(const char *s, int scale = 1) {
  int n = strlen(s);
  return n > 0 ? (n * 6 - 1) * scale : 0;
}

static void drawTextRight(const char *s, int right, int y, int scale = 1, bool on = true) {
  drawText(s, right - textWidth(s, scale) + 1, y, scale, on);
}

static void drawTextCenter(const char *s, int y, int scale = 1) {
  drawText(s, (128 - textWidth(s, scale)) / 2, y, scale);
}

// ============================ CONFIGURATION ============================

enum BrightMode : uint8_t { BR_DAY, BR_NIGHT, BR_DIM, BR_LIFE, BR_COUNT };  // display brightness per mode
static const char *const BRIGHT_KEY[BR_COUNT] = {"brday", "brnight", "brdim", "brlife"};
static const uint8_t BRIGHT_DEFAULT[BR_COUNT] = {CONTRAST_DAY, CONTRAST_NIGHT, CONTRAST_DIM, CONTRAST_LIFE};

// On the web brightness is a percentage 1–100, in NVS and on the display 0–255.
static int contrastToPct(uint8_t c) { return (c * 100 + 127) / 255; }
static uint8_t pctToContrast(int p) { return (p * 255 + 50) / 100; }

struct Config {
  char ssid[33];
  char pass[65];
  char call[12];
  char loc[7];
  char lang[4];                     // display and web language code ("en", "cs", "de"); English by default
  char tz[32];                      // time zone ID (see tz.h), e.g. "Europe/Prague" or "UTC+3"
  uint8_t saverMin;                 // saver after this many idle minutes, 0 = never
  uint8_t saverMode;                // SaverMode
  bool wakeOnSpot;                  // new spot = activity (wakes the display)
  bool ledOnSpotWake;               // blink the LED only on a spot wake-up
  bool lifeOff;                     // the Game of Life saver turns the display off after lifeDays
  uint8_t lifeDays;                 // days of Game of Life before the display turns off
  bool rotate;                      // automatic screen rotation
  uint8_t rotateSec;                // seconds per screen in rotation
  bool rotateAll;                   // rotation also cycles the spot screens when there are no spots
  bool rotateMap;                   // without spots, rotation also shows the map (the world, in AUTO)
  uint8_t nightFrom, nightTo;       // night hours (local time); equal = no night
  uint8_t nightMode;                // NightMode
  uint8_t bright[BR_COUNT];         // brightness (SSD1306 contrast) per BrightMode
  uint8_t nvisMargin;               // NVIS: how many % below foF2 the band must lie
  bool nvis60;                      // NVIS: recommend the 60 m band too
  char iono[8];                     // GIRO ionosonde code (e.g. "PQ052"); empty = nearest
  bool mapCz, mapDe, mapUk, mapUs;  // the Czechia, Germany, UK and USA map views are offered (off by default)
  uint8_t board;                    // BoardRev
};
static Config cfg;
static Preferences prefs;
static const char *const NVS_NAMESPACE = "microhamclock";

enum SaverMode : uint8_t { SV_OFF, SV_LIFE, SV_DIM, SV_MODE_COUNT };      // display off / Game of Life / dim
enum NightMode : uint8_t { NM_BUTTON, NM_SPOTS, NM_DARK, NM_MODE_COUNT }; // at night only the button wakes / spots too / dark
static const char *const SAVER_CODE[SV_MODE_COUNT] = {"off", "life", "dim"};
static const char *const NIGHT_CODE[NM_MODE_COUNT] = {"button", "spots", "dark"};
// Board revision, only for the battery measurement (V3.2 switches the divider the other way).
enum BoardRev : uint8_t { BD_AUTO, BD_V31, BD_V32, BD_COUNT };
static const char *const BOARD_CODE[BD_COUNT] = {"auto", "v31", "v32"};
static const char *const BOARD_NAME[BD_COUNT] = {"auto", "V3 / V3.1", "V3.2"};

static void loadString(const char *key, char *out, size_t n) {
  if (prefs.isKey(key)) prefs.getString(key, out, n);   // without isKey() the library logs a missing key as an error
}

static bool configured() { return cfg.ssid[0] && cfg.call[0]; }

static void loadConfig() {
  memset(&cfg, 0, sizeof cfg);
  loadString("ssid", cfg.ssid, sizeof cfg.ssid);
  loadString("pass", cfg.pass, sizeof cfg.pass);
  loadString("call", cfg.call, sizeof cfg.call);
  loadString("loc", cfg.loc, sizeof cfg.loc);
  loadString("lang", cfg.lang, sizeof cfg.lang);
  Lang l;
  if (!langFromCode(cfg.lang, l)) l = LANG_EN;          // unknown or missing language → English
  strlcpy(cfg.lang, langInfo(l).code, sizeof cfg.lang);

  loadString("tzid", cfg.tz, sizeof cfg.tz);
  char id[sizeof cfg.tz];
  if (!tzPosix(cfg.tz, id, sizeof id)) {
    // No zone: a previously configured board ran on CET/CEST, a new one starts in UTC.
    tzPosix(configured() ? LEGACY_TZ : DEFAULT_TZ, id, sizeof id);
  }
  strlcpy(cfg.tz, id, sizeof cfg.tz);

  cfg.saverMin = min<int>(prefs.getUChar("svmin", DEFAULT_SAVER_MIN), MAX_SAVER_MIN);
  cfg.saverMode = prefs.getUChar("svmode", SV_OFF) % SV_MODE_COUNT;
  cfg.wakeOnSpot = prefs.getBool("svspot", true);
  cfg.ledOnSpotWake = prefs.getBool("svled", true);
  cfg.lifeOff = prefs.getBool("lfoff", false);
  cfg.lifeDays = constrain(prefs.getUChar("lfdays", DEFAULT_LIFE_DAYS), 1, MAX_LIFE_DAYS);
  cfg.rotate = prefs.getBool("rotate", DEFAULT_ROTATE);
  cfg.rotateSec = constrain(prefs.getUChar("rotsec", DEFAULT_ROTATE_S), MIN_ROTATE_S, MAX_ROTATE_S);
  cfg.rotateAll = prefs.getBool("rotall", false);
  cfg.rotateMap = prefs.getBool("rotmap", true);
  cfg.nightFrom = prefs.getUChar("nfrom", DEFAULT_NIGHT_FROM) % 24;
  cfg.nightTo = prefs.getUChar("nto", DEFAULT_NIGHT_TO) % 24;
  cfg.nightMode = prefs.getUChar("nmode", NM_SPOTS) % NM_MODE_COUNT;
  for (int i = 0; i < BR_COUNT; i++) cfg.bright[i] = prefs.getUChar(BRIGHT_KEY[i], BRIGHT_DEFAULT[i]);
  cfg.nvisMargin = min<int>(prefs.getUChar("nvismg", 0), MAX_NVIS_MARGIN);
  cfg.nvis60 = prefs.getBool("nvis60", true);
  loadString("iono", cfg.iono, sizeof cfg.iono);
  cfg.mapCz = prefs.getBool("mapcz", false);
  cfg.mapDe = prefs.getBool("mapde", false);
  cfg.mapUs = prefs.getBool("mapus", false);
  cfg.mapUk = prefs.getBool("mapuk", false);
  cfg.board = prefs.getUChar("board", BD_AUTO) % BD_COUNT;
}

static void saveConfig(const Config &c) {
  prefs.putString("ssid", c.ssid);
  prefs.putString("pass", c.pass);
  prefs.putString("call", c.call);
  prefs.putString("loc", c.loc);
  prefs.putString("lang", c.lang);
  prefs.putString("tzid", c.tz);
  prefs.putUChar("svmin", c.saverMin);
  prefs.putUChar("svmode", c.saverMode);
  prefs.putBool("svspot", c.wakeOnSpot);
  prefs.putBool("svled", c.ledOnSpotWake);
  prefs.putBool("lfoff", c.lifeOff);
  prefs.putUChar("lfdays", c.lifeDays);
  prefs.putBool("rotate", c.rotate);
  prefs.putUChar("rotsec", c.rotateSec);
  prefs.putBool("rotall", c.rotateAll);
  prefs.putBool("rotmap", c.rotateMap);
  prefs.putUChar("nfrom", c.nightFrom);
  prefs.putUChar("nto", c.nightTo);
  prefs.putUChar("nmode", c.nightMode);
  for (int i = 0; i < BR_COUNT; i++) prefs.putUChar(BRIGHT_KEY[i], c.bright[i]);
  prefs.putUChar("nvismg", c.nvisMargin);
  prefs.putBool("nvis60", c.nvis60);
  prefs.putString("iono", c.iono);
  prefs.putBool("mapcz", c.mapCz);
  prefs.putBool("mapde", c.mapDe);
  prefs.putBool("mapus", c.mapUs);
  prefs.putBool("mapuk", c.mapUk);
  prefs.putUChar("board", c.board);
  if (prefs.isKey("tz")) prefs.remove("tz");            // POSIX string from version 0.1, no longer used
}

static char tzRule[48];             // POSIX rule of the chosen zone (set by setup)

static Lang cfgLang(const Config &c) {
  Lang l;
  return langFromCode(c.lang, l) ? l : LANG_EN;
}

// List of language codes for help, e.g. "en, cs, de".
static void langCodes(char *out, size_t n) {
  out[0] = 0;
  for (int l = 0; l < LANG_COUNT; l++) {
    if (l) strlcat(out, ", ", n);
    strlcat(out, langInfo(Lang(l)).code, n);
  }
}

// Callsign: uppercase letters, digits and slash, 3–11 chars.
static bool normalizeCall(char *s) {
  int n = strlen(s);
  if (n < 3 || n > 11) return false;
  for (int i = 0; i < n; i++) {
    s[i] = toupper((unsigned char)s[i]);
    if (!isalnum((unsigned char)s[i]) && s[i] != '/') return false;
  }
  return true;
}

// Locator: AA00 or AA00aa, returned in the usual form (JO70va).
static bool normalizeLocator(char *s) {
  int n = strlen(s);
  if (n != 4 && n != 6) return false;
  for (int i = 0; i < n; i++) s[i] = i < 2 ? toupper((unsigned char)s[i]) : tolower((unsigned char)s[i]);
  if (s[0] < 'A' || s[0] > 'R' || s[1] < 'A' || s[1] > 'R') return false;
  if (!isdigit((unsigned char)s[2]) || !isdigit((unsigned char)s[3])) return false;
  if (n == 6 && (s[4] < 'a' || s[4] > 'x' || s[5] < 'a' || s[5] > 'x')) return false;
  return true;
}

// ============================ GEOGRAPHY ============================

// Center of a locator square (4, 6 or more chars; longer ones are cut to 6).
static bool locatorToLatLon(const char *loc, float &lat, float &lon) {
  int n = strlen(loc);
  if (n < 4) return false;
  char a = toupper(loc[0]), b = toupper(loc[1]);
  if (a < 'A' || a > 'R' || b < 'A' || b > 'R' || !isdigit((unsigned char)loc[2]) || !isdigit((unsigned char)loc[3])) return false;
  lon = (a - 'A') * 20.0f - 180.0f + (loc[2] - '0') * 2.0f;
  lat = (b - 'A') * 10.0f - 90.0f + (loc[3] - '0') * 1.0f;
  char c = n >= 6 ? tolower(loc[4]) : 0, d = n >= 6 ? tolower(loc[5]) : 0;
  if (c >= 'a' && c <= 'x' && d >= 'a' && d <= 'x') {
    lon += (c - 'a') * (2.0f / 24) + 1.0f / 24;
    lat += (d - 'a') * (1.0f / 24) + 0.5f / 24;
  } else {
    lon += 1.0f;
    lat += 0.5f;
  }
  return true;
}

static float distanceKm(float lat1, float lon1, float lat2, float lon2) {
  const float R = 6371.0f, D = PI / 180;
  float dlat = (lat2 - lat1) * D, dlon = (lon2 - lon1) * D;
  float a = sinf(dlat / 2) * sinf(dlat / 2) + cosf(lat1 * D) * cosf(lat2 * D) * sinf(dlon / 2) * sinf(dlon / 2);
  return 2 * R * atan2f(sqrtf(a), sqrtf(1 - a));
}

// Point where the Sun is at the zenith (approximation, accurate to ~1°).
static void subsolarPoint(time_t t, float &decl, float &lon) {
  double n = (t - 946728000.0) / 86400.0;            // days since J2000.0
  double L = fmod(280.460 + 0.9856474 * n, 360.0);
  double g = fmod(357.528 + 0.9856003 * n, 360.0) * DEG_TO_RAD;
  double lambda = (L + 1.915 * sin(g) + 0.020 * sin(2 * g)) * DEG_TO_RAD;
  double eps = (23.439 - 0.0000004 * n) * DEG_TO_RAD;
  double ra = atan2(cos(eps) * sin(lambda), cos(lambda)) * RAD_TO_DEG;
  double gmst = fmod(280.46061837 + 360.98564736629 * n, 360.0);
  decl = asin(sin(eps) * sin(lambda)) * RAD_TO_DEG;
  lon = fmod(ra - gmst + 540.0, 360.0) - 180.0;
}

// Days since 1 Jan 1970 (newlib has no timegm, so UTC time is assembled by hand).
static int32_t daysFromCivil(int y, int m, int d) {
  y -= m <= 2;
  int era = (y >= 0 ? y : y - 399) / 400;
  int yoe = y - era * 400;
  int doy = (153 * (m + (m > 2 ? -3 : 9)) + 2) / 5 + d - 1;
  int doe = yoe * 365 + yoe / 4 - yoe / 100 + doy;
  return era * 146097 + doe - 719468;
}

static bool timeValid() { return time(nullptr) > 1700000000; }

// Night per settings (local time). Without valid time there is no night.
static bool isNight() {
  if (!timeValid() || cfg.nightFrom == cfg.nightTo) return false;
  time_t t = time(nullptr);
  struct tm l;
  localtime_r(&t, &l);
  int h = l.tm_hour;
  return cfg.nightFrom > cfg.nightTo ? (h >= cfg.nightFrom || h < cfg.nightTo)
                                     : (h >= cfg.nightFrom && h < cfg.nightTo);
}

// At night with the "dark" option the display stays off (except while the button is held for setup).
static bool nightDark() { return cfg.nightMode == NM_DARK && isNight(); }

// ============================ SHARED DATA ============================
// Networking runs in its own task (core 0), display and button in loop() (core 1).
// Spots and propagation data are guarded by the dataLock lock.

static SemaphoreHandle_t dataLock;
static void lock()   { xSemaphoreTake(dataLock, portMAX_DELAY); }
static void unlock() { xSemaphoreGive(dataLock); }

struct Spot {
  char call[12];                    // who heard me
  char band[6];                     // "20m", "70cm" …
  float lat, lon;
  uint16_t km;
  int8_t snr;
  uint32_t t;                       // reception time (unix), as reported by PSKReporter
  uint32_t rxMs;                    // when it reached us (millis)
};
static const int MAX_SPOTS = 150;
static Spot spots[MAX_SPOTS];
static int spotCount;

struct Solar {
  bool ok;
  char sfi[6], sn[6], a[6], k[6], xray[8];
  uint8_t cond[4][2];               // [bands][day, night]: 0 = ?, 1 = good, 2 = fair, 3 = poor
  uint32_t fetchedAt;               // unix, 0 = fetched before the clock was set (filled in later)
  uint32_t fetchedMs;               // millis() of the fetch
};
static Solar solar;

struct Iono {
  bool ok;
  float fof2, mufd;                 // MHz; mufd = MUF for a 3000 km hop
  uint32_t measuredAt;              // unix, ionosonde measurement time
  char code[8];                     // GIRO ionosonde code, e.g. "PQ052"
  char name[40];                    // e.g. "Pruhonice, Czech Republic" (serial console only)
  uint16_t km;                      // distance from home, 0 = unknown
};
static Iono iono;

static float homeLat, homeLon;
static bool homeOk;

static volatile bool wifiUp, mqttUp, quietLog;

enum WifiFail : uint8_t { WF_NONE, WF_NO_AP, WF_AUTH, WF_OTHER };
static const StrId WIFI_FAIL_TEXT[] = {S_WIFI_CONNECTING, S_WIFI_NO_AP, S_WIFI_BAD_PASS, S_WIFI_CONNECTING};
static const char *const WIFI_FAIL_LOG[] = {"", "network not found", "wrong password?", "error"};
static volatile WifiFail wifiFail;       // shown on the display
static volatile WifiFail wifiFailSeen;   // the latest failure reason, shown only once it lasts
static const uint32_t WIFI_RETRY_MS = 60000;   // how often to retry connecting when it fails
// The first attempt after a restart often fails (reason 2, AUTH_EXPIRE) and the next one connects,
// so a failure reaches the display only when Wi-Fi has been down this long.
static const uint32_t WIFI_FAIL_SHOW_MS = 20000;
static volatile uint32_t spotsTotal;
// When the PSKReporter feed last got a spot (unix, from FEED_TOPIC or our own spots), 0 = not known yet.
static volatile uint32_t feedLastSpot;
static volatile bool feedWatched;        // the broker accepted the FEED_TOPIC subscription
static bool asleep;                     // the saver is on (display task only)
// Console "saver": the saver is on right away until the next activity; saverForceMode -1 = the set one.
static bool saverForced;
static int8_t saverForceMode = -1;
static uint32_t saverForcedAt;
static volatile uint32_t spotWakeAt;   // millis of the last fresh spot (wakes the display), 0 = none
static volatile uint32_t propagationSeq;   // increments when new propagation data arrives (N0NBH or ionosonde)
static uint32_t blinkTestAt;               // "blink" command: pretend new data at this moment, 0 = none
static int screenCmd = -1;                 // "screen" command: the screen to show (a Screen value, or SCREEN_STATUS), -1 = none
static const int SCREEN_STATUS = 100;

static uint32_t spotAge(const Spot &s, uint32_t nowUnix, uint32_t nowMs) {
  if (nowUnix && s.t && nowUnix >= s.t) return nowUnix - s.t;
  return (nowMs - s.rxMs) / 1000;
}

// The feed is connected but has had no spot from PSKReporter for FEED_DOWN_MIN (needs valid time).
static bool feedDown() {
  uint32_t last = feedLastSpot;
  return mqttUp && last && timeValid() && (uint32_t)time(nullptr) > last + FEED_DOWN_MIN * 60u;
}

// The same station on the same band is just updated.
static void addSpot(const Spot &s) {
  lock();
  int slot = -1, oldest = 0;
  for (int i = 0; i < spotCount; i++) {
    if (!strcmp(spots[i].call, s.call) && !strcmp(spots[i].band, s.band)) { slot = i; break; }
    if (spots[i].t < spots[oldest].t) oldest = i;
  }
  if (slot < 0) slot = spotCount < MAX_SPOTS ? spotCount++ : oldest;
  spots[slot] = s;
  unlock();
}

static void expireSpots() {
  uint32_t nowUnix = timeValid() ? time(nullptr) : 0, nowMs = millis();
  lock();
  int j = 0;
  for (int i = 0; i < spotCount; i++)
    if (spotAge(spots[i], nowUnix, nowMs) < SPOT_WINDOW_MIN * 60u) spots[j++] = spots[i];
  spotCount = j;
  unlock();
}

// ============================ PSKREPORTER (MQTT) ============================
// Minimal MQTT 3.1.1 client: CONNECT, SUBSCRIBE (QoS 0), PINGREQ and receiving PUBLISH.
// Topics look like pskr/filter/v2/band/mode/sender/receiver/sloc/rloc/sdxcc/rdxcc,
// a slash in a callsign is replaced by a dot in the topic.

// A delay with a random spread of ±10 %, so boards that started together (after a power cut, say)
// do not all ask the data servers or the MQTT broker at the same moment.
static uint32_t jittered(uint32_t ms) {
  uint32_t spread = ms / 5;
  return ms - spread / 2 + esp_random() % (spread + 1);
}

enum MqttState { MS_IDLE, MS_WAIT_CONNACK, MS_WAIT_SUBACK, MS_READY };
static WiFiClient mqttNet;
static MqttState mqttState = MS_IDLE;
static uint32_t mqttStateSince, mqttLastRx, mqttLastTx, mqttNextTry, mqttBackoff = 5000;
static uint8_t mqttBuf[1024];

static size_t putLen(uint8_t *p, uint32_t n) {
  size_t i = 0;
  do {
    uint8_t b = n & 0x7F;
    n >>= 7;
    p[i++] = b | (n ? 0x80 : 0);
  } while (n);
  return i;
}

static size_t putStr(uint8_t *p, const char *s) {
  size_t n = strlen(s);
  p[0] = n >> 8;
  p[1] = n & 0xFF;
  memcpy(p + 2, s, n);
  return n + 2;
}

static void mqttSend(uint8_t type, const uint8_t *body, size_t len) {
  uint8_t hdr[5];
  hdr[0] = type;
  size_t h = 1 + putLen(hdr + 1, len);
  mqttNet.write(hdr, h);
  if (len) mqttNet.write(body, len);
  mqttLastTx = millis();
}

static void mqttSetState(MqttState s) {
  mqttState = s;
  mqttStateSince = millis();
  mqttUp = s == MS_READY;
}

static void mqttDrop(const char *why) {
  if (mqttState != MS_IDLE && !quietLog) Serial.printf("MQTT: disconnected (%s)\r\n", why);
  mqttNet.stop();
  mqttSetState(MS_IDLE);
  mqttNextTry = millis() + jittered(mqttBackoff);
  mqttBackoff = min<uint32_t>(mqttBackoff * 2, 120000);
}

static void mqttConnect() {
  if (!mqttNet.connect(MQTT_HOST, MQTT_PORT, 5000)) {
    mqttDrop("cannot connect");
    if (!quietLog) Serial.println("MQTT: server not responding");
    return;
  }
  mqttNet.setNoDelay(true);
  char id[24];
  snprintf(id, sizeof id, "microhamclock-%08lx", (unsigned long)esp_random());
  uint8_t body[64];
  size_t n = putStr(body, "MQTT");
  body[n++] = 4;                    // version 3.1.1
  body[n++] = 0x02;                 // clean session
  body[n++] = 0;
  body[n++] = 60;                   // keepalive 60 s
  n += putStr(body + n, id);
  mqttSend(0x10, body, n);
  mqttLastRx = millis();
  mqttSetState(MS_WAIT_CONNACK);
}

// Base form of a callsign: the longest part between slashes (OK2MTB/P → OK2MTB, DL/OK2MTB → OK2MTB).
static void baseCall(const char *call, char *out, size_t n) {
  const char *best = call;
  size_t bestLen = 0;
  for (const char *p = call; *p;) {
    size_t len = strcspn(p, "/");
    if (len > bestLen) { best = p; bestLen = len; }
    p += len;
    if (*p) p++;
  }
  bestLen = min(bestLen, n - 1);
  memcpy(out, best, bestLen);
  out[bestLen] = 0;
}

// Subscribes to the callsign as entered, its base form and the base with CALL_SUFFIXES.
static void mqttSubscribe() {
  const int MAX_CALLS = 2 + sizeof CALL_SUFFIXES / sizeof CALL_SUFFIXES[0];
  char calls[MAX_CALLS][16], base[12];
  int count = 0;
  baseCall(cfg.call, base, sizeof base);
  auto add = [&](const char *c) {
    for (int i = 0; i < count; i++) if (!strcmp(calls[i], c)) return;
    strlcpy(calls[count++], c, sizeof calls[0]);
  };
  add(cfg.call);
  add(base);
  for (const char *suffix : CALL_SUFFIXES) {
    char c[16];
    snprintf(c, sizeof c, "%s/%s", base, suffix);
    add(c);
  }

  uint8_t body[256];
  body[0] = 0;
  body[1] = 1;                      // message identifier
  size_t n = 2;
  for (int i = 0; i < count; i++) {
    char topic[64] = "pskr/filter/v2/+/+/";
    size_t t = strlen(topic);
    for (const char *c = calls[i]; *c && t < sizeof topic - 3; c++) topic[t++] = *c == '/' ? '.' : *c;
    strcpy(topic + t, "/#");
    n += putStr(body + n, topic);
    body[n++] = 0;                  // QoS 0
    if (!quietLog) Serial.printf("MQTT: subscribing to %s\r\n", topic);
  }
  n += putStr(body + n, FEED_TOPIC);   // the last topic, its SUBACK result may fail
  body[n++] = 0;
  mqttSend(0x82, body, n);
  mqttSetState(MS_WAIT_SUBACK);
}

// ---- simple parsing of PSKReporter's flat JSON ----

static const char *jsonFind(const char *js, const char *key) {
  char pat[16];
  snprintf(pat, sizeof pat, "\"%s\":", key);
  const char *p = strstr(js, pat);
  return p ? p + strlen(pat) : nullptr;
}

static bool jsonStr(const char *js, const char *key, char *out, size_t n) {
  const char *p = jsonFind(js, key);
  if (!p || *p != '"') return false;
  size_t i = 0;
  for (p++; *p && *p != '"' && i + 1 < n; p++) out[i++] = *p;
  out[i] = 0;
  return i > 0;
}

// 64-bit: a 32-bit long would clamp unix times after January 2038.
static bool jsonLong(const char *js, const char *key, long long &v) {
  const char *p = jsonFind(js, key);
  if (!p) return false;
  char *end;
  v = strtoll(p, &end, 10);
  return end != p;
}

// {"sq":…,"f":14074000,"md":"FT8","rp":-12,"t":1791562589,"sc":"OK1ABC","sl":"JO70va",
//  "rc":"DL1XYZ","rl":"JO62qm","sa":503,"ra":230,"b":"20m"}
static void handleSpot(const char *js) {
  Spot s = {};
  char loc[12];
  long long snr = 0, t = 0;
  if (!jsonStr(js, "rc", s.call, sizeof s.call) || !jsonStr(js, "rl", loc, sizeof loc)) return;
  for (char *c = s.call; *c; c++) *c = toupper((unsigned char)*c);   // the font would draw a lowercase "s" as lowercase
  if (!strcmp(s.call, "N0CALL")) return;   // default callsign in programs where nobody has set one
  if (!locatorToLatLon(loc, s.lat, s.lon)) return;
  jsonStr(js, "b", s.band, sizeof s.band);
  jsonLong(js, "rp", snr);
  jsonLong(js, "t", t);
  s.snr = constrain(snr, -99, 99);
  s.t = t;
  s.rxMs = millis();
  s.km = homeOk ? (uint16_t)lroundf(distanceKm(homeLat, homeLon, s.lat, s.lon)) : 0;
  addSpot(s);
  spotsTotal++;
  // Only fresh spots wake: some programs send reports delayed by even hours.
  uint32_t nowUnix = timeValid() ? time(nullptr) : 0;
  if (!nowUnix || !s.t || nowUnix < s.t + SPOT_WAKE_MAX_AGE_MIN * 60u) spotWakeAt = millis() | 1;
  if (nowUnix > feedLastSpot) feedLastSpot = nowUnix;   // a spot of our own proves the feed works
  if (!quietLog) Serial.printf("Spot: %s %s %+d dB %u km\r\n", s.call, s.band, s.snr, s.km);
}

// FEED_TOPIC payload: a plain ISO time, "2026-10-17T16:01:58.635Z".
static void handleFeed(const char *js) {
  int Y, M, D, h, m, sec;
  if (sscanf(js, "%d-%d-%dT%d:%d:%d", &Y, &M, &D, &h, &m, &sec) != 6) return;
  uint32_t t = (int64_t)daysFromCivil(Y, M, D) * 86400 + h * 3600 + m * 60 + sec;
  if (t > feedLastSpot) feedLastSpot = t;
}

static void mqttPacket(uint8_t type, const uint8_t *p, uint32_t len) {
  switch (type >> 4) {
    case 2:                         // CONNACK
      if (len >= 2 && p[1] == 0) {
        if (!quietLog) Serial.println("MQTT: connected");
        mqttBackoff = 5000;
        mqttSubscribe();
      } else {
        mqttDrop("server refused the connection");
      }
      break;
    case 9: {                       // SUBACK: after the identifier, one result per topic, FEED_TOPIC last
      bool ok = len >= 4;
      for (uint32_t i = 2; i + 1 < len; i++) ok &= p[i] != 0x80;
      if (ok) {
        feedWatched = p[len - 1] != 0x80;
        if (!feedWatched && !quietLog) Serial.println("MQTT: feed statistics refused, the feed is not watched");
        mqttSetState(MS_READY);
      } else {
        mqttDrop("subscription refused");
      }
      break;
    }
    case 3: {                       // PUBLISH
      if (len < 2) break;
      uint32_t off = 2 + (p[0] << 8 | p[1]);
      if (type & 0x06) off += 2;    // QoS > 0 has a message identifier
      if (off >= len) break;
      char js[sizeof mqttBuf + 1];
      memcpy(js, p + off, len - off);
      js[len - off] = 0;
      size_t topicLen = p[0] << 8 | p[1];
      if (topicLen == strlen(FEED_TOPIC) && !memcmp(p + 2, FEED_TOPIC, topicLen)) handleFeed(js);
      else handleSpot(js);
      break;
    }
    default:                        // PINGRESP and the rest are enough as a sign of life
      break;
  }
}

static void mqttPoll() {
  static uint8_t type;
  static uint32_t len, got, mult;
  static int part;                  // 0 = header, 1 = length, 2 = payload
  while (mqttNet.available()) {
    uint8_t b = mqttNet.read();
    mqttLastRx = millis();
    if (part == 0) {
      type = b;
      len = got = 0;
      mult = 1;
      part = 1;
    } else if (part == 1) {
      len += (b & 0x7F) * mult;
      mult <<= 7;
      if (!(b & 0x80)) part = len ? 2 : 0;
      if (!part) mqttPacket(type, mqttBuf, 0);
    } else {
      if (got < sizeof mqttBuf) mqttBuf[got] = b;   // overly long messages are dropped
      if (++got == len) {
        if (len <= sizeof mqttBuf) mqttPacket(type, mqttBuf, len);
        part = 0;
      }
    }
  }
}

static void mqttService() {
  uint32_t now = millis();
  if (mqttState == MS_IDLE) {
    if (cfg.call[0] && (int32_t)(now - mqttNextTry) >= 0) mqttConnect();
    return;
  }
  if (!mqttNet.connected()) { mqttDrop("connection lost"); return; }
  mqttPoll();
  now = millis();                   // mqttPoll may have moved times forward, an older "now" would underflow
  if (mqttState == MS_IDLE) return;
  if (mqttState != MS_READY && now - mqttStateSince > 10000) { mqttDrop("server did not respond"); return; }
  if (now - mqttLastTx > 30000) mqttSend(0xC0, nullptr, 0);   // PINGREQ
  if (now - mqttLastRx > 100000) mqttDrop("no reply to ping");

  static bool wasDown;
  bool down = feedDown();
  if (down != wasDown && !quietLog) {
    if (down) {
      time_t t = feedLastSpot;
      struct tm u;
      gmtime_r(&t, &u);
      Serial.printf("MQTT: PSKReporter feed down, no spot since %02d:%02d:%02d UTC\r\n", u.tm_hour, u.tm_min, u.tm_sec);
    } else {
      Serial.println("MQTT: PSKReporter feed back");
    }
  }
  wasDown = down;
}

// ============================ PROPAGATION (hamqsl.com, ionosonde) ============================

// Downloads a public page over HTTPS (the certificate is not verified, the data is not secret).
static bool httpsGet(const char *url, const char *what, String &out) {
  WiFiClientSecure tls;
  tls.setInsecure();
  HTTPClient http;
  http.setTimeout(10000);
  http.setUserAgent(String("microHAMCLOCK/") + FW_VERSION + " (https://github.com/Holyszewski/microHAMCLOCK)");
  if (!http.begin(tls, url)) return false;
  int code = http.GET();
  if (code == 200) out = http.getString();
  http.end();
  if (code != 200 && !quietLog) Serial.printf("%s: HTTP %d\r\n", what, code);
  return code == 200 && out.length();
}

static void xmlValue(const String &x, const char *tag, char *out, size_t n) {
  out[0] = 0;
  String open = String('<') + tag + '>';
  int a = x.indexOf(open);
  if (a < 0) return;
  a += open.length();
  int b = x.indexOf('<', a);
  if (b < 0) return;
  String v = x.substring(a, b);
  v.trim();
  strlcpy(out, v.c_str(), n);
}

static const char *const BAND_GROUPS[4] = {"80m-40m", "30m-20m", "17m-15m", "12m-10m"};

static bool fetchSolar() {
  String x;
  if (!httpsGet(SOLAR_URL, "Propagation", x)) return false;

  Solar s = {};
  xmlValue(x, "solarflux", s.sfi, sizeof s.sfi);
  xmlValue(x, "sunspots", s.sn, sizeof s.sn);
  xmlValue(x, "aindex", s.a, sizeof s.a);
  xmlValue(x, "kindex", s.k, sizeof s.k);
  xmlValue(x, "xray", s.xray, sizeof s.xray);
  for (int i = 0; i < 4; i++)
    for (int j = 0; j < 2; j++) {
      char key[48];
      snprintf(key, sizeof key, "name=\"%s\" time=\"%s\">", BAND_GROUPS[i], j ? "night" : "day");
      int p = x.indexOf(key);
      if (p < 0) continue;
      p += strlen(key);
      s.cond[i][j] = x.startsWith("Good", p) ? 1 : x.startsWith("Fair", p) ? 2 : x.startsWith("Poor", p) ? 3 : 0;
    }
  if (!s.sfi[0]) return false;
  s.ok = true;
  s.fetchedAt = timeValid() ? time(nullptr) : 0;
  s.fetchedMs = millis();
  lock();
  solar = s;
  unlock();
  static char lastUpdated[32];      // N0NBH refreshes about hourly, we fetch more often
  char updated[32];
  xmlValue(x, "updated", updated, sizeof updated);
  if (strcmp(updated, lastUpdated)) {
    strcpy(lastUpdated, updated);
    propagationSeq++;
  }
  if (!quietLog) Serial.printf("Propagation: SFI %s SN %s A %s K %s X %s\r\n", s.sfi, s.sn, s.a, s.k, s.xray);
  return true;
}

// Number after "key": in KC2G JSON (with spaces); null or missing key → false.
static bool jsonNumber(const String &js, int from, int to, const char *key, float &v) {
  String pat = String('"') + key + "\":";
  int p = js.indexOf(pat, from);
  if (p < 0 || p >= to) return false;
  const char *s = js.c_str() + p + pat.length();
  while (*s == ' ') s++;
  char *end;
  v = strtof(s, &end);
  return end != s;
}

// Text after "key": "value" in KC2G JSON; missing key → false.
static bool jsonText(const String &js, int from, int to, const char *key, char *out, size_t n) {
  String pat = String('"') + key + "\": \"";
  int p = js.indexOf(pat, from);
  if (p < 0 || p >= to) return false;
  p += pat.length();
  int e = js.indexOf('"', p);
  if (e < 0 || e >= to) return false;
  strlcpy(out, js.c_str() + p, min<size_t>(n, e - p + 1));
  return true;
}

// Bounds [from, to) of the next top-level object of a JSON array, searched from pos. KC2G does not keep
// the key order of its records stable (once "source" came first, later "tec"), so records are found
// by their braces, never by their first key.
static bool nextJsonObject(const String &js, int pos, int &from, int &to) {
  const char *s = js.c_str();
  int depth = 0;
  bool inStr = false;
  for (int i = pos, n = js.length(); i < n; i++) {
    char c = s[i];
    if (inStr) {
      if (c == '\\') i++;
      else if (c == '"') inStr = false;
    } else if (c == '"') {
      inStr = true;
    } else if (c == '{') {
      if (!depth++) from = i;
    } else if (c == '}' && depth && !--depth) {
      to = i + 1;
      return true;
    }
  }
  return false;
}

// One KC2G record, keys in any order: {"station": {"code": "PQ052", "name": …, "longitude": "14.6",
// "latitude": "50"}, "time": "2026-10-09T16:40:00", "fof2": 6.0, "mufd": 19.8, "source": "giro", …}.
// Without foF2 or time → false.
static bool parseIonoRecord(const String &js, int from, int to, Iono &io) {
  io = {};
  char lat[12], lon[12], when[24];
  if (!jsonText(js, from, to, "code", io.code, sizeof io.code) || !jsonNumber(js, from, to, "fof2", io.fof2) ||
      !jsonText(js, from, to, "time", when, sizeof when))
    return false;
  int Y, M, D, h, m;
  if (sscanf(when, "%d-%d-%dT%d:%d", &Y, &M, &D, &h, &m) != 5) return false;
  io.measuredAt = (int64_t)daysFromCivil(Y, M, D) * 86400 + h * 3600 + m * 60;   // int32 would overflow in 2038
  jsonNumber(js, from, to, "mufd", io.mufd);
  jsonText(js, from, to, "name", io.name, sizeof io.name);
  if (homeOk && jsonText(js, from, to, "latitude", lat, sizeof lat) && jsonText(js, from, to, "longitude", lon, sizeof lon)) {
    float la = atof(lat), lo = atof(lon);
    if (lo > 180) lo -= 360;          // KC2G has longitude 0–360
    io.km = max(1L, lroundf(distanceKm(homeLat, homeLon, la, lo)));
  }
  io.ok = true;
  return true;
}

// Picks the ionosonde: the one given by code, otherwise the nearest with a fresh measurement within IONO_MAX_KM.
// The current one stays until it is more than IONO_STICKY_KM farther than the nearest, so readings
// do not jump between two stations that drop out alternately.
// false = download failed (retried sooner); with no suitable ionosonde the old data stays until it ages out.
static bool fetchIono() {           // called only with valid time
  String js;
  if (!httpsGet(IONO_URL, "Ionosonde", js)) return false;
  uint32_t now = time(nullptr);
  char last[sizeof iono.code];
  strcpy(last, iono.code);          // iono is written only by this task, so it may read it without the lock
  bool manual = cfg.iono[0], listed = false;
  Iono best = {}, kept = {}, rec;
  for (int from, to, pos = 0; nextJsonObject(js, pos, from, to); pos = to) {
    if (parseIonoRecord(js, from, to, rec)) {
      bool match = manual && !strcmp(rec.code, cfg.iono);
      listed |= match;
      bool fresh = now >= rec.measuredAt && now - rec.measuredAt < IONO_MAX_AGE_MIN * 60u;
      if (fresh && (match || (!manual && rec.km && rec.km <= IONO_MAX_KM))) {
        if (!best.ok || rec.km < best.km) best = rec;
        if (!manual && !strcmp(rec.code, last)) kept = rec;
      }
    }
  }
  if (kept.ok && kept.km <= best.km + IONO_STICKY_KM) best = kept;
  if (!best.ok) {
    if (quietLog) return true;
    if (!manual)      Serial.printf("Ionosonde: none with a fresh measurement within %u km\r\n", IONO_MAX_KM);
    else if (!listed) Serial.printf("Ionosonde %s: not in the data\r\n", cfg.iono);
    else              Serial.printf("Ionosonde %s: no fresh measurement\r\n", cfg.iono);
    return true;
  }
  lock();
  bool changed = !iono.ok || iono.measuredAt != best.measuredAt || strcmp(iono.code, best.code);
  iono = best;
  unlock();
  if (changed) propagationSeq++;
  if (!quietLog) {
    time_t t = best.measuredAt;
    struct tm u;
    gmtime_r(&t, &u);
    Serial.printf("Ionosonde %s (%s, %u km): foF2 %.1f MHz, MUF %.1f MHz (%02d:%02d UTC)\r\n", best.code, best.name,
                  best.km, best.fof2, best.mufd, u.tm_hour, u.tm_min);
  }
  return true;
}

// A measurement is fresh when not older than IONO_MAX_AGE_MIN (trusted without valid time).
static bool ionoFresh(const Iono &io) {
  if (!io.ok) return false;
  if (!timeValid() || !io.measuredAt) return true;
  return (uint32_t)time(nullptr) - io.measuredAt < IONO_MAX_AGE_MIN * 60u;
}

// Recommended NVIS band: the highest band whose lower edge lies below foF2
// reduced by the configured margin (the classic optimum working frequency FOT is 0.85 × foF2).
// Returns e.g. "80", or nullptr when there is no data or foF2 is below 160 m.
static const char *nvisBand(const Iono &io) {
  struct Band { float mhz; const char *name; };
  static const Band BANDS[] = {{14.0f, "20"}, {10.1f, "30"}, {7.0f, "40"}, {5.3515f, "60"}, {3.5f, "80"}, {1.8f, "160"}};
  if (!ionoFresh(io)) return nullptr;
  float limit = io.fof2 * (100 - cfg.nvisMargin) / 100;
  for (const Band &b : BANDS)
    if (b.mhz <= limit && (cfg.nvis60 || strcmp(b.name, "60"))) return b.name;
  return nullptr;
}

// ============================ NETWORK TASK ============================

static void onTimeSync(struct timeval *tv) {   // called by SNTP after each sync (about hourly)
  if (quietLog) return;
  time_t t = tv->tv_sec;
  struct tm u;
  gmtime_r(&t, &u);
  Serial.printf("NTP: time set, %02d:%02d:%02d UTC\r\n", u.tm_hour, u.tm_min, u.tm_sec);
}

// Why connecting fails (from the disconnect event reason code), so the display can say so.
static void onWifiDisconnect(WiFiEvent_t, WiFiEventInfo_t info) {
  uint8_t r = info.wifi_sta_disconnected.reason;
  if (r == WIFI_REASON_ASSOC_LEAVE) return;   // we disconnected ourselves (new attempt), the previous failure reason still holds
  WifiFail f = r == WIFI_REASON_NO_AP_FOUND ? WF_NO_AP
             : r == WIFI_REASON_AUTH_FAIL || r == WIFI_REASON_4WAY_HANDSHAKE_TIMEOUT ||
               r == WIFI_REASON_HANDSHAKE_TIMEOUT || r == WIFI_REASON_AUTH_EXPIRE ? WF_AUTH
             : WF_OTHER;
  if (f != wifiFailSeen && !quietLog)
    Serial.printf("WiFi: cannot connect to %s (%s, code %u)\r\n", cfg.ssid, WIFI_FAIL_LOG[f], r);
  wifiFailSeen = f;
}

// Wait after the n-th failed download in a row: 2 min, then longer each time, up to an hour, so a server
// that is down is not asked every 2 minutes by every board.
static uint32_t retryDelay(uint8_t fails) {
  uint32_t ms = FETCH_RETRY_MIN_MS;
  for (uint8_t i = 1; i < fails && ms < FETCH_RETRY_MAX_MS; i++) ms *= 2;
  return jittered(min<uint32_t>(ms, FETCH_RETRY_MAX_MS));
}

static void netTask(void *) {
  WiFi.onEvent(onWifiDisconnect, ARDUINO_EVENT_WIFI_STA_DISCONNECTED);
  WiFi.mode(WIFI_STA);
  WiFi.setHostname("microhamclock");
  WiFi.setAutoReconnect(true);
  WiFi.begin(cfg.ssid, cfg.pass[0] ? cfg.pass : nullptr);
  bool ntpStarted = false, wasUp = false;
  uint32_t nextSolar = 0, nextIono = 0, nextExpire = 0, lastBegin = millis(), downSince = millis();
  uint8_t solarFails = 0, ionoFails = 0;

  for (;;) {
    uint32_t now = millis();
    bool up = WiFi.status() == WL_CONNECTED;
    if (up != wasUp) {
      wasUp = up;
      if (!up) downSince = now;
      else {                          // the first downloads come soon, but not all at the same moment
        nextSolar = now + esp_random() % START_SPREAD_MS;
        nextIono = now + esp_random() % START_SPREAD_MS;
      }
      if (!quietLog) {
        if (up) Serial.printf("WiFi: connected, IP %s\r\n", WiFi.localIP().toString().c_str());
        else    Serial.println("WiFi: disconnected");
      }
    }
    wifiUp = up;
    if (up) wifiFailSeen = WF_NONE;
    wifiFail = !up && now - downSince >= WIFI_FAIL_SHOW_MS ? wifiFailSeen : WF_NONE;
    if (!up) {
      if (mqttState != MS_IDLE) mqttDrop("Wi-Fi down");
      // The core does not reconnect by itself after some errors (e.g. AUTH_FAIL), so we retry ourselves.
      if (now - lastBegin > WIFI_RETRY_MS) {
        WiFi.disconnect();
        WiFi.begin(cfg.ssid, cfg.pass[0] ? cfg.pass : nullptr);
        lastBegin = now;
      }
      vTaskDelay(pdMS_TO_TICKS(500));
      continue;
    }
    lastBegin = now;
    if (!ntpStarted) {                // time comes from NTP only after connecting to Wi-Fi
      sntp_set_time_sync_notification_cb(onTimeSync);
      configTzTime(tzRule, NTP_1, NTP_2, NTP_3);
      ntpStarted = true;
    }

    mqttService();

    if (solar.ok && !solar.fetchedAt && timeValid()) {   // fetched before NTP: date it now
      lock();
      solar.fetchedAt = time(nullptr) - (millis() - solar.fetchedMs) / 1000;
      unlock();
    }

    if ((int32_t)(now - nextSolar) >= 0) {
      bool ok = fetchSolar();
      solarFails = ok ? 0 : min<uint8_t>(solarFails + 1, 16);
      nextSolar = millis() + (ok ? jittered(SOLAR_REFRESH_MIN * 60000UL) : retryDelay(solarFails));
    }
    if (timeValid() && (int32_t)(now - nextIono) >= 0) {   // without time a fresh measurement cannot be recognized
      bool ok = fetchIono();
      ionoFails = ok ? 0 : min<uint8_t>(ionoFails + 1, 16);
      nextIono = millis() + (ok ? jittered(IONO_REFRESH_MIN * 60000UL) : retryDelay(ionoFails));
    }
    if ((int32_t)(now - nextExpire) >= 0) {
      expireSpots();
      nextExpire = now + 10000;
    }
    vTaskDelay(pdMS_TO_TICKS(20));
  }
}

// ============================ POWER (BATTERY, POWER OFF) ============================
// The battery voltage is measured on GPIO1 through a divider that GPIO37 switches on. Its polarity
// differs between revisions: V3 and V3.1 have a pull-up and are active LOW, V3.2 has a transistor and
// is active HIGH. The pull-up also tells them apart: the pin left as an input reads HIGH only on V3/V3.1.
// Power off = deep sleep with no wake-up source; only the RST button (a full reset) starts the board.

static TaskHandle_t netTaskHandle;
static bool boardV32Detected;
static uint16_t batteryMv;          // last measurement, 0 = not measured yet

static bool boardV32() { return cfg.board == BD_V32 || (cfg.board == BD_AUTO && boardV32Detected); }

static const char *boardName() { return BOARD_NAME[boardV32() ? BD_V32 : BD_V31]; }

// Called at boot before anything drives GPIO37; then the divider stays on (about 9 µA, nothing next to Wi-Fi).
static void batteryInit() {
  gpio_hold_dis(gpio_num_t(PIN_VBAT_CTRL));    // held since a power off when woken by the timer
  pinMode(PIN_VBAT_CTRL, INPUT);
  delayMicroseconds(200);
  boardV32Detected = digitalRead(PIN_VBAT_CTRL) == LOW;
  pinMode(PIN_VBAT_CTRL, OUTPUT);
  digitalWrite(PIN_VBAT_CTRL, boardV32() ? HIGH : LOW);
  delay(2);
}

static uint16_t readBatteryMv() {
  uint32_t sum = 0;
  for (int i = 0; i < 16; i++) sum += analogReadMilliVolts(PIN_VBAT);
  return sum / 16 * VBAT_DIVIDER;
}

static bool batteryPresent(uint16_t mv) { return mv >= BAT_NONE_MV; }

// Rough charge of a Li-ion cell from its voltage under a light load.
static int batteryPercent(uint16_t mv) {
  static const uint16_t MV[] = {3300, 3400, 3500, 3600, 3700, 3800, 3900, 4000, 4100, 4200};
  static const uint8_t PCT[] = {0, 4, 10, 22, 40, 55, 68, 79, 90, 100};
  if (mv <= MV[0]) return 0;
  for (size_t i = 1; i < sizeof MV / sizeof MV[0]; i++)
    if (mv <= MV[i]) return PCT[i - 1] + (PCT[i] - PCT[i - 1]) * (mv - MV[i - 1]) / (MV[i] - MV[i - 1]);
  return 100;
}

// Puts the SX1262 into sleep (SetSleep, cold start); after a power-on it sits in standby.
static void loraSleep() {
  pinMode(PIN_LORA_RST, OUTPUT);
  digitalWrite(PIN_LORA_RST, HIGH);
  pinMode(PIN_LORA_NSS, OUTPUT);
  digitalWrite(PIN_LORA_NSS, HIGH);
  pinMode(PIN_LORA_BUSY, INPUT);
  SPI.begin(PIN_LORA_SCK, PIN_LORA_MISO, PIN_LORA_MOSI, PIN_LORA_NSS);
  for (uint32_t t = millis(); digitalRead(PIN_LORA_BUSY) == HIGH && millis() - t < 20;) delay(1);
  SPI.beginTransaction(SPISettings(2000000, MSBFIRST, SPI_MODE0));
  digitalWrite(PIN_LORA_NSS, LOW);
  SPI.transfer(0x84);               // SetSleep
  SPI.transfer(0x00);               // cold start, RTC timeout off
  digitalWrite(PIN_LORA_NSS, HIGH);
  SPI.endTransaction();
  SPI.end();
  delay(1);
}

static void holdPin(uint8_t pin, bool high) {
  pinMode(pin, OUTPUT);
  digitalWrite(pin, high ? HIGH : LOW);
  gpio_hold_en(gpio_num_t(pin));
}

// Pins held through deep sleep are released at boot (a timer wake keeps the holds).
static void releasePinHolds() {
  for (uint8_t pin : {PIN_VEXT, PIN_VBAT_CTRL, PIN_LORA_NSS, PIN_LORA_RST}) gpio_hold_dis(gpio_num_t(pin));
  gpio_deep_sleep_hold_dis();
}

// Turns everything off and goes to deep sleep. flat = the battery is flat: with BAT_FLAT_RECHECK the board
// then wakes every BAT_RECHECK_MIN to check whether it has been charged, otherwise only RST starts it, as
// after the manual power off. show = say so on the display first.
static void powerOff(bool flat, bool show) {
  if (show) {
    memset(fb, 0, sizeof fb);
    const char *title = tr(flat ? S_BATTERY_FLAT : S_POWER_OFF);
    if (textWidth(title, 2) <= 128) drawTextCenter(title, 14, 2);
    else                            drawTextCenter(title, 18);   // too long for big letters
    drawTextCenter(tr(S_POWER_RST), 40);
    oledPower(true);
    oledContrast(cfg.bright[BR_DAY]);
    oledFlush();
  }
  Serial.println(flat ? "Power off: battery flat" : "Power off: press RST to start again");
  Serial.flush();
  if (show) delay(1500);
  if (netTaskHandle) vTaskSuspend(netTaskHandle);
  WiFi.disconnect(true);
  WiFi.mode(WIFI_OFF);
  digitalWrite(LED_BUILTIN, LOW);
  loraSleep();
  Wire.end();                       // no pull-ups on the I2C lines of the unpowered display
  for (uint8_t pin : {PIN_OLED_SDA, PIN_OLED_SCL, PIN_OLED_RST}) pinMode(pin, INPUT);
  holdPin(PIN_VEXT, true);          // display power off
  holdPin(PIN_VBAT_CTRL, !boardV32());   // battery divider off
  holdPin(PIN_LORA_NSS, true);      // a falling NSS would wake the radio
  holdPin(PIN_LORA_RST, true);
  gpio_deep_sleep_hold_en();
  if (flat && BAT_FLAT_RECHECK) esp_sleep_enable_timer_wakeup(BAT_RECHECK_MIN * 60ULL * 1000000ULL);
  esp_deep_sleep_start();
}

// Factory reset: erases the whole NVS partition (our settings and the Wi-Fi driver's stored network)
// and restarts, so the board comes up in setup mode like a new one.
static void factoryReset() {
  memset(fb, 0, sizeof fb);
  drawTextCenter(tr(S_FACTORY_RESET), 28);
  oledFlush();
  Serial.println("Factory reset: erasing all settings, restarting...");
  Serial.flush();
  if (netTaskHandle) vTaskSuspend(netTaskHandle);
  WiFi.disconnect(true);
  WiFi.mode(WIFI_OFF);
  prefs.end();
  esp_err_t err = nvs_flash_erase();
  if (err != ESP_OK) Serial.printf("Factory reset: erase failed (%s)\r\n", esp_err_to_name(err));
  Serial.flush();
  delay(800);
  ESP.restart();
}

// Measures the battery now and then. With BAT_AUTO_OFF a flat cell powers the board off.
static void batteryService(uint32_t now) {
  static uint32_t lastAt;
  static uint8_t lowCount;
  if (batteryMv && now - lastAt < BAT_CHECK_S * 1000UL) return;
  lastAt = now;
  batteryMv = readBatteryMv();
  if (!BAT_AUTO_OFF) return;
  lowCount = batteryPresent(batteryMv) && batteryMv < BAT_OFF_MV ? lowCount + 1 : 0;
  if (lowCount >= BAT_OFF_COUNT) powerOff(true, true);
}

// After a power off for a flat battery the timer wakes the board (BAT_FLAT_RECHECK): back to sleep unless it
// was charged.
static void batteryBootCheck() {
  if (!BAT_AUTO_OFF || !BAT_FLAT_RECHECK || esp_sleep_get_wakeup_cause() != ESP_SLEEP_WAKEUP_TIMER) return;
  uint16_t mv = readBatteryMv();
  if (batteryPresent(mv) && mv < BAT_ON_MV) powerOff(true, false);
}

// ============================ SERIAL CONSOLE ============================
// "setup" starts a wizard that asks for everything needed, step by step.
// The wizard does not block, the display keeps running meanwhile.

enum WizStep { WZ_OFF, WZ_LANG, WZ_SSID, WZ_PASS, WZ_CALL, WZ_LOC, WZ_TZ, WZ_SAVER_MIN, WZ_SAVER_MODE,
               WZ_WAKE_SPOT, WZ_WAKE_LED, WZ_NIGHT, WZ_NIGHT_MODE, WZ_CONFIRM };
static WizStep wiz = WZ_OFF;
static Config draft;
static char line[512];              // long enough for a URL-encoded "save" from the web installer
static uint16_t lineLen;
static bool lineFromPage;           // the last line came from the web installer (started with STX)

// Reads chars from the serial line; returns true when a whole line is complete.
// A line starting with STX (0x02) comes from the web installer: it is not echoed (it may hold a password).
static bool readLine(bool secret) {
  static bool lastCR, page;
  while (Serial.available()) {
    char c = Serial.read();
    if (c == '\n' && lastCR) { lastCR = false; continue; }   // CRLF = one Enter
    lastCR = c == '\r';
    if (c == 2 && !lineLen) {
      page = true;
      continue;
    }
    if (c == '\r' || c == '\n') {
      line[lineLen] = 0;
      lineLen = 0;
      if (!page) Serial.println();
      lineFromPage = page;
      page = false;
      return true;
    }
    if (c == 8 || c == 127) {                                // backspace
      if (lineLen) {
        lineLen--;
        if (!page) Serial.print("\b \b");
      }
    } else if (c >= 32 && lineLen < sizeof line - 1) {
      line[lineLen++] = c;
      if (!page) Serial.print(secret ? '*' : c);
    }
  }
  return false;
}

static void trim(char *s) {
  int n = strlen(s);
  while (n && isspace((unsigned char)s[n - 1])) s[--n] = 0;
  int i = 0;
  while (isspace((unsigned char)s[i])) i++;
  if (i) memmove(s, s + i, n - i + 1);
}

// The console is English only; the language applies to the display and web.
static void wizPrompt() {
  char codes[32];
  switch (wiz) {
    case WZ_LANG:
      langCodes(codes, sizeof codes);
      Serial.printf("Display language (%s) [%s]: ", codes, draft.lang);
      break;
    case WZ_SSID: Serial.printf("Wi-Fi network (SSID) [%s]: ", draft.ssid); break;
    case WZ_PASS:
      if (draft.pass[0]) Serial.print("Wi-Fi password [saved; Enter = keep, - = none]: ");
      else               Serial.print("Wi-Fi password [Enter = none]: ");
      break;
    case WZ_CALL: Serial.printf("Your callsign [%s]: ", draft.call); break;
    case WZ_LOC:  Serial.printf("Locator, 4 or 6 characters [%s]: ", draft.loc); break;
    case WZ_TZ:
      Serial.printf("Time zone: city or UTC offset, e.g. Prague, New York, UTC+3 ('list' = all) [%s]: ", draft.tz);
      break;
    case WZ_SAVER_MIN:
      Serial.printf("Screen saver after how many minutes of inactivity (0 = never) [%u]: ", draft.saverMin);
      break;
    case WZ_SAVER_MODE:
      Serial.printf("Screen saver (off = display off, life = Game of Life, dim = dim and shift) [%s]: ",
                    SAVER_CODE[draft.saverMode]);
      break;
    case WZ_WAKE_SPOT: Serial.printf("Wake the display on a new spot (y/n) [%s]: ", draft.wakeOnSpot ? "y" : "n"); break;
    case WZ_WAKE_LED: Serial.printf("Briefly flash the LED when a spot wakes the display (y/n) [%s]: ", draft.ledOnSpotWake ? "y" : "n"); break;
    case WZ_NIGHT:
      Serial.printf("Night hours, local time (e.g. 22-6; the same hour twice = no night) [%u-%u]: ", draft.nightFrom,
                    draft.nightTo);
      break;
    case WZ_NIGHT_MODE:
      Serial.printf("At night (button = only the button wakes the display, spots = spots too, dark = stays off) [%s]: ",
                    NIGHT_CODE[draft.nightMode]);
      break;
    case WZ_CONFIRM:
      Serial.println();
      Serial.printf("  Language:     %s\r\n", langInfo(cfgLang(draft)).nameAscii);
      Serial.printf("  Wi-Fi:        %s (%s)\r\n", draft.ssid, draft.pass[0] ? "with password" : "no password");
      Serial.printf("  Callsign:     %s\r\n", draft.call);
      Serial.printf("  Locator:      %s\r\n", draft.loc[0] ? draft.loc : "-");
      Serial.printf("  Time zone:    %s\r\n", draft.tz);
      if (draft.saverMin) Serial.printf("  Screen saver: %s after %u min, new spot %s\r\n", SAVER_CODE[draft.saverMode],
                                        draft.saverMin, draft.wakeOnSpot ? "wakes it" : "does not wake it");
      else                Serial.println("  Screen saver: never");
      Serial.printf("  Spot wake LED: %s\r\n", draft.ledOnSpotWake ? "on" : "off");
      if (draft.nightFrom != draft.nightTo)
        Serial.printf("  Night:        %u-%u, %s\r\n", draft.nightFrom, draft.nightTo, NIGHT_CODE[draft.nightMode]);
      else
        Serial.println("  Night:        none");
      Serial.print("Save and restart? (y/n): ");
      break;
    default: break;
  }
  // The answer goes on its own line: web consoles (the ESP Web Tools log) show a line only once
  // its newline arrives, so a prompt without one stayed hidden and users answered the previous one.
  if (wiz != WZ_OFF) Serial.println();
}

static void wizStart() {
  draft = cfg;
  wiz = WZ_LANG;
  quietLog = true;
  Serial.println();
  Serial.println("=== microHAMCLOCK setup ===");
  Serial.println("Enter = keep the value in brackets, 'cancel' = quit without saving.");
  wizPrompt();
}

static void wizEnd() {
  wiz = WZ_OFF;
  quietLog = false;
}

static void wizInput(char *in) {
  trim(in);
  if (!strcasecmp(in, "cancel") || !strcasecmp(in, "zrusit")) {
    Serial.println("Cancelled, nothing was saved.");
    wizEnd();
    return;
  }
  bool keep = !in[0], ok = true;
  switch (wiz) {
    case WZ_LANG:
      if (!keep) {
        Lang l;
        ok = langFromCode(in, l);
        if (ok) strlcpy(draft.lang, langInfo(l).code, sizeof draft.lang);
        else {
          char codes[32];
          langCodes(codes, sizeof codes);
          Serial.printf("Unknown language, choose one of: %s\r\n", codes);
        }
      }
      break;
    case WZ_SSID:
      if (!keep) strlcpy(draft.ssid, in, sizeof draft.ssid);
      ok = draft.ssid[0];
      if (!ok) Serial.println("Wi-Fi is required, enter the network name.");
      break;
    case WZ_PASS:
      if (!strcmp(in, "-")) {
        draft.pass[0] = 0;
      } else if (!keep) {
        ok = strlen(in) >= 8 && strlen(in) <= 63;           // WPA2 accepts no other length
        if (ok) strlcpy(draft.pass, in, sizeof draft.pass);
        else Serial.println("A Wi-Fi password has 8 to 63 characters.");
      }
      break;
    case WZ_CALL:
      if (!keep) strlcpy(draft.call, in, sizeof draft.call);
      ok = normalizeCall(draft.call);
      if (!ok) {
        Serial.println("A callsign has 3-11 characters: letters, digits and slash.");
        strlcpy(draft.call, cfg.call, sizeof draft.call);
      }
      break;
    case WZ_LOC:
      if (!keep) {
        if (strlen(in) < sizeof draft.loc) strlcpy(draft.loc, in, sizeof draft.loc);
        else ok = false;
      }
      ok = ok && normalizeLocator(draft.loc);
      if (!ok) {
        Serial.println("A locator looks like JO70 or JO70va.");
        strlcpy(draft.loc, cfg.loc, sizeof draft.loc);
      }
      break;
    case WZ_TZ:
      if (!keep) {
        if (!strcasecmp(in, "list")) {
          for (size_t i = 0; i < tzZoneCount(); i++) {
            char label[96];
            tzLabel(tzZone(i), label, sizeof label);
            Serial.printf("  %-22s %s\r\n", tzZone(i).id, label);
          }
          Serial.printf("  or a fixed offset UTC%+d ... UTC%+d (no daylight saving time)\r\n", TZ_FIXED_MIN, TZ_FIXED_MAX);
          ok = false;
          break;
        }
        char id[sizeof draft.tz];
        int found = tzSearch(in, id, sizeof id);
        if (found == 1) {
          strlcpy(draft.tz, id, sizeof draft.tz);
          Serial.printf("Time zone: %s\r\n", draft.tz);
        } else if (found > 1) {
          Serial.println("More time zones match, be more specific:");
          tzSearch(in, nullptr, 0, [](const char *zid, const char *cities) { Serial.printf("  %-22s %s\r\n", zid, cities); });
          ok = false;
        } else {
          Serial.println("Unknown time zone. Type a city, a UTC offset like UTC+3, or 'list'.");
          ok = false;
        }
      }
      break;
    case WZ_SAVER_MIN:
      if (!keep) {
        char *end;
        long m = strtol(in, &end, 10);
        ok = !*end && m >= 0 && m <= MAX_SAVER_MIN;
        if (ok) draft.saverMin = m;
        else Serial.printf("Enter 0 to %u minutes.\r\n", MAX_SAVER_MIN);
      }
      break;
    case WZ_SAVER_MODE:
      if (!keep) {
        int m = -1;
        for (int i = 0; i < SV_MODE_COUNT; i++) if (!strcasecmp(in, SAVER_CODE[i])) m = i;
        ok = m >= 0;
        if (ok) draft.saverMode = m;
        else Serial.println("Type off, life or dim.");
      }
      break;
    case WZ_WAKE_SPOT:
    case WZ_WAKE_LED:
      if (!keep) {
        char c = tolower((unsigned char)in[0]);
        ok = c == 'y' || c == 'a' || c == 'n';
        if (ok) {
          if (wiz == WZ_WAKE_SPOT) draft.wakeOnSpot = c != 'n';
          else draft.ledOnSpotWake = c != 'n';
        }
        else Serial.println("Type y or n.");
      }
      break;
    case WZ_NIGHT:
      if (!keep) {
        int from, to;
        char extra;
        ok = sscanf(in, "%d-%d%c", &from, &to, &extra) == 2 && from >= 0 && from < 24 && to >= 0 && to < 24;
        if (ok) {
          draft.nightFrom = from;
          draft.nightTo = to;
        } else {
          Serial.println("Type two hours 0-23, e.g. 22-6.");
        }
      }
      break;
    case WZ_NIGHT_MODE:
      if (!keep) {
        int m = -1;
        for (int i = 0; i < NM_MODE_COUNT; i++) if (!strcasecmp(in, NIGHT_CODE[i])) m = i;
        ok = m >= 0;
        if (ok) draft.nightMode = m;
        else Serial.println("Type button, spots or dark.");
      }
      break;
    case WZ_CONFIRM: {
      char c = tolower((unsigned char)in[0]);
      if (c == 'y' || c == 'a') {                          // "a" = Czech "ano" (yes), so old habits still work
        saveConfig(draft);
        Serial.println("Saved, restarting...");
        Serial.flush();
        delay(300);
        ESP.restart();
      } else if (c == 'n') {
        Serial.println("Nothing was saved.");
        wizEnd();
        return;
      }
      ok = false;
      break;
    }
    default: break;
  }
  if (ok) wiz = WizStep(wiz + 1);
  wizPrompt();
}

static void printStatus() {
  Serial.println();
  Serial.printf("microHAMCLOCK %s\r\n", FW_VERSION);
  Serial.printf("Callsign %s, locator %s, display language %s\r\n", cfg.call[0] ? cfg.call : "-",
                cfg.loc[0] ? cfg.loc : "-", langInfo(language()).nameAscii);
  Serial.printf("Time zone %s (%s)\r\n", cfg.tz, tzRule);
  if (cfg.rotate) Serial.printf("Screen rotation: on, every %u s, without spots %s\r\n", cfg.rotateSec,
                                cfg.rotateAll ? "all screens" : cfg.rotateMap ? "clock, propagation and map" : "clock and propagation only");
  else            Serial.println("Screen rotation: off");
  if (cfg.saverMin)
    Serial.printf("Screen saver: %s after %u min, new spot %s, now %s\r\n", SAVER_CODE[cfg.saverMode], cfg.saverMin,
                  cfg.wakeOnSpot ? "wakes it" : "does not wake it", asleep ? "on" : "off");
  else
    Serial.println("Screen saver: never");
  Serial.printf("Spot wake LED: %s\r\n", cfg.ledOnSpotWake ? "on" : "off");
  if (cfg.lifeOff) Serial.printf("Game of Life saver: display off after %u days\r\n", cfg.lifeDays);
  else             Serial.println("Game of Life saver: runs until woken");
  if (cfg.nightFrom != cfg.nightTo)
    Serial.printf("Night: %u-%u, %s, now %s\r\n", cfg.nightFrom, cfg.nightTo, NIGHT_CODE[cfg.nightMode],
                  isNight() ? "night" : "day");
  Serial.printf("Brightness: day %d %%, night %d %%, dim %d %%, life %d %%\r\n", contrastToPct(cfg.bright[BR_DAY]),
                contrastToPct(cfg.bright[BR_NIGHT]), contrastToPct(cfg.bright[BR_DIM]), contrastToPct(cfg.bright[BR_LIFE]));
  Serial.printf("NVIS: margin %u %% below foF2, 60 m %s\r\n", cfg.nvisMargin, cfg.nvis60 ? "on" : "off");
  Serial.printf("Country maps: Czechia %s, Germany %s, UK %s, USA %s\r\n", cfg.mapCz ? "on" : "off",
                cfg.mapDe ? "on" : "off", cfg.mapUk ? "on" : "off", cfg.mapUs ? "on" : "off");
  Serial.printf("Board: Heltec %s (%s)\r\n", boardName(), cfg.board == BD_AUTO ? "detected" : "set by hand");
  if (batteryPresent(batteryMv))
    Serial.printf("Battery: %u.%02u V, about %d %% (means little on USB or without a cell)\r\n", batteryMv / 1000,
                  batteryMv % 1000 / 10, batteryPercent(batteryMv));
  else
    Serial.printf("Battery: none (%u mV)\r\n", batteryMv);
  if (!cfg.ssid[0]) Serial.println("WiFi: not set up (command setup)");
  else if (wifiUp)  Serial.printf("WiFi: %s, IP %s, %d dBm\r\n", cfg.ssid, WiFi.localIP().toString().c_str(), WiFi.RSSI());
  else              Serial.printf("WiFi: connecting to %s\r\n", cfg.ssid);
  if (timeValid()) {
    time_t t = time(nullptr);
    struct tm u;
    gmtime_r(&t, &u);
    Serial.printf("Time: %02d:%02d:%02d UTC\r\n", u.tm_hour, u.tm_min, u.tm_sec);
  } else {
    Serial.println("Time: waiting for NTP");
  }
  lock();
  int n = spotCount;
  Solar s = solar;
  Iono io = iono;
  unlock();
  Serial.printf("MQTT: %s, spots in the last %d min: %d, received in total: %lu\r\n",
                mqttUp ? "connected" : "not connected", SPOT_WINDOW_MIN, n, (unsigned long)spotsTotal);
  uint32_t feedAt = feedLastSpot;
  if (!mqttUp)                 Serial.println("PSKReporter feed: unknown (MQTT not connected)");
  else if (!feedWatched)       Serial.println("PSKReporter feed: not watched (the broker refused the statistics)");
  else if (!feedAt)            Serial.println("PSKReporter feed: unknown (no statistics yet)");
  else if (!timeValid())       Serial.println("PSKReporter feed: unknown (waiting for NTP)");
  else {
    time_t t = feedAt;
    struct tm u;
    gmtime_r(&t, &u);
    uint32_t nowUnix = time(nullptr), ago = nowUnix > feedAt ? nowUnix - feedAt : 0;
    if (feedDown())
      Serial.printf("PSKReporter feed: DOWN at the provider, no spot since %02d:%02d:%02d UTC (%lu min ago)\r\n",
                    u.tm_hour, u.tm_min, u.tm_sec, (unsigned long)(ago / 60));
    else
      Serial.printf("PSKReporter feed: OK, last spot %lu s ago\r\n", (unsigned long)ago);
  }
  if (s.ok) Serial.printf("Propagation: SFI %s SN %s A %s K %s X %s\r\n", s.sfi, s.sn, s.a, s.k, s.xray);
  else      Serial.println("Propagation: no data yet");
  if (cfg.iono[0]) Serial.printf("Ionosonde choice: %s (set by hand)\r\n", cfg.iono);
  else             Serial.printf("Ionosonde choice: nearest with fresh data within %u km\r\n", IONO_MAX_KM);
  if (io.ok) {
    time_t t = io.measuredAt;
    struct tm u;
    gmtime_r(&t, &u);
    Serial.printf("Ionosonde %s (%s, %u km): foF2 %.1f MHz, MUF %.1f MHz, measured %02d:%02d UTC%s\r\n", io.code, io.name,
                  io.km, io.fof2, io.mufd, u.tm_hour, u.tm_min, ionoFresh(io) ? "" : " (too old, not shown)");
    const char *nvis = nvisBand(io);
    if (nvis) Serial.printf("Recommended NVIS band: %s m\r\n", nvis);
    else      Serial.println("Recommended NVIS band: none");
  } else {
    Serial.println("Ionosonde: no data yet");
  }
  Serial.printf("Running %lu min, free memory %u B\r\n", (unsigned long)(millis() / 60000), (unsigned)ESP.getFreeHeap());
}

// Display contents as 64 hex lines (MSB = left pixel); tools/snapshot.py turns it into an image.
static void printScreenshot() {
  Serial.println("SNAPSHOT");
  for (int y = 0; y < 64; y++) {
    for (int bx = 0; bx < 16; bx++) {
      uint8_t b = 0;
      for (int i = 0; i < 8; i++) b = b << 1 | ((fb[(y >> 3) * 128 + bx * 8 + i] >> (y & 7)) & 1);
      Serial.printf("%02X", b);
    }
    Serial.println();
  }
}

// ============================ SETUP MODE (HOTSPOT) ============================
// The board creates an open Wi-Fi MICROHAMCLOCK-xxxx and serves a form at http://4.3.2.1.
// Only an unconfigured board enters it by itself, otherwise only by holding the button.
// Nothing is erased: the form is prefilled and leaving without saving changes nothing.
// The mode is entered via a restart (NVS flag "portal"), so the normal network
// task does not run at all and Wi-Fi belongs to the hotspot alone.

// Hotspot address. Deliberately not a private 192.168.x.x: when a newer Android's check
// address resolves to a private IP, it marks the network "no internet" right away and does not
// even try the sign-in page (confirmed in the log: DNS queries came, the HTTP check never). The hotspot
// does not lead to the internet, so a public-looking address bothers nobody.
static const IPAddress PORTAL_IP(4, 3, 2, 1);

static bool portalMode;
static char apName[20];             // MICROHAMCLOCK-xxxx
static WebServer web(80);
struct Net { String ssid; int rssi; bool open; };
static const int MAX_NETS = 15;
static Net nets[MAX_NETS];          // networks found, for the form
static int netCount;
static bool scanRunning, scanStartFailed, restartPending;
static uint8_t scanTriesLeft;
static uint32_t scanStartedAt, portalSeenAt, restartAt;

static void restartSoon(uint32_t ms) {
  restartPending = true;
  restartAt = millis() + ms;
}

// Button hold in normal operation: restart straight into setup mode.
static void enterConfigMode() {
  prefs.putBool("portal", true);
  memset(fb, 0, sizeof fb);
  drawTextCenter(tr(S_SETUP), 14, 2);
  drawTextCenter(tr(S_STARTING_HOTSPOT), 40);
  oledFlush();
  Serial.println("Setup mode: restarting...");
  Serial.flush();
  delay(800);
  ESP.restart();
}

static String htmlEscape(const char *s) {
  String o;
  for (; *s; s++) {
    switch (*s) {
      case '&':  o += "&amp;"; break;
      case '<':  o += "&lt;"; break;
      case '>':  o += "&gt;"; break;
      case '"':  o += "&quot;"; break;
      case '\'': o += "&#39;"; break;
      default:   o += *s;
    }
  }
  return o;
}

// Text inside a single-quoted JavaScript string in an HTML attribute (onclick="…('…')").
static String jsQuote(const char *s) {
  String o;
  for (; *s; s++) {
    if (*s == '\\' || *s == '\'') o += '\\';
    if (*s == '"') o += "&quot;";
    else if (*s == '&') o += "&amp;";
    else o += *s;
  }
  return o;
}

// A JSON string, with the quotes and escapes.
static String jsonString(const char *s) {
  String o = "\"";
  for (; *s; s++) {
    if (*s == '"' || *s == '\\') o += '\\';
    if ((uint8_t)*s < 32) {
      char e[8];
      snprintf(e, sizeof e, "\\u%04x", *s);
      o += e;
    } else {
      o += *s;
    }
  }
  return o + '"';
}

static void scanBegin() {
  scanRunning = true;
  scanStartedAt = millis();
  // asynchronous, scanService() picks up the result
  scanStartFailed = WiFi.scanNetworks(true) == WIFI_SCAN_FAILED;
}

static void startScan() {
  if (scanRunning) return;
  scanTriesLeft = SCAN_RETRIES;
  scanBegin();
}

// Network list: each only once (the strongest), sorted by signal strength.
static void collectScan(int n) {
  int idx[MAX_NETS], count = 0;
  for (int i = 0; i < n; i++) {
    String s = WiFi.SSID(i);
    if (!s.length()) continue;
    bool dup = false;
    for (int j = 0; j < count && !dup; j++) dup = WiFi.SSID(idx[j]) == s;
    if (dup) continue;
    if (count < MAX_NETS) idx[count++] = i;
  }
  for (int i = 1; i < count; i++)
    for (int j = i; j > 0 && WiFi.RSSI(idx[j]) > WiFi.RSSI(idx[j - 1]); j--) std::swap(idx[j], idx[j - 1]);
  for (int i = 0; i < count; i++) {
    nets[i].ssid = WiFi.SSID(idx[i]);
    nets[i].rssi = WiFi.RSSI(idx[i]);
    nets[i].open = WiFi.encryptionType(idx[i]) == WIFI_AUTH_OPEN;
  }
  netCount = count;
  WiFi.scanDelete();
}

static const char PORTAL_STYLE[] PROGMEM =
  "body{font-family:system-ui,sans-serif;max-width:440px;margin:0 auto;padding:16px;background:#111;color:#eee}"
  "h1{font-size:1.5em;margin:0}p.v{margin:2px 0 16px;color:#999;font-size:.85em}"
  "label{display:block;margin:16px 0 4px;font-weight:600}label.chk{font-weight:400;margin-top:8px}"
  ".row{display:flex;gap:8px;align-items:center}.row select{flex:1}"
  "input[type=text],input[type=password],input[type=number],select{width:100%;box-sizing:border-box;padding:10px;font-size:1em;"
  "border-radius:6px;border:1px solid #555;background:#222;color:#eee}"
  ".net{display:block;padding:8px 10px;margin:4px 0;border-radius:6px;background:#222;color:#eee;text-decoration:none}"
  ".net small,small{color:#999}a{color:#7ab4ff}.err{background:#5a1d1d;padding:10px;border-radius:6px}"
  "button{margin-top:20px;width:100%;padding:12px;font-size:1em;border:0;border-radius:6px;background:#2b7de9;color:#fff}"
  "button.sec{background:#444;margin-top:10px}button.danger{background:#a33;margin-top:24px}"
  "details{margin-top:24px;border-top:1px solid #333;padding-top:8px}summary{cursor:pointer;font-weight:600;padding:8px 0}"
  "input[type=range]{width:100%}output{float:right;font-weight:400;color:#999}"
  ".sub{margin-left:28px}.off{opacity:.4;pointer-events:none}";

// Page in language lang (may differ from the stored one: the user is just choosing it).
static void sendPage(Lang lang, const String &body) {
  String h;
  h.reserve(body.length() + 1200);
  h += "<!doctype html><html lang=";
  h += langInfo(lang).code;
  h += F("><head><meta charset=utf-8><meta name=viewport content='width=device-width,initial-scale=1'><title>");
  h += tr(W_TITLE, lang);
  h += F("</title><style>");
  h += FPSTR(PORTAL_STYLE);
  h += F("</style></head><body><h1>microHAMCLOCK</h1><p class=v>");
  h += tr(W_VERSION, lang);
  h += ' ';
  h += FW_VERSION;
  h += "</p>";
  h += body;
  h += F("</body></html>");
  web.send(200, "text/html; charset=utf-8", h);
}

static void addOption(String &b, const char *value, const char *label, bool selected, const char *aliases = nullptr) {
  b += "<option value='";
  b += htmlEscape(value);
  b += "'";
  if (aliases) {
    b += " data-a='";
    b += value;
    b += ' ';
    b += aliases;
    b += "'";
  }
  if (selected) b += " selected";
  b += ">";
  b += htmlEscape(label);
  b += "</option>";
}

// v = values to show (the stored ones, or after an error what the user entered).
// autoTz = nobody has chosen a zone yet, it is preselected from the browser.
static void sendForm(Lang lang, const char *error, const Config &v, bool autoTz) {
  String b;
  b.reserve(9000 + netCount * 120);
  if (error && *error) b += "<p class=err>" + htmlEscape(error) + "</p>";
  b += "<form method=post action=/save><label for=lang>";
  b += tr(W_LANGUAGE, lang);
  // Changing the language reloads the page in it right away (that's why it comes first, nothing is lost).
  b += F("</label><select id=lang name=lang onchange=\"location='/?lang='+this.value\">");
  for (int l = 0; l < LANG_COUNT; l++)
    addOption(b, langInfo(Lang(l)).code, langInfo(Lang(l)).nameNative, l == lang);
  b += "</select><label for=ssid>";
  b += tr(W_WIFI, lang);
  b += "</label><input type=text id=ssid name=ssid maxlength=32 required value='" + htmlEscape(v.ssid) + "'>";
  // The script redraws the list and the line under it when a scan finishes (see handleNets).
  b += "<div id=nets data-open='" + htmlEscape(tr(W_NET_OPEN, lang)) + "'>";
  for (int i = 0; i < netCount; i++) {
    String name = htmlEscape(nets[i].ssid.c_str());
    b += "<a href='#' class=net data-s='" + name + "'>" + name + " <small>" + nets[i].rssi + " dBm";
    if (nets[i].open) b += tr(W_NET_OPEN, lang);
    b += "</small></a>";
  }
  b += "</div><small id=scanning";
  if (!scanRunning) b += " hidden";
  b += ">";
  b += tr(W_SCANNING, lang);
  b += "</small><small id=scandone";
  if (scanRunning) b += " hidden";
  b += "><span id=nonets";
  if (netCount) b += " hidden";
  b += ">";
  b += tr(W_NO_NETS, lang);
  b += " </span><a id=rescan href='/?scan=1&lang=";
  b += langInfo(lang).code;
  b += "'>";
  b += tr(W_RESCAN, lang);
  b += "</a></small>";
  b += "<label for=pass>";
  b += tr(W_PASS, lang);
  b += "</label><input type=password id=pass name=pass maxlength=63";
  if (cfg.pass[0]) b += " placeholder='" + htmlEscape(tr(W_PASS_KEEP, lang)) + "'";
  b += "><label class=chk><input type=checkbox name=open value=1> ";
  b += tr(W_OPEN_NET, lang);
  b += "</label><label for=call>";
  b += tr(W_CALL, lang);
  b += "</label><input type=text id=call name=call maxlength=11 required autocapitalize=characters value='" +
       htmlEscape(v.call) + "'><small>";
  b += tr(W_CALL_HINT, lang);
  b += "</small><label for=loc>";
  b += tr(W_LOC, lang);
  b += "</label><input type=text id=loc name=loc maxlength=6 required placeholder='JO70va' value='" + htmlEscape(v.loc) +
       "'>";

  // time zone: regions by city, then fixed offsets
  b += "<label for=tz>";
  b += tr(W_TZ, lang);
  b += "</label><select id=tz name=tz";
  if (autoTz) b += " data-auto=1";
  b += "><optgroup label='UTC'>";
  char label[96];
  for (size_t i = 0; i < tzZoneCount(); i++) {
    const TzZone &z = tzZone(i);
    tzLabel(z, label, sizeof label);
    addOption(b, z.id, label, !strcmp(v.tz, z.id), z.aliases);
  }
  b += "</optgroup><optgroup label='";
  b += htmlEscape(tr(W_TZ_FIXED, lang));
  b += "'>";
  for (int h = TZ_FIXED_MIN; h <= TZ_FIXED_MAX; h++) {
    char id[8];
    if (h) snprintf(id, sizeof id, "UTC%+d", h);
    else   strcpy(id, "UTC");
    if (!h) continue;                 // UTC is already among the regions
    addOption(b, id, id, !strcmp(v.tz, id));
  }
  b += "</optgroup></select><small>";
  b += tr(W_TZ_HINT, lang);
  b += "</small>";

  // automatic screen rotation (the interval is in Advanced)
  b += "<label class=chk><input type=checkbox name=rotate value=1";
  if (v.rotate) b += " checked";
  b += "> ";
  b += tr(W_ROTATE, lang);
  b += "</label>";

  // screen saver
  b += "<label for=svmin>";
  b += tr(W_SAVER, lang);
  b += "</label><input type=number id=svmin name=svmin min=0 max=";
  b += (int)MAX_SAVER_MIN;
  b += " value=";
  b += (int)v.saverMin;
  b += "><label for=svmode>";
  b += tr(W_SAVER_MODE, lang);
  b += "</label><select id=svmode name=svmode>";
  static const StrId SAVER_TEXT[SV_MODE_COUNT] = {W_SAVER_OFF, W_SAVER_LIFE, W_SAVER_DIM};
  for (int m = 0; m < SV_MODE_COUNT; m++) addOption(b, SAVER_CODE[m], tr(SAVER_TEXT[m], lang), m == v.saverMode);
  b += "</select><label class=chk><input type=checkbox id=svspot name=svspot value=1";
  if (v.wakeOnSpot) b += " checked";
  b += "> ";
  b += tr(W_SAVER_SPOT, lang);
  // LED depends on spot wake-up: indented, greyed out without it (the value is still sent and saved though)
  b += "</label><label class='chk sub' id=svledl><input type=checkbox name=svled value=1";
  if (v.ledOnSpotWake) b += " checked";
  b += "> ";
  b += tr(W_SAVER_LED, lang);
  b += "</label>";

  // night
  b += "<label>";
  b += tr(W_NIGHT, lang);
  b += "</label><div class=row>";
  const char *names[2] = {"nfrom", "nto"};
  const StrId words[2] = {W_NIGHT_FROM, W_NIGHT_TO};
  const uint8_t values[2] = {v.nightFrom, v.nightTo};
  for (int k = 0; k < 2; k++) {
    b += "<span>";
    b += tr(words[k], lang);
    b += "</span><select name=";
    b += names[k];
    b += ">";
    for (int h = 0; h < 24; h++) {
      char hh[4];
      snprintf(hh, sizeof hh, "%d", h);
      char lbl[8];
      snprintf(lbl, sizeof lbl, "%02d:00", h);
      addOption(b, hh, lbl, h == values[k]);
    }
    b += "</select>";
  }
  b += "</div><small>";
  b += tr(W_NIGHT_HINT, lang);
  b += "</small><label for=nmode>";
  b += tr(W_NIGHT_MODE, lang);
  b += "</label><select id=nmode name=nmode>";
  static const StrId NIGHT_TEXT[NM_MODE_COUNT] = {W_NIGHT_BUTTON, W_NIGHT_SPOTS, W_NIGHT_DARK};
  for (int m = 0; m < NM_MODE_COUNT; m++) addOption(b, NIGHT_CODE[m], tr(NIGHT_TEXT[m], lang), m == v.nightMode);
  b += "</select>";

  // advanced: display brightness; collapsed while everything is at defaults
  bool custom = memcmp(v.bright, BRIGHT_DEFAULT, sizeof BRIGHT_DEFAULT) != 0 || v.nvisMargin || !v.nvis60 || v.iono[0] ||
                v.rotateSec != DEFAULT_ROTATE_S || v.rotateAll || !v.rotateMap || v.lifeOff || v.lifeDays != DEFAULT_LIFE_DAYS || v.mapCz || v.mapDe ||
                v.mapUk || v.mapUs || v.board != BD_AUTO;
  b += custom ? "<details open><summary>" : "<details><summary>";
  b += tr(W_ADVANCED, lang);
  b += "</summary><label for=rotsec>";
  b += tr(W_ROTATE_SEC, lang);
  b += "</label><input type=number id=rotsec name=rotsec min=";
  b += (int)MIN_ROTATE_S;
  b += " max=";
  b += (int)MAX_ROTATE_S;
  b += " value=";
  b += (int)v.rotateSec;
  b += "><label class=chk><input type=checkbox id=rotall name=rotall value=1";
  if (v.rotateAll) b += " checked";
  b += "> ";
  b += tr(W_ROTATE_ALL, lang);
  b += "</label><label class=chk id=rotmapl><input type=checkbox name=rotmap value=1";
  if (v.rotateMap) b += " checked";
  b += "> ";
  b += tr(W_ROTATE_MAP, lang);
  b += "</label><b>";
  b += tr(W_BRIGHT, lang);
  b += "</b>";
  static const StrId BRIGHT_TEXT[BR_COUNT] = {W_BRIGHT_DAY, W_BRIGHT_NIGHT, W_BRIGHT_DIM, W_BRIGHT_LIFE};
  for (int i = 0; i < BR_COUNT; i++) {
    int pct = contrastToPct(v.bright[i]);
    b += "<label for=";
    b += BRIGHT_KEY[i];
    b += ">";
    b += tr(BRIGHT_TEXT[i], lang);
    b += " <output>";
    b += pct;
    b += " %</output></label><input type=range class=br min=1 max=100 id=";
    b += BRIGHT_KEY[i];
    b += " name=";
    b += BRIGHT_KEY[i];
    b += " value=";
    b += pct;
    b += ">";
  }
  b += "<small>";
  b += tr(W_BRIGHT_HINT, lang);
  // Game of Life saver: display off after some days; the days are greyed out while unticked (but still sent)
  b += "</small><label class=chk><input type=checkbox id=lfoff name=lfoff value=1";
  if (v.lifeOff) b += " checked";
  b += "> ";
  b += tr(W_LIFE_OFF, lang);
  b += "</label><div class=sub id=lfd><label for=lfdays>";
  b += tr(W_LIFE_DAYS, lang);
  b += "</label><input type=number id=lfdays name=lfdays min=1 max=";
  b += (int)MAX_LIFE_DAYS;
  b += " value=";
  b += (int)v.lifeDays;
  b += "></div><small>";
  b += tr(W_LIFE_HINT, lang);
  b += "</small><label for=nvismg>";
  b += tr(W_NVIS_MARGIN, lang);
  b += "</label><input type=number id=nvismg name=nvismg min=0 max=";
  b += (int)MAX_NVIS_MARGIN;
  b += " value=";
  b += (int)v.nvisMargin;
  b += "><label class=chk><input type=checkbox name=nvis60 value=1";
  if (v.nvis60) b += " checked";
  b += "> ";
  b += tr(W_NVIS_60, lang);
  b += "</label><small>";
  b += tr(W_NVIS_HINT, lang);
  b += "</small><label for=iono>";
  b += tr(W_IONO, lang);
  b += "</label><input type=text id=iono name=iono maxlength=7 autocapitalize=characters placeholder='";
  b += htmlEscape(tr(W_IONO_AUTO, lang));
  b += "' value='" + htmlEscape(v.iono) + "'><small>";
  b += tr(W_IONO_HINT, lang);
  b += "</small><b>";               // country map views, offered by the long press on the map
  b += tr(W_MAPS, lang);
  b += "</b>";
  auto mapBox = [&](const char *name, bool on, StrId text) {
    b += "<label class=chk><input type=checkbox name=";
    b += name;
    b += " value=1";
    if (on) b += " checked";
    b += "> ";
    b += tr(text, lang);
    b += "</label>";
  };
  mapBox("mapcz", v.mapCz, W_MAP_CZ);
  mapBox("mapde", v.mapDe, W_MAP_DE);
  mapBox("mapuk", v.mapUk, W_MAP_UK);
  mapBox("mapus", v.mapUs, W_MAP_US);
  b += "<small>";
  b += tr(W_MAPS_HINT, lang);
  b += "</small><label for=board>";
  b += tr(W_BOARD, lang);
  b += "</label><select id=board name=board>";
  for (int r = 0; r < BD_COUNT; r++) {
    String label = r == BD_AUTO ? String(tr(W_BOARD_AUTO, lang)) + " (" + BOARD_NAME[boardV32Detected ? BD_V32 : BD_V31] + ")"
                                : String(BOARD_NAME[r]);
    addOption(b, BOARD_CODE[r], label.c_str(), r == v.board);
  }
  b += "</select><small>";
  b += tr(W_BOARD_HINT, lang);
  b += "</small><button type=submit class=danger formaction=/factory formnovalidate onclick=\"return confirm('";
  b += jsQuote(tr(W_FACTORY_ASK, lang));
  b += "')\">";
  b += tr(W_FACTORY, lang);
  b += "</button><small>";
  b += tr(W_FACTORY_HINT, lang);
  b += "</small></details>";

  b += "<button type=submit>";
  b += tr(W_SAVE, lang);
  b += "</button></form>";
  if (configured()) {
    b += "<form method=post action=/cancel><input type=hidden name=lang value=";
    b += langInfo(lang).code;
    b += "><button class=sec>";
    b += tr(W_LEAVE, lang);
    b += "</button></form>";
  }
  b += F("<script>"
         // networks: a click fills in the name; the list fills in by itself when the scan finishes
         "(function(){var L=document.getElementById('nets');function g(i){return document.getElementById(i)}"
         "function show(busy,none){g('scanning').hidden=!busy;g('scandone').hidden=busy;g('nonets').hidden=!none}"
         "L.onclick=function(e){var a=e.target.closest('.net');if(!a)return;e.preventDefault();"
         "g('ssid').value=a.dataset.s;g('pass').focus()};"
         "function poll(q){fetch('/nets'+q).then(function(r){return r.json()}).then(function(d){"
         "if(!d.scanning){L.textContent='';d.nets.forEach(function(n){var a=document.createElement('a'),"
         "m=document.createElement('small');a.href='#';a.className='net';a.dataset.s=n.s;a.textContent=n.s+' ';"
         "m.textContent=n.r+' dBm'+(n.o?L.dataset.open:'');a.appendChild(m);L.appendChild(a)})}"
         "show(d.scanning,!d.scanning&&!d.nets.length);if(d.scanning)setTimeout(poll,1500,'')"
         "}).catch(function(){setTimeout(poll,3000,'')})}"
         "g('rescan').onclick=function(){show(true,false);poll('?scan=1');return false};"
         "if(!g('scanning').hidden)setTimeout(poll,1500,'')})();"
         // zone from the browser: IANA name (or alias), otherwise a whole-hour offset
         "(function(){var s=document.getElementById('tz');if(!s.dataset.auto)return;try{"
         "var z=Intl.DateTimeFormat().resolvedOptions().timeZone,i,o;"
         "for(i=0;i<s.options.length;i++){o=s.options[i];"
         "if((' '+(o.dataset.a||'')+' ').indexOf(' '+z+' ')>=0){s.selectedIndex=i;return}}"
         "var h=-new Date().getTimezoneOffset()/60;if(h!=Math.round(h))return;"
         "var v=h?'UTC'+(h>0?'+':'')+h:'Etc/UTC';"
         "for(i=0;i<s.options.length;i++)if(s.options[i].value==v){s.selectedIndex=i;return}"
         "}catch(e){}})();"
         // LED on spot wake-up only makes sense with spot wake-up enabled
         "(function(){var w=document.getElementById('svspot'),l=document.getElementById('svledl');"
         "function u(){l.classList.toggle('off',!w.checked)}w.onchange=u;u()})();"
         // the map option has no effect while all screens rotate without spots anyway
         "(function(){var w=document.getElementById('rotall'),l=document.getElementById('rotmapl');"
         "function u(){l.classList.toggle('off',w.checked)}w.onchange=u;u()})();"
         "(function(){var w=document.getElementById('lfoff'),l=document.getElementById('lfd');"
         "function u(){l.classList.toggle('off',!w.checked)}w.onchange=u;u()})();"
         // brightness: number next to the slider and preview on the display (at most one request per 150 ms)
         "document.querySelectorAll('.br').forEach(function(r){var t;r.oninput=function(){"
         "r.previousElementSibling.querySelector('output').textContent=r.value+' %';clearTimeout(t);"
         "t=setTimeout(function(){fetch('/bright?v='+r.value)},150)}})</script>");
  sendPage(lang, b);
}

// Page language: from the lang parameter, otherwise the stored one.
static Lang requestLang() {
  Lang l;
  return langFromCode(web.arg("lang").c_str(), l) ? l : cfgLang(cfg);
}

// Preselect the zone from the browser until someone has chosen it.
static bool tzNeverChosen() { return !configured() || !prefs.isKey("tzid"); }

static void handleRoot() {
  portalSeenAt = millis();
  if (web.hasArg("scan")) startScan();
  sendForm(requestLang(), nullptr, cfg, tzNeverChosen());
}

// Network list for the form's script: {"scanning":…,"nets":[{"s":ssid,"r":rssi,"o":open},…]}.
// ?scan=1 starts a new scan first.
static void handleNets() {
  portalSeenAt = millis();
  if (web.hasArg("scan")) startScan();
  String j;
  j.reserve(40 + netCount * 60);
  j += scanRunning ? "{\"scanning\":true,\"nets\":[" : "{\"scanning\":false,\"nets\":[";
  for (int i = 0; i < netCount; i++) {
    if (i) j += ',';
    j += "{\"s\":" + jsonString(nets[i].ssid.c_str()) + ",\"r\":" + nets[i].rssi + ",\"o\":" +
         (nets[i].open ? "true}" : "false}");
  }
  j += "]}";
  web.sendHeader("Cache-Control", "no-store");
  web.send(200, "application/json", j);
}

static int codeIndex(const String &code, const char *const *codes, int n) {
  for (int i = 0; i < n; i++)
    if (code == codes[i]) return i;
  return -1;
}

// Basic settings, shared by the hotspot form and the web installer. Copies the values into d
// (also wrong ones, so they need not be retyped after an error) and returns an error text ID,
// or -1 when all is fine; then d also holds the password and the normalized callsign and locator.
static int checkBasic(Config &d, String ssid, const String &pass, bool open, String call, String loc,
                      const String &tz) {
  ssid.trim();
  call.trim();
  loc.trim();
  strlcpy(d.ssid, ssid.c_str(), sizeof d.ssid);
  strlcpy(d.call, call.c_str(), sizeof d.call);
  strlcpy(d.loc, loc.c_str(), sizeof d.loc);
  char tzId[sizeof d.tz];
  bool tzOk = tzPosix(tz.c_str(), tzId, sizeof tzId);
  if (tzOk) strlcpy(d.tz, tzId, sizeof d.tz);
  char callBuf[16], locBuf[8];
  strlcpy(callBuf, call.c_str(), sizeof callBuf);
  strlcpy(locBuf, loc.c_str(), sizeof locBuf);
  if (!ssid.length() || ssid.length() > 32) return W_ERR_SSID;
  if (!open && pass.length() && (pass.length() < 8 || pass.length() > 63)) return W_ERR_PASS_LEN;
  if (!open && !pass.length() && ssid != cfg.ssid) return W_ERR_PASS_NEW;
  if (call.length() > 11 || !normalizeCall(callBuf)) return W_ERR_CALL;
  if (loc.length() > 6 || !normalizeLocator(locBuf)) return W_ERR_LOC;
  if (!tzOk) return W_ERR_TZ;
  if (open) d.pass[0] = 0;
  else if (pass.length()) strlcpy(d.pass, pass.c_str(), sizeof d.pass);
  strlcpy(d.call, callBuf, sizeof d.call);
  strlcpy(d.loc, locBuf, sizeof d.loc);
  return -1;
}

static void handleSave() {
  portalSeenAt = millis();
  Lang lang = requestLang();
  String svmin = web.arg("svmin");
  svmin.trim();

  // d = what the user entered (even if wrong, so it need not be retyped after an error)
  Config d = cfg;
  strlcpy(d.lang, langInfo(lang).code, sizeof d.lang);
  long minutes = svmin.toInt();
  bool minOk = svmin.length() && svmin.length() <= 3 && minutes >= 0 && minutes <= MAX_SAVER_MIN;
  for (size_t i = 0; i < svmin.length(); i++) minOk &= isdigit((unsigned char)svmin[i]) != 0;
  if (minOk) d.saverMin = minutes;
  int mode = codeIndex(web.arg("svmode"), SAVER_CODE, SV_MODE_COUNT);
  if (mode >= 0) d.saverMode = mode;
  d.wakeOnSpot = web.hasArg("svspot");
  d.ledOnSpotWake = web.hasArg("svled");
  d.lifeOff = web.hasArg("lfoff");
  String lfdays = web.arg("lfdays");
  lfdays.trim();
  long days = lfdays.toInt();
  bool daysOk = lfdays.length() && days >= 1 && days <= MAX_LIFE_DAYS;
  if (daysOk) d.lifeDays = days;
  if (!d.lifeOff) daysOk = true;      // ignored while unticked, the stored number stays
  d.rotate = web.hasArg("rotate");
  long rotsec = web.arg("rotsec").toInt();
  if (rotsec >= MIN_ROTATE_S && rotsec <= MAX_ROTATE_S) d.rotateSec = rotsec;
  d.rotateAll = web.hasArg("rotall");
  d.rotateMap = web.hasArg("rotmap");
  long nf = web.arg("nfrom").toInt(), nt = web.arg("nto").toInt();
  if (nf >= 0 && nf < 24) d.nightFrom = nf;
  if (nt >= 0 && nt < 24) d.nightTo = nt;
  int nmode = codeIndex(web.arg("nmode"), NIGHT_CODE, NM_MODE_COUNT);
  if (nmode >= 0) d.nightMode = nmode;
  for (int i = 0; i < BR_COUNT; i++) {
    long pct = web.arg(BRIGHT_KEY[i]).toInt();
    if (pct >= 1 && pct <= 100) d.bright[i] = pctToContrast(pct);
  }
  String nvismg = web.arg("nvismg");
  nvismg.trim();
  long margin = nvismg.toInt();
  if (nvismg.length() && margin >= 0 && margin <= MAX_NVIS_MARGIN) d.nvisMargin = margin;
  d.nvis60 = web.hasArg("nvis60");
  String ionoArg = web.arg("iono");   // GIRO ionosonde code: letters, digits, underscore (e.g. NI63_)
  ionoArg.trim();
  ionoArg.toUpperCase();
  bool ionoOk = ionoArg.length() < sizeof d.iono;
  for (size_t i = 0; i < ionoArg.length(); i++) ionoOk &= isalnum((unsigned char)ionoArg[i]) || ionoArg[i] == '_';
  strlcpy(d.iono, ionoArg.c_str(), sizeof d.iono);
  d.mapCz = web.hasArg("mapcz");
  d.mapDe = web.hasArg("mapde");
  d.mapUs = web.hasArg("mapus");
  d.mapUk = web.hasArg("mapuk");
  int board = codeIndex(web.arg("board"), BOARD_CODE, BD_COUNT);
  if (board >= 0) d.board = board;

  int err = checkBasic(d, web.arg("ssid"), web.arg("pass"), web.hasArg("open"), web.arg("call"), web.arg("loc"),
                       web.arg("tz"));
  if (err < 0) err = !minOk ? W_ERR_SAVER : !daysOk ? W_ERR_LIFE_DAYS : !ionoOk ? W_ERR_IONO : -1;
  if (err >= 0) {
    sendForm(lang, tr(StrId(err), lang), d, false);
    return;
  }
  saveConfig(d);
  Serial.printf("Hotspot: saved (%s, %s, %s, %s, %s), restarting\r\n", d.ssid, d.call, d.loc, d.lang, d.tz);
  char msg[400];
  snprintf(msg, sizeof msg, tr(W_SAVED, lang), htmlEscape(d.ssid).c_str());
  sendPage(lang, String("<p>") + msg + "</p>");
  restartSoon(1500);
}

// Brightness preview: the display briefly shows the slider's brightness, nothing is saved.
static uint8_t previewContrast;
static uint32_t previewUntil;

static void handleBright() {
  portalSeenAt = millis();
  long pct = web.arg("v").toInt();
  if (pct >= 1 && pct <= 100) {
    previewContrast = pctToContrast(pct);
    previewUntil = millis() + BRIGHT_PREVIEW_MS;
  }
  web.send(204);
}

static bool factoryPending;         // the restart after the reply erases the settings first

static void handleFactory() {
  Lang lang = requestLang();
  sendPage(lang, String("<p>") + tr(W_FACTORY_DONE, lang) + "</p>");
  Serial.println("Hotspot: factory reset");
  factoryPending = true;
  restartSoon(1500);
}

static void handleCancel() {
  Lang lang = requestLang();
  sendPage(lang, String("<p>") + tr(W_NOCHANGE, lang) + "</p>");
  Serial.println("Hotspot: no changes, restarting");
  restartSoon(1500);
}

// Phones probe various addresses after connecting (generate_204, hotspot-detect…);
// a redirect to the form tells them it's a sign-in page, and they open it themselves.
static void handleOther() {
  web.sendHeader("Location", "http://" + PORTAL_IP.toString() + "/", true);
  web.send(302, "text/plain", "");
}

// ---- custom DNS: answers every name with the hotspot address ----
// Type A (IPv4) queries get the hotspot address, others (mainly AAAA) an empty
// answer without error. Unlike the DNSServer library it also handles queries with EDNS.

static WiFiUDP dnsUdp;

static void dnsService() {
  int len = dnsUdp.parsePacket();
  if (len <= 0) return;
  uint8_t q[512], r[512 + 16];
  if (len > (int)sizeof q || len < 12) {
    dnsUdp.flush();
    return;
  }
  dnsUdp.read(q, len);
  if ((q[2] & 0x80) || (q[4] << 8 | q[5]) != 1) return;   // only queries with a single question

  char name[64];
  int p = 12, n = 0;
  while (p < len && q[p]) {
    int l = q[p++];
    if ((l & 0xC0) || p + l > len) return;
    for (int i = 0; i < l; i++, p++) if (n < (int)sizeof name - 2) name[n++] = q[p];
    name[n++] = '.';
  }
  if (n) n--;
  name[n] = 0;
  p++;                                                     // null terminator of the name
  if (p + 4 > len) return;
  uint16_t qtype = q[p] << 8 | q[p + 1];
  p += 4;                                                  // type and class

  memcpy(r, q, p);                                         // header and question copied back
  r[2] = 0x84 | (q[2] & 0x01);                             // response, authoritative, RD as in the query
  r[3] = 0x80;                                             // RA, no error
  r[6] = r[7] = r[8] = r[9] = r[10] = r[11] = 0;
  int out = p;
  if (qtype == 1 || qtype == 255) {                        // A or ANY
    static const uint8_t ans[] = {0xC0, 0x0C, 0, 1, 0, 1, 0, 0, 0, 10, 0, 4};   // TTL 10 s
    memcpy(r + out, ans, sizeof ans);
    out += sizeof ans;
    IPAddress ip = WiFi.softAPIP();
    for (int i = 0; i < 4; i++) r[out++] = ip[i];
    r[7] = 1;
  }
  dnsUdp.beginPacket(dnsUdp.remoteIP(), dnsUdp.remotePort());
  dnsUdp.write(r, out);
  dnsUdp.endPacket();
}

// Catches all other paths. With onNotFound the core would log an error to the console for each one.
class CatchAll : public RequestHandler {
  bool canHandle(HTTPMethod, String) override { return true; }
  bool handle(WebServer &, HTTPMethod, String) override {
    handleOther();
    return true;
  }
};

static void portalStart() {
  WiFi.onEvent([](WiFiEvent_t, WiFiEventInfo_t) { Serial.println("Hotspot: a device connected"); },
               ARDUINO_EVENT_WIFI_AP_STACONNECTED);
  WiFi.onEvent([](WiFiEvent_t, WiFiEventInfo_t info) {
    Serial.printf("Hotspot: DHCP assigned %s\r\n", IPAddress(info.wifi_ap_staipassigned.ip.addr).toString().c_str());
  }, ARDUINO_EVENT_WIFI_AP_STAIPASSIGNED);
  WiFi.mode(WIFI_AP_STA);           // STA part only for scanning networks
  uint8_t mac[6];
  WiFi.macAddress(mac);             // only after Wi-Fi is on, otherwise it returns zeros
  snprintf(apName, sizeof apName, "MICROHAMCLOCK-%02X%02X", mac[4], mac[5]);
  WiFi.softAPConfig(PORTAL_IP, PORTAL_IP, IPAddress(255, 255, 255, 0));
  WiFi.softAP(apName);              // open network, runs only during setup

  // Arduino core 2.x does not let DHCP send the DNS server address. The phone then never
  // asks our DNS, does not detect the sign-in page and does not open it by itself.
  esp_netif_t *ap = esp_netif_get_handle_from_ifkey("WIFI_AP_DEF");
  if (ap) {
    esp_netif_dhcps_stop(ap);
    esp_netif_dns_info_t dnsInfo = {};
    dnsInfo.ip.type = ESP_IPADDR_TYPE_V4;
    dnsInfo.ip.u_addr.ip4.addr = static_cast<uint32_t>(WiFi.softAPIP());
    esp_netif_set_dns_info(ap, ESP_NETIF_DNS_MAIN, &dnsInfo);
    dhcps_offer_t offer = OFFER_DNS;
    esp_netif_dhcps_option(ap, ESP_NETIF_OP_SET, ESP_NETIF_DOMAIN_NAME_SERVER, &offer, sizeof offer);
    esp_netif_dhcps_start(ap);
  }
  dnsUdp.begin(53);
  web.on("/", HTTP_GET, handleRoot);
  web.on("/save", HTTP_POST, handleSave);
  web.on("/cancel", HTTP_POST, handleCancel);
  web.on("/factory", HTTP_POST, handleFactory);
  web.on("/bright", HTTP_GET, handleBright);
  web.on("/nets", HTTP_GET, handleNets);
  web.addHandler(new CatchAll());   // after the other paths, redirects everything left
  web.begin();
  startScan();
  portalSeenAt = millis();
  Serial.printf("Setup mode: join Wi-Fi %s (no password) and open http://%s\r\n", apName,
                PORTAL_IP.toString().c_str());
  Serial.println("Or type setup here in the console.");
}

// Picks up the result of startScan(). The core reports a failure after 6 s (300 ms per channel
// × 20), but with the hotspot on the radio keeps returning to its channel and the scan takes
// about 8 s and then finishes fine, so we wait for the result ourselves. An empty or failed
// scan (often the first one after the hotspot starts) is repeated.
static void scanService() {
  if (!scanRunning) return;
  int n = WiFi.scanComplete();
  if (n < 0 && !scanStartFailed) {
    if (millis() - scanStartedAt < SCAN_TIMEOUT_MS) return;
    esp_wifi_scan_stop();
  }
  if (n <= 0 && scanTriesLeft) {
    scanTriesLeft--;
    Serial.println("WiFi scan: nothing found, trying again");
    scanBegin();
    return;
  }
  collectScan(n > 0 ? n : 0);
  scanRunning = false;
}

static void portalService() {
  dnsService();
  web.handleClient();
  scanService();
  uint32_t now = millis();
  if (WiFi.softAPgetStationNum() > 0) portalSeenAt = now;
  // A configured board returns by itself after a while (e.g. when the hotspot was started by mistake).
  if (configured() && wiz == WZ_OFF && now - portalSeenAt > PORTAL_IDLE_MIN * 60000UL) {
    Serial.println("Hotspot: nobody connected, returning to normal operation");
    restartSoon(0);
  }
}

// ============================ USB SETUP (WEB INSTALLER) ============================
// The web installer page sets the basics over Web Serial. Its commands are lines starting with
// STX (0x02), which are not echoed; every reply is one line starting with "HC ":
//   info             → HC info {version, settings without the password, languages, time zones}
//   scan             → HC scan [{ssid, rssi, open}, …] once the Wi-Fi scan is done
//   save k=v&k=v…    → HC ok and a restart, or HC error {field, msg}
// "save" takes lang, ssid, pass, open, call, loc and tz, URL-encoded (encodeURIComponent).
// Without pass the stored password stays; open=1 means a network without a password.

static bool usbScanWanted;

static void jsonPrint(const char *s) { Serial.print(jsonString(s)); }

// Value of key in "k=v&k=v", URL-decoded; found says whether the key was there at all.
static String urlValue(const char *q, const char *key, bool *found = nullptr) {
  size_t kn = strlen(key);
  if (found) *found = false;
  for (const char *p = q; *p;) {
    const char *end = strchr(p, '&');
    if (!end) end = p + strlen(p);
    if (!strncmp(p, key, kn) && p[kn] == '=') {
      if (found) *found = true;
      String v;
      for (const char *c = p + kn + 1; c < end; c++) {
        if (*c == '%' && c + 2 < end && isxdigit((unsigned char)c[1]) && isxdigit((unsigned char)c[2])) {
          char hex[3] = {c[1], c[2], 0};
          v += (char)strtol(hex, nullptr, 16);
          c += 2;
        } else {
          v += *c;
        }
      }
      return v;
    }
    p = *end ? end + 1 : end;
  }
  return String();
}

static void usbInfo() {
  Serial.print("HC info {\"version\":");
  jsonPrint(FW_VERSION);
  Serial.printf(",\"configured\":%s,\"setupMode\":%s,\"lang\":", configured() ? "true" : "false",
                portalMode ? "true" : "false");
  jsonPrint(cfg.lang);
  Serial.print(",\"ssid\":");
  jsonPrint(cfg.ssid);
  Serial.printf(",\"pass\":%s,\"call\":", cfg.pass[0] ? "true" : "false");
  jsonPrint(cfg.call);
  Serial.print(",\"loc\":");
  jsonPrint(cfg.loc);
  Serial.print(",\"tz\":");
  jsonPrint(cfg.tz);
  Serial.printf(",\"tzChosen\":%s,\"langs\":[", tzNeverChosen() ? "false" : "true");
  for (int l = 0; l < LANG_COUNT; l++) {
    Serial.print(l ? ",[" : "[");
    jsonPrint(langInfo(Lang(l)).code);
    Serial.print(',');
    jsonPrint(langInfo(Lang(l)).nameNative);
    Serial.print(']');
  }
  Serial.print("],\"zones\":[");
  char label[96];
  for (size_t i = 0; i < tzZoneCount(); i++) {
    const TzZone &z = tzZone(i);
    tzLabel(z, label, sizeof label);
    Serial.print(i ? ",[" : "[");
    jsonPrint(z.id);
    Serial.print(',');
    jsonPrint(label);
    Serial.print(',');
    jsonPrint(z.aliases ? z.aliases : "");
    Serial.print(']');
  }
  for (int h = TZ_FIXED_MIN; h <= TZ_FIXED_MAX; h++) {
    if (!h) continue;                 // UTC is already among the regions
    char id[8];
    snprintf(id, sizeof id, "UTC%+d", h);
    Serial.printf(",[\"%s\",\"%s\",\"\"]", id, id);
  }
  Serial.println("]}");
}

static void usbScanReply() {
  Serial.print("HC scan [");
  for (int i = 0; i < netCount; i++) {
    Serial.print(i ? ",{\"ssid\":" : "{\"ssid\":");
    jsonPrint(nets[i].ssid.c_str());
    Serial.printf(",\"rssi\":%d,\"open\":%s}", nets[i].rssi, nets[i].open ? "true" : "false");
  }
  Serial.println("]");
}

static void usbSave(const char *q) {
  Config d = cfg;
  Lang l;
  if (langFromCode(urlValue(q, "lang").c_str(), l)) strlcpy(d.lang, langInfo(l).code, sizeof d.lang);
  int err = checkBasic(d, urlValue(q, "ssid"), urlValue(q, "pass"), urlValue(q, "open") == "1", urlValue(q, "call"),
                       urlValue(q, "loc"), urlValue(q, "tz"));
  if (err >= 0) {
    static const struct { int err; const char *field; } FIELD[] = {
      {W_ERR_SSID, "ssid"}, {W_ERR_PASS_LEN, "pass"}, {W_ERR_PASS_NEW, "pass"},
      {W_ERR_CALL, "call"}, {W_ERR_LOC, "loc"},       {W_ERR_TZ, "tz"},
    };
    const char *field = "";
    for (auto &f : FIELD)
      if (f.err == err) field = f.field;
    Serial.printf("HC error {\"field\":\"%s\",\"msg\":", field);
    jsonPrint(tr(StrId(err), LANG_EN));
    Serial.println("}");
    return;
  }
  saveConfig(d);
  Serial.println("HC ok");
  Serial.printf("USB setup: saved (%s, %s, %s, %s, %s), restarting\r\n", d.ssid, d.call, d.loc, d.lang, d.tz);
  restartSoon(500);
}

static void usbCommand(char *cmd) {
  trim(cmd);
  if (!strcmp(cmd, "info")) {
    usbInfo();
  } else if (!strcmp(cmd, "scan")) {
    startScan();
    usbScanWanted = true;
  } else if (!strncmp(cmd, "save ", 5)) {
    usbSave(cmd + 5);
  } else {
    Serial.println("HC error {\"field\":\"\",\"msg\":\"unknown command\"}");
  }
}

static void usbService() {
  if (!usbScanWanted) return;
  if (!portalMode) scanService();   // in setup mode portalService() does it
  if (scanRunning) return;
  usbScanWanted = false;
  usbScanReply();
}

// "saver" turns the set screen saver on right away, "saver off|life|dim" a given one; the settings
// don't change and the next activity (button, or a spot when it may wake the display) ends it.
static void saverCommand(char *arg) {
  trim(arg);
  int mode = -1;
  if (*arg) {
    for (int m = 0; m < SV_MODE_COUNT; m++)
      if (!strcasecmp(arg, SAVER_CODE[m])) mode = m;
    if (mode < 0) {
      Serial.println("Use: saver, saver off, saver life or saver dim");
      return;
    }
  }
  if (portalMode) {
    Serial.println("Screen saver: not in setup mode");
    return;
  }
  saverForceMode = mode;
  saverForced = true;
  saverForcedAt = millis();
  static const char *const NAME[SV_MODE_COUNT] = {"display off", "Game of Life", "dim and shift"};
  Serial.printf("Screen saver now (%s), until the button or a spot wakes the display\r\n",
                NAME[mode >= 0 ? mode : cfg.saverMode]);
}

// "screen clock|propagation|list|map|status": shows that screen on the display (the button does it too, but
// not when nobody is near the board). Settings don't change; loop() does the switch.
static void screenCommand(const char *arg) {
  while (*arg == ' ') arg++;
  static const char *const NAME[] = {"clock", "propagation", "list", "map", "status"};
  for (int i = 0; i < 5; i++)
    if (!strcasecmp(arg, NAME[i])) {
      screenCmd = i < 4 ? i : SCREEN_STATUS;
      Serial.printf("Screen: %s\r\n", NAME[i]);
      return;
    }
  Serial.println("Usage: screen clock|propagation|list|map|status");
}

static bool factoryAsked;           // "factory" was typed, the next line confirms it

// Commands are in English; the original Czech ones (stav, snimek) still work.
static void serialService() {
  if (!readLine(wiz == WZ_PASS)) return;
  if (lineFromPage) {
    usbCommand(line);
    return;
  }
  if (wiz != WZ_OFF) {
    wizInput(line);
    return;
  }
  trim(line);
  if (factoryAsked) {
    factoryAsked = false;
    if (!strcasecmp(line, "yes")) factoryReset();
    Serial.println("Factory reset cancelled, nothing was erased.");
    return;
  }
  if (!strcasecmp(line, "setup"))                                    wizStart();
  else if (!strcasecmp(line, "status") || !strcasecmp(line, "stav")) printStatus();
  else if (!strcasecmp(line, "snapshot") || !strcasecmp(line, "snimek")) printScreenshot();
  else if (!strcasecmp(line, "blink"))                               blinkTestAt = (millis() + 1000) | 1;
  else if (!strncasecmp(line, "screen", 6) && (!line[6] || line[6] == ' ')) screenCommand(line + 6);
  else if (!strncasecmp(line, "saver", 5) && (!line[5] || line[5] == ' ')) saverCommand(line + 5);
  else if (!strcasecmp(line, "off"))                                 powerOff(false, true);
  else if (!strcasecmp(line, "factory")) {
    factoryAsked = true;
    Serial.println("Factory reset erases all settings, Wi-Fi included, and restarts in setup mode.");
    Serial.println("Type yes to erase everything, anything else cancels:");
  }
  else if (line[0]) Serial.println("Commands: setup = settings, status = what is going on, snapshot = screen dump, "
                                   "blink = test the propagation screen blink, screen <name> = show a screen, "
                                   "saver [off|life|dim] = screen saver now, "
                                   "off = power off (RST starts again), factory = erase all settings");
}

// ============================ SCREENS ============================

enum Screen { S_CLOCK, S_SOLAR, S_PSK_LIST, S_PSK_MAP, SCREEN_COUNT };
// The country views (from MM_CZECHIA on) show only the territory of the country and are offered only when
// switched on in the settings. New views go at the end, the number is stored in NVS.
enum MapMode { MM_AUTO, MM_WORLD, MM_EUROPE, MM_CZECHIA, MM_GERMANY, MM_UK, MM_USA, MM_COUNT };
static const StrId MAP_MODE_NAME[MM_COUNT] = {S_MAP_AUTO,    S_MAP_WORLD, S_MAP_EUROPE, S_MAP_CZECHIA,
                                              S_MAP_GERMANY, S_MAP_UK,    S_MAP_USA};
static const MapView *const MAP_OF[MM_COUNT] = {nullptr,      &MAP_WORLD, &MAP_EUROPE, &MAP_CZECHIA,
                                                &MAP_GERMANY, &MAP_UK,    &MAP_USA};

static bool mapEnabled(int m) {
  switch (m) {
    case MM_CZECHIA: return cfg.mapCz;
    case MM_GERMANY: return cfg.mapDe;
    case MM_UK:      return cfg.mapUk;
    case MM_USA:     return cfg.mapUs;
    default:         return true;
  }
}

static int screen = S_CLOCK;
static bool showStatus, sortByDist;
static uint32_t buttonHeldMs;        // how long the button has been held right now (0 = released)
static uint32_t lastActivity;        // last button press or new spot (saver)
static bool wakeSwallow;             // the press that woke the display does nothing else
static bool nightAwake;              // dark night: a button press has woken the display until the saver time runs out
static uint8_t mapMode;
static uint32_t screenSince;
static char flashText[24];
static uint32_t flashUntil;

static Spot snap[MAX_SPOTS];         // copy of the spots for drawing
static int snapCount;

static void takeSnapshot() {
  uint32_t nowUnix = timeValid() ? time(nullptr) : 0, nowMs = millis();
  lock();
  snapCount = 0;
  for (int i = 0; i < spotCount; i++)
    if (spotAge(spots[i], nowUnix, nowMs) < SPOT_WINDOW_MIN * 60u) snap[snapCount++] = spots[i];
  unlock();
}

static int byTime(const void *a, const void *b) {
  uint32_t ta = ((const Spot *)a)->t, tb = ((const Spot *)b)->t;
  return ta < tb ? 1 : ta > tb ? -1 : 0;
}

static int byDistance(const void *a, const void *b) {
  return (int)((const Spot *)b)->km - (int)((const Spot *)a)->km;
}

// Oldest arrival first, so the map draws the newest (blinking) spots last, on top of the rest.
static int byArrival(const void *a, const void *b) {
  int32_t d = (int32_t)(((const Spot *)a)->rxMs - ((const Spot *)b)->rxMs);
  return d < 0 ? -1 : d > 0 ? 1 : 0;
}

static void drawLabel(const char *s) {
  int tw = textWidth(s);
  int x0 = (128 - tw - 6) / 2, y0 = 53;
  fillRect(x0 - 1, y0 - 1, tw + 8, 12, false);  // black border so the frame does not blend into the image
  fillRect(x0, y0, tw + 6, 11);                 // frame
  fillRect(x0 + 1, y0 + 1, tw + 4, 9, false);
  drawText(s, x0 + 3, y0 + 2);
}

static void drawHeader(const char *left, const char *right) {
  fillRect(0, 0, 128, 9);
  drawText(left, 1, 1, 1, false);
  if (right && *right) drawTextRight(right, 126, 1, 1, false);
}

static void renderPortal() {
  char buf[32];
  snprintf(buf, sizeof buf, "v%s", FW_VERSION_OLED);
  drawHeader(tr(S_SETUP), buf);
  drawText(apName, 0, 12);          // "WIFI MICROHAMCLOCK-xxxx" would not fit in 21 chars
  drawText(tr(S_PORTAL_OPEN), 0, 21);
  snprintf(buf, sizeof buf, tr(S_PORTAL_IP), PORTAL_IP.toString().c_str());
  drawText(buf, 0, 31);
  drawText(tr(S_PORTAL_OR_USB), 0, 40);
  int n = WiFi.softAPgetStationNum();
  if (n) {
    snprintf(buf, sizeof buf, tr(S_PORTAL_CLIENTS), n);
    drawText(buf, 0, 49);
  }
  if (configured()) drawText(tr(S_PORTAL_BACK), 0, 57);
}

static void renderWizard() {
  drawTextCenter(tr(S_SETUP), 6, 2);
  drawTextCenter(tr(S_WIZARD_1), 30);
  drawTextCenter(tr(S_WIZARD_2), 42);
}

static void renderClock() {
  if (!timeValid()) {
    char buf[16];
    // The name: its first 5 letters in the normal size on the baseline of the rest drawn big (126 px of 128).
    static const char NAME[] = "MICROHAMCLOCK";
    char small[6];
    strlcpy(small, NAME, sizeof small);
    int nameX = (128 - textWidth(small) - 3 - textWidth(NAME + 5, 2)) / 2;
    drawText(small, nameX, 2 + 14 - 7);
    drawText(NAME + 5, nameX + textWidth(small) + 3, 2, 2);
    snprintf(buf, sizeof buf, "v%s", FW_VERSION_OLED);
    drawTextCenter(buf, 19);
    drawTextCenter(wifiUp ? tr(S_WAITING_TIME) : tr(WIFI_FAIL_TEXT[wifiFail]), 31);
    char hint[32];
    snprintf(hint, sizeof hint, tr(S_HOLD_FOR_SETUP), (unsigned)(CONFIG_HOLD_MS / 1000));
    drawTextCenter(hint, 43);
  } else {
    time_t t = time(nullptr);
    struct tm u, l;
    gmtime_r(&t, &u);
    localtime_r(&t, &l);
    char buf[24];
    drawText("UTC", 0, 0);
    formatDate(u, buf, sizeof buf);                 // per language, e.g. "FRI 09 OCT 2026"
    drawTextRight(buf, 127, 0);
    snprintf(buf, sizeof buf, "%02d:%02d", u.tm_hour, u.tm_min);
    drawText(buf, 0, 11, 3);
    snprintf(buf, sizeof buf, ":%02d", u.tm_sec);
    drawText(buf, 93, 18, 2);
    strftime(buf, sizeof buf, "%H:%M", &l);
    drawText(buf, 0, 38, 2);
    strftime(buf, sizeof buf, "%Z", &l);
    drawText(buf, 64, 45);
  }
  drawText(cfg.call, 0, 57);
  char loc[8];
  drawTextRight(wifiUp ? upperCopy(cfg.loc, loc, sizeof loc) : tr(S_NO_WIFI), 127, 57);
}

static uint32_t solarBlinkUntil;   // until when the propagation screen is inverted (new data)

static void renderSolar() {
  lock();
  Solar s = solar;
  Iono io = iono;
  unlock();
  if (!s.ok) {
    drawHeader(tr(S_PROPAGATION), "");
    drawTextCenter(wifiUp ? tr(S_WAITING_DATA) : tr(WIFI_FAIL_TEXT[wifiFail]), 28);
    return;
  }
  char buf[24];
  snprintf(buf, sizeof buf, "SFI %s", s.sfi);
  drawText(buf, 0, 0);
  snprintf(buf, sizeof buf, "SN %s", s.sn);
  drawText(buf, 54, 0);
  snprintf(buf, sizeof buf, "A %s", s.a);
  drawTextRight(buf, 127, 0);
  snprintf(buf, sizeof buf, "K %s", s.k);
  drawText(buf, 0, 8);
  // NVIS centered in the gap between "K 9" (ends at x=16) and the longest "XRAY X10.2" (starts at x=69)
  const char *nvis = nvisBand(io);
  snprintf(buf, sizeof buf, "NVIS%s", nvis ? nvis : " --");
  drawText(buf, 43 - textWidth(buf) / 2, 8);
  snprintf(buf, sizeof buf, "XRAY %s", s.xray);
  drawTextRight(buf, 127, 8);

  // Ionosonde (Pruhonice): F2 critical frequency and MUF for a 3000 km hop.
  bool fresh = ionoFresh(io);
  if (fresh) snprintf(buf, sizeof buf, "FOF2 %.1f", io.fof2);
  else       strcpy(buf, "FOF2 --");
  drawText(buf, 0, 16);
  if (fresh && io.mufd > 0) snprintf(buf, sizeof buf, "MUF %.1f", io.mufd);
  else                      strcpy(buf, "MUF --");
  drawTextRight(buf, 127, 16);

  const char *const COND[4] = {"?", tr(S_COND_GOOD), tr(S_COND_FAIR), tr(S_COND_POOR)};
  static const char *const GROUP[4] = {"80-40", "30-20", "17-15", "12-10"};
  drawText(tr(S_BAND), 0, 24);
  drawText(tr(S_DAY), 36, 24);
  drawText(tr(S_NIGHT), 84, 24);
  for (int x = 0; x < 128; x += 2) setPixel(x, 31);
  for (int i = 0; i < 4; i++) {
    int y = 33 + i * 8;
    drawText(GROUP[i], 0, y);
    for (int j = 0; j < 2; j++) {
      int x = j ? 84 : 36;
      uint8_t c = s.cond[i][j];
      if (c == 1) {                 // good conditions are boxed so they stand out at a glance
        fillRect(x - 1, y - 1, textWidth(COND[c]) + 2, 9);
        drawText(COND[c], x, y, 1, false);
      } else {
        drawText(COND[c], x, y);
      }
    }
  }
}

static void bandLabel(const char *band, char *out) {   // "20m" → "20", "70cm" → "70C"
  int n = strlen(band);
  strlcpy(out, band, 6);
  if (n >= 2 && !strcmp(band + n - 2, "cm")) out[n - 1] = 0;
  else if (n >= 1 && band[n - 1] == 'm')     out[n - 1] = 0;
  out[3] = 0;
}

static void renderPskList() {
  takeSnapshot();
  qsort(snap, snapCount, sizeof(Spot), sortByDist ? byDistance : byTime);
  const int ROWS = 6;
  int pages = (snapCount + ROWS - 1) / ROWS;
  int page = pages > 1 ? ((millis() - screenSince) / LIST_PAGE_MS) % pages : 0;   // from the first page
  char left[24], right[8] = "";
  snprintf(left, sizeof left, tr(S_HEARD_ME), snapCount);
  if (pages > 1) snprintf(right, sizeof right, "%d/%d", page + 1, pages);
  drawHeader(left, right);

  if (!snapCount) {
    char buf[24];
    drawTextCenter(tr(S_NO_SPOTS), 22);
    snprintf(buf, sizeof buf, tr(S_LAST_MIN), SPOT_WINDOW_MIN);
    drawTextCenter(buf, 32);
    if (wifiUp && feedDown()) {     // the provider sends nothing: say so, "go on the air" would not help
      drawTextCenter(tr(S_FEED_DOWN), 41);
      drawTextCenter(tr(S_FEED_DOWN_WHO), 50);
      return;
    }
    drawTextCenter(!wifiUp ? tr(WIFI_FAIL_TEXT[wifiFail]) : !mqttUp ? tr(S_MQTT_CONNECTING) : tr(S_TRANSMIT_HINT), 50);
    return;
  }
  for (int i = 0; i < ROWS; i++) {
    int k = page * ROWS + i;
    if (k >= snapCount) break;
    const Spot &s = snap[k];
    int y = 11 + i * 9;
    char buf[12];
    baseCall(s.call, buf, sizeof buf);
    bool author = !strcasecmp(buf, "OK2MTB");   // the author heard you: the call is inverted, like GOOD on the propagation screen
    strlcpy(buf, s.call, 10);
    if (author) {
      fillRect(0, y - 1, textWidth(buf) + 3, 9);
      drawText(buf, 1, y, 1, false);
    } else {
      drawText(buf, 0, y);
    }
    bandLabel(s.band, buf);
    drawTextRight(buf, 72, y);
    snprintf(buf, sizeof buf, "%+d", s.snr);
    drawTextRight(buf, 93, y);
    snprintf(buf, sizeof buf, "%u", s.km);
    drawTextRight(buf, 127, y);
  }
}

static bool mapBit(const MapView &m, int x, int y) {
  return m.bits[y][x >> 3] & (0x80 >> (x & 7));
}

static bool inView(const MapView &m, float lat, float lon) {
  return lon >= m.west && lon < m.east && lat <= m.north && lat > m.south;
}

static void mapXY(const MapView &m, float lat, float lon, int &x, int &y) {
  x = (int)floorf((lon - m.west) / (m.east - m.west) * 128);
  y = (int)floorf((m.north - lat) / (m.north - m.south) * 64);
}

// Is the point inside the country of a country view? By its mask, with one pixel to spare, so a station
// on the coast (45 km per pixel on the USA map) isn't taken for one at sea.
static bool inCountry(const MapView &m, float lat, float lon) {
  if (!inView(m, lat, lon)) return false;
  int x, y;
  mapXY(m, lat, lon, x, y);
  for (int dy = -1; dy <= 1; dy++)
    for (int dx = -1; dx <= 1; dx++) {
      int xx = x + dx, yy = y + dy;
      if (xx >= 0 && xx < 128 && yy >= 0 && yy < 64 && mapBit(m, xx, yy)) return true;
    }
  return false;
}

// Are home and all spots inside the view (country = inside the country itself)?
static bool allIn(const MapView &m, bool country) {
  auto in = [&](float lat, float lon) { return country ? inCountry(m, lat, lon) : inView(m, lat, lon); };
  if (homeOk && !in(homeLat, homeLon)) return false;
  for (int i = 0; i < snapCount; i++)
    if (!in(snap[i].lat, snap[i].lon)) return false;
  return true;
}

static void renderPskMap() {
  takeSnapshot();
  int mode = mapEnabled(mapMode) ? mapMode : MM_AUTO;
  if (mode == MM_AUTO) {   // all in a switched-on country → that country, all in Europe → Europe, else the world
    mode = MM_WORLD;
    if (snapCount) {
      for (int c = MM_CZECHIA; c < MM_COUNT && mode == MM_WORLD; c++)
        if (mapEnabled(c) && allIn(*MAP_OF[c], true)) mode = c;
      if (mode == MM_WORLD && allIn(MAP_EUROPE, false)) mode = MM_EUROPE;
    }
  }
  const MapView *m = MAP_OF[mode];
  bool wrap = m->east - m->west >= 360;

  // By day land is filled with dots, at night only the outline remains – forming the grey line.
  // The Czechia, Germany and UK maps are just the border outline; day and night make no sense on them.
  // The USA spans four time zones, so it keeps them.
  bool fill = mode == MM_USA || mode < MM_CZECHIA;
  bool sun = timeValid();
  float decl = 0, subLon = 0;
  if (sun) subsolarPoint(time(nullptr), decl, subLon);
  float sinD = sinf(decl * DEG_TO_RAD), cosD = cosf(decl * DEG_TO_RAD);
  static float cosDl[128];
  for (int x = 0; x < 128; x++) {
    float lon = m->west + (x + 0.5f) * (m->east - m->west) / 128;
    cosDl[x] = cosf((lon - subLon) * DEG_TO_RAD);
  }
  for (int y = 0; y < 64; y++) {
    float lat = (m->north - (y + 0.5f) * (m->north - m->south) / 64) * DEG_TO_RAD;
    float a = sinf(lat) * sinD, b = cosf(lat) * cosD;
    for (int x = 0; x < 128; x++) {
      if (!mapBit(*m, x, y)) continue;
      bool edge = (y > 0 && !mapBit(*m, x, y - 1)) || (y < 63 && !mapBit(*m, x, y + 1));
      if (x > 0 || wrap)   edge |= !mapBit(*m, (x + 127) & 127, y);
      if (x < 127 || wrap) edge |= !mapBit(*m, (x + 1) & 127, y);
      bool day = fill && (!sun || a + b * cosDl[x] > 0);
      if (edge || (day && !((x + y) & 1))) setPixel(x, y);
    }
  }

  uint32_t nowMs = millis();
  bool pulse = (nowMs / 500) & 1;
  int shown = 0;
  qsort(snap, snapCount, sizeof(Spot), byArrival);   // each spot clears a 7×7 square, so the later one wins
  for (int i = 0; i < snapCount; i++) {
    const Spot &s = snap[i];
    if (!inView(*m, s.lat, s.lon)) continue;
    shown++;
    int x, y;
    mapXY(*m, s.lat, s.lon, x, y);
    fillRect(x - 3, y - 3, 7, 7, false);
    if (pulse && nowMs - s.rxMs < NEW_SPOT_BLINK_S * 1000u) {   // a new spot pulses: 5×5 frame ↔ 3×3 square
      fillRect(x - 2, y - 2, 5, 5);
      fillRect(x - 1, y - 1, 3, 3, false);
    } else {
      fillRect(x - 1, y - 1, 3, 3);
    }
  }
  if (homeOk && inView(*m, homeLat, homeLon)) {   // home: hollow square with a dot
    int x, y;
    mapXY(*m, homeLat, homeLon, x, y);
    fillRect(x - 3, y - 3, 7, 7, false);
    fillRect(x - 2, y - 2, 5, 5);
    fillRect(x - 1, y - 1, 3, 3, false);
    setPixel(x, y);
  }

  char buf[8];                                    // number of spots visible on the map
  snprintf(buf, sizeof buf, "%d", shown);
  fillRect(0, 55, textWidth(buf) + 3, 9, false);
  drawText(buf, 1, 57);
}

static void renderStatus() {
  char buf[32];
  drawHeader(tr(S_STATUS), cfg.call);
  char ssid[sizeof cfg.ssid];
  snprintf(buf, sizeof buf, "WIFI %s", wifiUp ? upperCopy(cfg.ssid, ssid, sizeof ssid) : tr(S_NOT_CONNECTED));
  drawText(buf, 0, 12);
  if (wifiUp) {
    snprintf(buf, sizeof buf, "%s %d", WiFi.localIP().toString().c_str(), WiFi.RSSI());
    drawText(buf, 0, 21);
  }
  lock();
  int n = spotCount;
  bool solarOk = solar.ok, ionoOk = iono.ok;
  uint32_t solarAt = solar.fetchedAt, ionoAt = iono.measuredAt;
  char ionoCode[sizeof iono.code];
  strcpy(ionoCode, iono.code);
  unlock();
  if (feedDown()) snprintf(buf, sizeof buf, "PSKR DOWN %lu", (unsigned long)spotsTotal);   // connected, but no spots come
  else snprintf(buf, sizeof buf, "MQTT %s %lu", mqttUp ? "OK" : "--", (unsigned long)spotsTotal);
  drawText(buf, 0, 30);
  snprintf(buf, sizeof buf, tr(S_SPOTS), n);
  drawTextRight(buf, 127, 30);
  // When the solar data arrived and when the ionosonde measured (UTC). The labels are the same
  // in every language: a translated one ("SIRENI") made the line longer than 21 chars.
  auto stamp = [&](const char *name, bool ok, uint32_t at) {
    if (ok && at) {
      time_t t = at;
      struct tm u;
      gmtime_r(&t, &u);
      snprintf(buf, sizeof buf, "%s %02d:%02d", name, u.tm_hour, u.tm_min);
    } else {
      snprintf(buf, sizeof buf, "%s %s", name, ok ? "OK" : "--");
    }
  };
  stamp("SOLAR", solarOk, solarAt);
  drawText(buf, 0, 39);
  stamp("IONO", ionoOk, ionoAt);
  drawTextRight(buf, 127, 39);
  if (ionoOk) drawTextRight(ionoCode, 127, 48);   // which ionosonde (below its measurement time)
  uint32_t min = millis() / 60000;
  snprintf(buf, sizeof buf, tr(S_UPTIME), (unsigned long)(min / 60), (unsigned long)(min % 60));
  drawText(buf, 0, 48);
  drawText(timeValid() ? "NTP OK" : "NTP --", 0, 57);
  // The version bottom right (it would not fit next to the callsign in the header), the battery voltage one
  // space before it. A long version overlaps NTP OK; that is accepted, it happens only in development builds.
  if (batteryPresent(batteryMv))
    snprintf(buf, sizeof buf, "%u.%02uV v%s", batteryMv / 1000, batteryMv % 1000 / 10, FW_VERSION_OLED);
  else
    snprintf(buf, sizeof buf, "v%s", FW_VERSION_OLED);
  drawTextRight(buf, 127, 57);
}

static void render() {
  memset(fb, 0, sizeof fb);
  if (wiz != WZ_OFF)        renderWizard();
  else if (portalMode)      renderPortal();
  else if (showStatus)      renderStatus();
  else switch (screen) {
    case S_CLOCK:    renderClock(); break;
    case S_SOLAR:
      renderSolar();
      if ((int32_t)(millis() - solarBlinkUntil) < 0)
        for (uint8_t &b : fb) b = ~b;
      break;
    case S_PSK_LIST: renderPskList(); break;
    case S_PSK_MAP:  renderPskMap(); break;
  }
  if (!portalMode && buttonHeldMs >= CONFIG_HINT_MS) {   // countdown to setup mode
    char buf[24];
    snprintf(buf, sizeof buf, tr(S_SETUP_IN),(unsigned long)((CONFIG_HOLD_MS - buttonHeldMs + 999) / 1000));
    drawLabel(buf);
  } else if ((int32_t)(millis() - flashUntil) < 0) {
    drawLabel(flashText);
  }
}

static void flash(const char *s) {
  strlcpy(flashText, s, sizeof flashText);
  flashUntil = millis() + FLASH_MS;
}


// Power and brightness are sent only on change, I2C commands take time.
static void setDisplay(bool on, uint8_t contrast) {
  static int curOn = -1, curContrast = -1;
  if (on != curOn) {
    oledPower(on);
    curOn = on;
  }
  if (on && contrast != curContrast) {
    oledContrast(contrast);
    curContrast = contrast;
  }
}

// Shifts fb contents by dx, dy pixels right and down ("dim and shift" saver).
static void fbShift(int dx, int dy) {
  if (!dx && !dy) return;
  static uint8_t src[sizeof fb];
  memcpy(src, fb, sizeof fb);
  memset(fb, 0, sizeof fb);
  for (int y = dy; y < 64; y++)
    for (int x = dx; x < 128; x++)
      if (src[((y - dy) >> 3) * 128 + x - dx] & (1 << ((y - dy) & 7))) setPixel(x, y);
}

// True when a spot younger than SPOT_WINDOW_MIN is on record: the same test as the spot lists use.
static bool hasRecentSpot() {
  uint32_t nowUnix = timeValid() ? time(nullptr) : 0, nowMs = millis();
  lock();
  bool any = false;
  for (int i = 0; i < spotCount && !any; i++) any = spotAge(spots[i], nowUnix, nowMs) < SPOT_WINDOW_MIN * 60u;
  unlock();
  return any;
}

// Automatic switching goes on to the next screen after `from`. Without spots (and without the Advanced
// "all screens" option) the clock, the propagation screen and, unless switched off in Advanced, the map take part;
// the empty spot list stays reachable by hand.
static int nextRotationScreen(int from, bool allScreens, bool withMap) {
  for (int k = 1; k <= SCREEN_COUNT; k++) {
    int s = (from + k) % SCREEN_COUNT;
    if (allScreens || s == S_CLOCK || s == S_SOLAR || (withMap && s == S_PSK_MAP)) return s;
  }
  return from;
}

// ---- button: short press, double click, triple click, long press, 10 s hold ----
// The long press fires once while still held; setup follows after 10 s.

enum ButtonEvent { BTN_NONE, BTN_SHORT, BTN_DOUBLE, BTN_TRIPLE, BTN_LONG, BTN_CONFIG };

static ButtonEvent pollButton(uint32_t now) {
  static bool stable = false, lastRaw = false, configFired = false, longFired = false;
  static uint32_t rawChangedAt, pressedAt, releasedAt;
  static uint8_t clicks;

  bool raw = digitalRead(PIN_BUTTON) == LOW;
  if (raw != lastRaw) {
    lastRaw = raw;
    rawChangedAt = now;
  }
  if (raw != stable && now - rawChangedAt >= 25) {   // debounce
    stable = raw;
    if (stable) {
      pressedAt = now;
      configFired = false;
      longFired = false;
    } else {
      buttonHeldMs = 0;
      if (configFired || longFired) return BTN_NONE;
      clicks++;
      releasedAt = now;
      if (clicks >= 3) {
        clicks = 0;
        return BTN_TRIPLE;
      }
    }
  }
  buttonHeldMs = stable ? now - pressedAt : 0;
  if (stable && !configFired && buttonHeldMs >= CONFIG_HOLD_MS) {
    configFired = true;
    clicks = 0;
    return BTN_CONFIG;
  }
  if (stable && !longFired && !configFired && buttonHeldMs >= LONG_PRESS_MS) {
    longFired = true;
    clicks = 0;
    return BTN_LONG;
  }
  if (!stable && clicks && now - releasedAt >= DOUBLE_CLICK_MS) {
    ButtonEvent e = clicks == 2 ? BTN_DOUBLE : BTN_SHORT;
    clicks = 0;
    return e;
  }
  return BTN_NONE;
}

static void handleButton(uint32_t now) {
  ButtonEvent e = pollButton(now);
  if (portalMode) {                 // in setup mode: short press = back without saving
    if (e == BTN_SHORT && configured() && wiz == WZ_OFF) {
      Serial.println("Hotspot: back without changes, restarting");
      restartSoon(0);
    }
    return;
  }
  // Saver: the first press only wakes the display, no action. The hold for setup always works.
  // Only at the start of a press, not during the whole hold: at night in "dark" the display keeps sleeping and a long press
  // would set wakeSwallow again after the swallow; in the morning it would then swallow another press and the spot wake-up.
  static bool held;
  bool pressStart = buttonHeldMs && !held;
  held = buttonHeldMs != 0;
  if ((pressStart || e != BTN_NONE) && asleep) wakeSwallow = true;
  if ((pressStart || e != BTN_NONE) && nightDark()) nightAwake = true;   // the button wakes the display even in the dark night
  // Automatic switching without spots: the press that wakes the display shows the clock, which then switches
  // with the propagation screen.
  if (pressStart && asleep && cfg.rotate && !cfg.rotateAll && !hasRecentSpot()) {
    screen = S_CLOCK;
    showStatus = false;
    screenSince = now;
  }
  if (buttonHeldMs || e != BTN_NONE) lastActivity = now;
  if (e == BTN_CONFIG) {
    wakeSwallow = false;
  } else if (e != BTN_NONE && wakeSwallow) {
    wakeSwallow = false;
    return;
  }
  switch (e) {
    case BTN_CONFIG:
      enterConfigMode();
      break;
    case BTN_SHORT:
      if (showStatus) showStatus = false;
      else screen = (screen + 1) % SCREEN_COUNT;
      screenSince = now;
      break;
    case BTN_DOUBLE:
      cfg.rotate = !cfg.rotate;
      prefs.putBool("rotate", cfg.rotate);
      flash(tr(cfg.rotate ? S_ROTATE_ON : S_ROTATE_OFF));
      screenSince = now;
      break;
    case BTN_TRIPLE:
      showStatus = !showStatus;
      break;
    case BTN_LONG:
      if (showStatus) {             // long press on the status screen: power off
        powerOff(false, true);
        break;
      }
      if (screen == S_PSK_LIST) {
        sortByDist = !sortByDist;
        prefs.putBool("sortdist", sortByDist);
        flash(tr(sortByDist ? S_SORT_KM : S_SORT_TIME));
      } else if (screen == S_PSK_MAP) {
        do mapMode = (mapMode + 1) % MM_COUNT; while (!mapEnabled(mapMode));   // skip switched-off views
        prefs.putUChar("mapmode", mapMode);
        flash(tr(MAP_MODE_NAME[mapMode]));
      }
      screenSince = now;
      break;
    default:
      break;
  }
}

// ============================ SETUP / LOOP ============================

void setup() {
  Serial.begin(115200);
  releasePinHolds();
  pinMode(PIN_BUTTON, INPUT_PULLUP);
  digitalWrite(LED_BUILTIN, LOW);
  pinMode(LED_BUILTIN, OUTPUT);
  prefs.begin(NVS_NAMESPACE, false);
  loadConfig();
  batteryInit();
  batteryBootCheck();               // after a power off for a flat battery: sleeps on unless charged
  oledInit();

  setLanguage(cfgLang(cfg));
  sortByDist = prefs.getBool("sortdist", false);
  mapMode = prefs.getUChar("mapmode", MM_AUTO) % MM_COUNT;
  homeOk = locatorToLatLon(cfg.loc, homeLat, homeLon);

  // Setup mode: the board is not configured, or someone requested it by holding the button.
  // The flag is cleared right away, so a power cycle brings back normal operation.
  portalMode = !configured() || prefs.getBool("portal", false);
  if (prefs.isKey("portal")) prefs.remove("portal");

  dataLock = xSemaphoreCreateMutex();
  delay(500);                       // give the USB bridge time to open the port
  Serial.println();
  Serial.printf("microHAMCLOCK %s for Heltec V3. Commands: setup, status, snapshot\r\n", FW_VERSION);
  strlcpy(tzRule, tzPosix(cfg.tz), sizeof tzRule);   // loadConfig guaranteed a valid zone
  setenv("TZ", tzRule, 1);
  tzset();
  if (portalMode) portalStart();
  else xTaskCreatePinnedToCore(netTask, "net", 16384, nullptr, 1, &netTaskHandle, 0);
  screenSince = lastActivity = millis();
}

// Saver: after inactivity (or at night with "dark") the display turns off, runs
// Game of Life, or dims and shifts. A new spot is activity if the
// settings and night allow it; it wakes the display straight on the spot list.
static void saverService(uint32_t now) {
  static uint32_t seenSpotWake;
  static bool ledLit;
  static uint32_t ledStartedAt;
  if (ledLit && now - ledStartedAt >= SPOT_LED_MS) {
    digitalWrite(LED_BUILTIN, LOW);
    ledLit = false;
  }
  bool busy = portalMode || wiz != WZ_OFF || buttonHeldMs >= CONFIG_HINT_MS;
  if (saverForced && (busy || (int32_t)(lastActivity - saverForcedAt) > 0)) {   // woken: back to normal
    saverForced = false;
    saverForceMode = -1;
  }
  bool wokeBySpot = false;
  uint32_t sw = spotWakeAt;
  if (sw != seenSpotWake) {
    seenSpotWake = sw;
    if (cfg.wakeOnSpot && (cfg.nightMode == NM_SPOTS || !isNight())) {
      if (asleep && !busy && !buttonHeldMs && !wakeSwallow && !nightDark()) {
        screen = S_PSK_LIST;
        showStatus = false;
        screenSince = now;
        wokeBySpot = true;
      }
      lastActivity = now;
    }
  }
  bool idle = cfg.saverMin && now - lastActivity >= cfg.saverMin * 60000UL;
  // Dark night: the display stays off, but a button press wakes it until the saver time runs out again.
  if (!nightDark() || idle) nightAwake = false;
  bool was = asleep;
  asleep = !busy && (idle || (nightDark() && !nightAwake) || saverForced);
  if (asleep && !was) {
    lifeReset(esp_random());
    Serial.println("Screen saver: on");
  } else if (was && !asleep) {
    Serial.println("Screen saver: off");
    if (wokeBySpot && cfg.ledOnSpotWake) {
      digitalWrite(LED_BUILTIN, HIGH);
      ledStartedAt = now;
      ledLit = true;
    }
  }
}

static SaverMode saverModeNow() {
  if (saverForceMode >= 0) return SaverMode(saverForceMode);
  return nightDark() ? SV_OFF : SaverMode(cfg.saverMode);
}

static void showFrame(uint32_t now) {
  static bool lifeRunning, lifeOver;  // Game of Life saver: since when it runs, and whether lifeDays are over
  static uint32_t lifeSince;
  SaverMode mode = saverModeNow();
  bool life = asleep && mode == SV_LIFE;
  if (!life) lifeOver = false;
  else if (!lifeRunning) lifeSince = now;
  else if (cfg.lifeOff && !lifeOver && now - lifeSince >= cfg.lifeDays * 86400000UL) {
    lifeOver = true;
    Serial.printf("Screen saver: Game of Life ran %u days, display off\r\n", cfg.lifeDays);
  }
  lifeRunning = life;
  if (asleep && (mode == SV_OFF || lifeOver)) {
    setDisplay(false, 0);
    return;
  }
  if (life) {
    lifeStep();
    lifeRender(fb);
    setDisplay(true, cfg.bright[BR_LIFE]);
  } else {
    render();
    if (asleep) {                   // dim and shift: shift by 0–2 px, changes every minute
      static const int8_t SHIFT[4][2] = {{0, 0}, {2, 0}, {2, 2}, {0, 2}};
      const int8_t *d = SHIFT[(now / (DIM_SHIFT_S * 1000UL)) % 4];
      fbShift(d[0], d[1]);
    }
    uint8_t c = cfg.bright[asleep ? BR_DIM : isNight() ? BR_NIGHT : BR_DAY];
    if (previewUntil && (int32_t)(now - previewUntil) < 0) c = previewContrast;
    setDisplay(true, c);
  }
  oledFlush();
}

void loop() {
  static uint32_t nextFrame;
  uint32_t now = millis();

  serialService();
  usbService();
  handleButton(now);
  if (portalMode) portalService();
  if (restartPending && (int32_t)(now - restartAt) >= 0) {
    if (factoryPending) factoryReset();
    ESP.restart();
  }
  saverService(now);
  batteryService(now);

  if (blinkTestAt && !portalMode && wiz == WZ_OFF) {   // test: show the propagation screen and a moment later "new data"
    screen = S_SOLAR;
    showStatus = false;
    screenSince = lastActivity = now;
    if ((int32_t)(now - blinkTestAt) >= 0) {
      blinkTestAt = 0;
      propagationSeq++;
    }
  }

  if (screenCmd >= 0 && !portalMode && wiz == WZ_OFF) {   // console: show the screen asked for
    showStatus = screenCmd == SCREEN_STATUS;
    if (!showStatus) screen = screenCmd;
    screenCmd = -1;
    screenSince = lastActivity = now;
  }

  // New propagation data: the propagation screen briefly inverts, but only when it is showing.
  static uint32_t seenPropagation;
  uint32_t seq = propagationSeq;
  if (seq != seenPropagation) {
    seenPropagation = seq;
    if (screen == S_SOLAR && !showStatus && !asleep && !portalMode && wiz == WZ_OFF) {
      solarBlinkUntil = now + DATA_BLINK_MS;
      nextFrame = now;              // redraw now, not after FRAME_MS
    }
  }

  uint32_t stayMs = cfg.rotateSec * 1000UL;
  if (cfg.rotate && screen == S_PSK_MAP && stayMs > MAP_EMPTY_S * 1000UL && !hasRecentSpot()) stayMs = MAP_EMPTY_S * 1000UL;   // an empty map shows just the terminator
  if (cfg.rotate && !portalMode && !showStatus && wiz == WZ_OFF && now - screenSince >= stayMs) {
    screen = nextRotationScreen(screen, cfg.rotateAll || hasRecentSpot(), cfg.rotateMap);
    screenSince = now;
  }
  if ((int32_t)(now - nextFrame) >= 0) {
    nextFrame = now + (asleep && saverModeNow() == SV_LIFE ? LIFE_STEP_MS : FRAME_MS);
    showFrame(now);
  }
  delay(1);
}
