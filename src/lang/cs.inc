// SPDX-License-Identifier: GPL-3.0-or-later
// Copyright (c) 2026 Matěj "Wolf" Holyszewski, OK2MTB

// Czech. The rules are in en.inc: S_… texts are plain ASCII without diacritics
// (the display font has none), W_… texts for the web are UTF-8 with diacritics.
// A missing text falls back to English. Check with: python tools/check_lang.py

// ---- OLED: Wi-Fi state ----
TR(S_WIFI_CONNECTING,  "PRIPOJUJI WIFI")
TR(S_WIFI_NO_AP,       "SIT NENALEZENA")
TR(S_WIFI_BAD_PASS,    "SPATNE HESLO?")
TR(S_NO_WIFI,          "BEZ WIFI")
TR(S_WAITING_TIME,     "CEKAM NA CAS")
TR(S_WAITING_DATA,     "CEKAM NA DATA")
TR(S_HOLD_FOR_SETUP,   "DRZ %us PRO NASTAVENI")

// ---- OLED: setup ----
TR(S_SETUP,            "NASTAVENI")
TR(S_SETUP_IN,         "NASTAVENI ZA %lus")
TR(S_STARTING_HOTSPOT, "SPOUSTIM HOTSPOT")
TR(S_PORTAL_OPEN,      "WIFI BEZ HESLA")
TR(S_PORTAL_IP,        "WEB IP %s")
TR(S_PORTAL_OR_USB,    "NEBO USB: SETUP")
TR(S_PORTAL_CLIENTS,   "PRIPOJENO: %d")
TR(S_PORTAL_BACK,      "TLACITKO = ZPET")
TR(S_WIZARD_1,         "POKRACUJ V")
TR(S_WIZARD_2,         "SERIOVE KONZOLI")

// ---- OLED: clock ----
TR(S_DATE_FORMAT,      "%a %d.%m.%Y")
TR(S_DOW_SUN,          "NE")
TR(S_DOW_MON,          "PO")
TR(S_DOW_TUE,          "UT")
TR(S_DOW_WED,          "ST")
TR(S_DOW_THU,          "CT")
TR(S_DOW_FRI,          "PA")
TR(S_DOW_SAT,          "SO")
TR(S_MONTH_JAN,        "LED")
TR(S_MONTH_FEB,        "UNO")
TR(S_MONTH_MAR,        "BRE")
TR(S_MONTH_APR,        "DUB")
TR(S_MONTH_MAY,        "KVE")
TR(S_MONTH_JUN,        "CVN")
TR(S_MONTH_JUL,        "CVC")
TR(S_MONTH_AUG,        "SRP")
TR(S_MONTH_SEP,        "ZAR")
TR(S_MONTH_OCT,        "RIJ")
TR(S_MONTH_NOV,        "LIS")
TR(S_MONTH_DEC,        "PRO")

// ---- OLED: propagation ----
TR(S_PROPAGATION,      "SIRENI")
TR(S_BAND,             "PASMO")
TR(S_DAY,              "DEN")
TR(S_NIGHT,            "NOC")
TR(S_COND_GOOD,        "DOBRE")
TR(S_COND_FAIR,        "STREDNI")
TR(S_COND_POOR,        "SPATNE")

// ---- OLED: PSKReporter ----
TR(S_HEARD_ME,         "SLYSELO ME: %d")
TR(S_NO_SPOTS,         "ZADNE SPOTY")
TR(S_LAST_MIN,         "ZA %d MIN")
TR(S_MQTT_CONNECTING,  "MQTT: PRIPOJUJI")
TR(S_TRANSMIT_HINT,    "VYSILEJ :)")
TR(S_MAP_AUTO,         "MAPA: AUTO")
TR(S_MAP_WORLD,        "MAPA: SVET")
TR(S_MAP_EUROPE,       "MAPA: EVROPA")
TR(S_MAP_CZECHIA,      "MAPA: CR")
TR(S_MAP_GERMANY,      "MAPA: NEMECKO")
TR(S_MAP_UK,           "MAPA: UK")
TR(S_MAP_USA,          "MAPA: USA")
TR(S_SORT_KM,          "RAZENI: KM")
TR(S_SORT_TIME,        "RAZENI: CAS")
TR(S_ROTATE_ON,        "STRIDANI ZAP")
TR(S_ROTATE_OFF,       "STRIDANI VYP")

// ---- OLED: status screen ----
TR(S_STATUS,           "STAV")
TR(S_NOT_CONNECTED,    "NEPRIPOJENO")
TR(S_SPOTS,            "SPOTU %d")
TR(S_UPTIME,           "BEZI %luH %02luM")

// ---- OLED: vypnutí ----
TR(S_POWER_OFF,        "VYPINANI")
TR(S_BATTERY_FLAT,     "VYBITA")
TR(S_POWER_RST,        "ZAPNE TLACITKO RST")

// ---- web page (UTF-8) ----
TR(W_TITLE,            "microHAMCLOCK: nastavení")
TR(W_VERSION,          "verze")
TR(W_LANGUAGE,         "Jazyk")
TR(W_WIFI,             "Wi-Fi síť")
TR(W_NET_OPEN,         ", bez hesla")
TR(W_SCANNING,         "Hledám sítě, za chvíli obnov stránku.")
TR(W_RESCAN,           "Znovu vyhledat sítě")
TR(W_PASS,             "Heslo k Wi-Fi")
TR(W_PASS_KEEP,        "prázdné = ponechat uložené")
TR(W_OPEN_NET,         "síť je bez hesla")
TR(W_CALL,             "Volací značka")
TR(W_CALL_HINT,        "Odebírají se spoty i pro značku s /P a /M.")
TR(W_LOC,              "Lokátor")
TR(W_TZ,               "Časové pásmo")
TR(W_TZ_FIXED,         "Pevný posun (bez letního času)")
TR(W_TZ_HINT,          "Předvyplněno podle telefonu. Když tvé město v seznamu není, vyber jiné se stejným časem.")
TR(W_ROTATE,           "automaticky střídat obrazovky (přepíná i dvojklik tlačítka)")
TR(W_SAVER,            "Spořič po (minutách, 0 = nikdy)")
TR(W_SAVER_MODE,       "Spořič")
TR(W_SAVER_OFF,        "vypne displej")
TR(W_SAVER_LIFE,       "Game of Life")
TR(W_SAVER_DIM,        "ztlumí a posouvá obraz")
TR(W_SAVER_SPOT,       "nový spot probudí displej (počítá se jako aktivita)")
TR(W_SAVER_LED,        "krátce bliknout LED, když spot probudí displej")
TR(W_NIGHT,            "Noc (místní čas)")
TR(W_NIGHT_FROM,       "od")
TR(W_NIGHT_TO,         "do")
TR(W_NIGHT_HINT,       "V noci je displej ztlumený. Dvakrát stejná hodina = bez noci.")
TR(W_NIGHT_MODE,       "V noci")
TR(W_NIGHT_BUTTON,     "displej probudí jen tlačítko")
TR(W_NIGHT_SPOTS,      "displej budí i spoty")
TR(W_NIGHT_DARK,       "displej zůstane zhasnutý")
TR(W_ADVANCED,         "Pokročilé")
TR(W_ROTATE_SEC,       "Střídání obrazovek: sekund na obrazovku")
TR(W_BRIGHT,           "Jas displeje")
TR(W_BRIGHT_DAY,       "Den")
TR(W_BRIGHT_NIGHT,     "Noc")
TR(W_BRIGHT_DIM,       "Spořič: ztlumit a posouvat")
TR(W_BRIGHT_LIFE,      "Spořič: Game of Life")
TR(W_BRIGHT_HINT,      "Při posunu jezdce displej na pár sekund ukáže zvolený jas. Vysoký jas OLED rychleji opotřebovává.")
TR(W_LIFE_OFF,         "po několika dnech Game of Life vypnout displej")
TR(W_LIFE_DAYS,        "Počet dní Game of Life")
TR(W_LIFE_HINT,        "Spořičem zůstává Game of Life; tlačítko nebo spot displej probudí jako obvykle. Bez zaškrtnutí běží, dokud se displej neprobudí.")
TR(W_NVIS_MARGIN,      "NVIS: rezerva pod foF2 (%)")
TR(W_NVIS_60,          "Doporučovat pro NVIS i pásmo 60 m")
TR(W_NVIS_HINT,        "Doporučené pásmo NVIS je nejvyšší pásmo pod foF2 zmenšenou o tuto rezervu. 0 % = těsně pod foF2; klasický optimální pracovní kmitočet (FOT) leží o 15 % níž.")
TR(W_IONO,             "Ionosonda")
TR(W_IONO_AUTO,        "nejbližší")
TR(W_IONO_HINT,        "Prázdné pole = nejbližší ionosonda s čerstvým měřením do 1500 km. Nebo zadejte kód stanice GIRO (např. PQ052 = Průhonice), viz mapa na <a href='https://prop.kc2g.com/'>prop.kc2g.com</a>.")
TR(W_MAPS,             "Mapy zemí")
TR(W_MAP_CZ,           "Česko")
TR(W_MAP_DE,           "Německo")
TR(W_MAP_UK,           "Spojené království")
TR(W_MAP_US,           "USA (48 souvislých států)")
TR(W_MAPS_HINT,        "Zaškrtnutá země přibude mezi pohledy mapy přepínané dlouhým stiskem a AUTO na ni přiblíží, když je v ní tvůj domov i všechny spoty. Česko, Německo a Spojené království ukazují jen hranici, USA i den a noc.")
TR(W_BOARD,            "Verze desky Heltec")
TR(W_BOARD_AUTO,       "rozpoznat automaticky")
TR(W_BOARD_HINT,       "Verze je natištěná na desce. Záleží na ní jen měření napětí baterie, které V3.2 zapíná jinak než V3 a V3.1.")
TR(W_ERR_SAVER,        "Čas spořiče musí být 0 až 240 minut.")
TR(W_ERR_LIFE_DAYS,    "Game of Life může běžet 1 až 30 dní, než se displej vypne.")
TR(W_ERR_IONO,         "Kód ionosondy má nejvýš 7 písmen, číslic nebo podtržítek (např. PQ052).")
TR(W_ERR_TZ,           "Vyber časové pásmo.")
TR(W_SAVE,             "Uložit a restartovat")
TR(W_LEAVE,            "Odejít bez uložení")
TR(W_ERR_SSID,         "Zadej název Wi-Fi sítě.")
TR(W_ERR_PASS_LEN,     "Heslo k Wi-Fi má 8 až 63 znaků.")
TR(W_ERR_PASS_NEW,     "U nové sítě zadej heslo, nebo zaškrtni, že je bez hesla.")
TR(W_ERR_CALL,         "Značka má 3 až 11 znaků: písmena, číslice a lomítko.")
TR(W_ERR_LOC,          "Lokátor vypadá jako JO70 nebo JO70va.")
TR(W_SAVED,            "Uloženo. microHAMCLOCK se restartuje a připojí k síti <b>%s</b>. Hotspot se vypne, můžeš se odpojit.")
TR(W_NOCHANGE,         "Nic se nezměnilo, microHAMCLOCK se vrací do běžného provozu.")
