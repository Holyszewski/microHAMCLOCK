// SPDX-License-Identifier: GPL-3.0-or-later
// Copyright (c) 2026 Matěj "Wolf" Holyszewski, OK2MTB

// German. The rules are in en.inc: S_… texts are plain ASCII (the display font
// has no umlauts, so Ä Ö Ü ß are written AE OE UE SS), W_… texts for the web are
// UTF-8 with umlauts. The web page says "du", as hams usually do.
// A missing text falls back to English. Check with: python tools/check_lang.py

// ---- OLED: Wi-Fi state ----
TR(S_WIFI_CONNECTING,  "VERBINDE WLAN")
TR(S_WIFI_NO_AP,       "NETZ NICHT GEFUNDEN")
TR(S_WIFI_BAD_PASS,    "FALSCHES PASSWORT?")
TR(S_NO_WIFI,          "KEIN WLAN")
TR(S_WAITING_TIME,     "WARTE AUF ZEIT")
TR(S_WAITING_DATA,     "WARTE AUF DATEN")
TR(S_HOLD_FOR_SETUP,   "%us HALTEN = SETUP")

// ---- OLED: setup ----
TR(S_SETUP,            "EINSTELLUNGEN")
TR(S_SETUP_IN,         "SETUP IN %lus")
TR(S_STARTING_HOTSPOT, "STARTE HOTSPOT")
TR(S_PORTAL_OPEN,      "WLAN OHNE PASSWORT")
TR(S_PORTAL_IP,        "WEB IP %s")
TR(S_PORTAL_OR_USB,    "ODER USB: SETUP")
TR(S_PORTAL_CLIENTS,   "VERBUNDEN: %d")
TR(S_PORTAL_BACK,      "TASTE = ZURUECK")
TR(S_WIZARD_1,         "WEITER IN DER")
TR(S_WIZARD_2,         "SERIELLEN KONSOLE")

// ---- OLED: clock ----
TR(S_DATE_FORMAT,      "%a %d.%m.%Y")
TR(S_DOW_SUN,          "SO")
TR(S_DOW_MON,          "MO")
TR(S_DOW_TUE,          "DI")
TR(S_DOW_WED,          "MI")
TR(S_DOW_THU,          "DO")
TR(S_DOW_FRI,          "FR")
TR(S_DOW_SAT,          "SA")
TR(S_MONTH_JAN,        "JAN")
TR(S_MONTH_FEB,        "FEB")
TR(S_MONTH_MAR,        "MRZ")
TR(S_MONTH_APR,        "APR")
TR(S_MONTH_MAY,        "MAI")
TR(S_MONTH_JUN,        "JUN")
TR(S_MONTH_JUL,        "JUL")
TR(S_MONTH_AUG,        "AUG")
TR(S_MONTH_SEP,        "SEP")
TR(S_MONTH_OCT,        "OKT")
TR(S_MONTH_NOV,        "NOV")
TR(S_MONTH_DEC,        "DEZ")

// ---- OLED: propagation (a condition fits 7 characters, so SCHWACH, not SCHLECHT) ----
TR(S_PROPAGATION,      "AUSBREITUNG")
TR(S_BAND,             "BAND")
TR(S_DAY,              "TAG")
TR(S_NIGHT,            "NACHT")
TR(S_COND_GOOD,        "GUT")
TR(S_COND_FAIR,        "MITTEL")
TR(S_COND_POOR,        "SCHWACH")

// ---- OLED: PSKReporter ----
TR(S_HEARD_ME,         "HOERT MICH: %d")
TR(S_NO_SPOTS,         "KEINE SPOTS")
TR(S_LAST_MIN,         "IN DEN LETZTEN %d MIN")
TR(S_MQTT_CONNECTING,  "MQTT: VERBINDE")
TR(S_TRANSMIT_HINT,    "AB AUF SENDUNG :)")
TR(S_MAP_AUTO,         "KARTE: AUTO")
TR(S_MAP_WORLD,        "KARTE: WELT")
TR(S_MAP_EUROPE,       "KARTE: EUROPA")
TR(S_MAP_CZECHIA,      "KARTE: TSCHECHIEN")
TR(S_MAP_GERMANY,      "KARTE: DEUTSCHLAND")
TR(S_MAP_UK,           "KARTE: UK")
TR(S_MAP_USA,          "KARTE: USA")
TR(S_SORT_KM,          "SORTIERT: KM")
TR(S_SORT_TIME,        "SORTIERT: ZEIT")
TR(S_ROTATE_ON,        "WECHSEL AN")
TR(S_ROTATE_OFF,       "WECHSEL AUS")

// ---- OLED: status screen ----
TR(S_STATUS,           "STATUS")
TR(S_NOT_CONNECTED,    "NICHT VERBUNDEN")
TR(S_SPOTS,            "SPOTS %d")
TR(S_UPTIME,           "SEIT %luH %02luM")

// ---- OLED: Ausschalten ----
TR(S_POWER_OFF,        "SCHALTE AB")
TR(S_BATTERY_FLAT,     "AKKU LEER")
TR(S_POWER_RST,        "START MIT RST")
TR(S_FACTORY_RESET,    "WERKSEINSTELLUNG")

// ---- web page (UTF-8) ----
TR(W_TITLE,            "microHAMCLOCK: Einstellungen")
TR(W_VERSION,          "Version")
TR(W_LANGUAGE,         "Sprache")
TR(W_WIFI,             "WLAN")
TR(W_NET_OPEN,         ", ohne Passwort")
TR(W_SCANNING,         "Suche nach Netzen…")
TR(W_NO_NETS,          "Keine Netze gefunden.")
TR(W_RESCAN,           "Erneut nach Netzen suchen")
TR(W_PASS,             "WLAN-Passwort")
TR(W_PASS_KEEP,        "leer = gespeichertes behalten")
TR(W_OPEN_NET,         "das Netz hat kein Passwort")
TR(W_CALL,             "Rufzeichen")
TR(W_CALL_HINT,        "Spots werden auch für das Rufzeichen mit /P und /M gesammelt.")
TR(W_LOC,              "Locator")
TR(W_TZ,               "Zeitzone")
TR(W_TZ_FIXED,         "Fester Versatz (ohne Sommerzeit)")
TR(W_TZ_HINT,          "Vorausgewählt nach deinem Telefon. Steht deine Stadt nicht in der Liste, wähle eine mit derselben Uhrzeit.")
TR(W_ROTATE,           "Bildschirme automatisch wechseln (auch ein Doppelklick auf die Taste schaltet das um)")
TR(W_SAVER,            "Bildschirmschoner nach (Minuten, 0 = nie)")
TR(W_SAVER_MODE,       "Bildschirmschoner")
TR(W_SAVER_OFF,        "Display ausschalten")
TR(W_SAVER_LIFE,       "Game of Life")
TR(W_SAVER_DIM,        "Bild abdunkeln und verschieben")
TR(W_SAVER_SPOT,       "ein neuer Spot weckt das Display (zählt als Aktivität)")
TR(W_SAVER_LED,        "die LED kurz blinken lassen, wenn ein Spot das Display weckt")
TR(W_NIGHT,            "Nacht (Ortszeit)")
TR(W_NIGHT_FROM,       "von")
TR(W_NIGHT_TO,         "bis")
TR(W_NIGHT_HINT,       "Nachts ist das Display abgedunkelt. Zweimal dieselbe Stunde = keine Nacht.")
TR(W_NIGHT_MODE,       "Nachts")
TR(W_NIGHT_BUTTON,     "weckt nur die Taste das Display")
TR(W_NIGHT_SPOTS,      "wecken auch Spots das Display")
TR(W_NIGHT_DARK,       "bleibt das Display aus")
TR(W_ADVANCED,         "Erweitert")
TR(W_ROTATE_SEC,       "Automatischer Bildschirmwechsel: Sekunden pro Bildschirm")
TR(W_ROTATE_ALL,       "auch ohne Spots alle Bildschirme wechseln (sonst nur Uhr und Ausbreitung)")
TR(W_ROTATE_MAP,       "auch ohne Spots die Karte wechseln (die Welt mit Tag und Nacht)")
TR(W_BRIGHT,           "Helligkeit des Displays")
TR(W_BRIGHT_DAY,       "Tag")
TR(W_BRIGHT_NIGHT,     "Nacht")
TR(W_BRIGHT_DIM,       "Bildschirmschoner: abdunkeln und verschieben")
TR(W_BRIGHT_LIFE,      "Bildschirmschoner: Game of Life")
TR(W_BRIGHT_HINT,      "Beim Verschieben eines Reglers zeigt das Display diese Helligkeit für ein paar Sekunden. Hohe Helligkeit nutzt ein OLED schneller ab.")
TR(W_LIFE_OFF,         "das Display nach einigen Tagen Game of Life ausschalten")
TR(W_LIFE_DAYS,        "Tage Game of Life")
TR(W_LIFE_HINT,        "Game of Life bleibt der Bildschirmschoner; die Taste oder ein Spot weckt das Display wie gewohnt. Ohne Häkchen läuft es, bis das Display geweckt wird.")
TR(W_NVIS_MARGIN,      "NVIS: Abstand unter foF2 (%)")
TR(W_NVIS_60,          "Für NVIS auch das 60-m-Band empfehlen")
TR(W_NVIS_HINT,        "Das empfohlene NVIS-Band ist das höchste Band unter foF2, vermindert um diesen Abstand. 0 % = knapp unter foF2; die klassische optimale Arbeitsfrequenz (FOT) liegt 15 % tiefer.")
TR(W_IONO,             "Ionosonde")
TR(W_IONO_AUTO,        "nächste")
TR(W_IONO_HINT,        "Leer = die nächste Ionosonde mit einer frischen Messung im Umkreis von 1500 km. Oder gib einen GIRO-Stationscode ein (zum Beispiel JR055 = Juliusruh), siehe die Karte auf <a href='https://prop.kc2g.com/'>prop.kc2g.com</a>.")
TR(W_MAPS,             "Länderkarten")
TR(W_MAP_CZ,           "Tschechien")
TR(W_MAP_DE,           "Deutschland")
TR(W_MAP_UK,           "Vereinigtes Königreich")
TR(W_MAP_US,           "USA (die 48 zusammenhängenden Staaten)")
TR(W_MAPS_HINT,        "Ein angehaktes Land kommt zu den Kartenansichten hinzu, die ein langer Tastendruck umschaltet, und AUTO zoomt darauf, wenn dein Standort und alle Spots darin liegen. Tschechien, Deutschland und das Vereinigte Königreich zeigen nur die Grenze, die USA auch Tag und Nacht.")
TR(W_BOARD,            "Version der Heltec-Platine")
TR(W_BOARD_AUTO,       "automatisch erkennen")
TR(W_BOARD_HINT,       "Die Version steht auf der Platine. Sie zählt nur für die Messung der Akkuspannung, die V3.2 anders einschaltet als V3 und V3.1.")
TR(W_FACTORY,          "Auf Werkseinstellungen zurücksetzen")
TR(W_FACTORY_HINT,     "Löscht alle Einstellungen samt WLAN und startet im Einrichtungsmodus neu, wie eine neue Platine. Praktisch, bevor du die Platine weitergibst.")
TR(W_FACTORY_ASK,      "Alle Einstellungen samt WLAN löschen? Das lässt sich nicht rückgängig machen.")
TR(W_ERR_SAVER,        "Die Zeit des Bildschirmschoners muss 0 bis 240 Minuten betragen.")
TR(W_ERR_LIFE_DAYS,    "Game of Life kann 1 bis 30 Tage laufen, bevor das Display ausgeht.")
TR(W_ERR_IONO,         "Ein Ionosonden-Code hat höchstens 7 Buchstaben, Ziffern oder Unterstriche (zum Beispiel JR055).")
TR(W_ERR_TZ,           "Wähle eine Zeitzone.")
TR(W_SAVE,             "Speichern und neu starten")
TR(W_LEAVE,            "Ohne Speichern verlassen")
TR(W_ERR_SSID,         "Gib den Namen des WLANs ein.")
TR(W_ERR_PASS_LEN,     "Ein WLAN-Passwort hat 8 bis 63 Zeichen.")
TR(W_ERR_PASS_NEW,     "Gib das Passwort für das neue Netz ein oder hake an, dass es keins hat.")
TR(W_ERR_CALL,         "Ein Rufzeichen hat 3 bis 11 Zeichen: Buchstaben, Ziffern und Schrägstrich.")
TR(W_ERR_LOC,          "Ein Locator sieht aus wie JO70 oder JO70va.")
TR(W_SAVED,            "Gespeichert. microHAMCLOCK startet neu und verbindet sich mit <b>%s</b>. Der Hotspot geht aus, du kannst die Verbindung trennen.")
TR(W_NOCHANGE,         "Nichts geändert, microHAMCLOCK kehrt zum normalen Betrieb zurück.")
TR(W_FACTORY_DONE,     "Alle Einstellungen wurden gelöscht. microHAMCLOCK startet im Einrichtungsmodus neu, wie eine neue Platine.")
