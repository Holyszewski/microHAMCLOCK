// English – the master catalog. It defines every string ID (in this order)
// and serves as the fallback for strings a translation doesn't have yet.
// Only the OLED and the setup web page are translated; the serial console
// is English only.
//
// Rules for all catalogs:
//   S_…  OLED display: plain ASCII only (the font has no accents). Lowercase "s"
//        is drawn lowercase (seconds unit), every other letter as uppercase.
//   W_…  web page in the setup hotspot: UTF-8, may contain HTML.
//   Keep printf placeholders (%s, %d, …) in the same order as here.
//   OLED lines have room for 21 characters.
// Check with: python tools/check_lang.py

// ---- OLED: Wi-Fi state ----
TR(S_WIFI_CONNECTING,  "CONNECTING WIFI")
TR(S_WIFI_NO_AP,       "NETWORK NOT FOUND")
TR(S_WIFI_BAD_PASS,    "WRONG PASSWORD?")
TR(S_NO_WIFI,          "NO WIFI")
TR(S_WAITING_TIME,     "WAITING FOR TIME")
TR(S_WAITING_DATA,     "WAITING FOR DATA")
TR(S_HOLD_FOR_SETUP,   "HOLD %us FOR SETUP")

// ---- OLED: setup ----
TR(S_SETUP,            "SETUP")
TR(S_SETUP_IN,         "SETUP IN %lus")
TR(S_STARTING_HOTSPOT, "STARTING HOTSPOT")
TR(S_PORTAL_OPEN,      "WIFI, NO PASSWORD")
TR(S_PORTAL_IP,        "WEB IP %s")
TR(S_PORTAL_OR_USB,    "OR USB: SETUP")
TR(S_PORTAL_CLIENTS,   "CONNECTED: %d")
TR(S_PORTAL_BACK,      "BUTTON = BACK")
TR(S_WIZARD_1,         "CONTINUE IN THE")
TR(S_WIZARD_2,         "SERIAL CONSOLE")

// ---- OLED: clock. Date pattern: %a weekday, %d day, %m month, %b month name, %Y year ----
TR(S_DATE_FORMAT,      "%a %d %b %Y")
TR(S_DOW_SUN,          "SUN")
TR(S_DOW_MON,          "MON")
TR(S_DOW_TUE,          "TUE")
TR(S_DOW_WED,          "WED")
TR(S_DOW_THU,          "THU")
TR(S_DOW_FRI,          "FRI")
TR(S_DOW_SAT,          "SAT")
TR(S_MONTH_JAN,        "JAN")
TR(S_MONTH_FEB,        "FEB")
TR(S_MONTH_MAR,        "MAR")
TR(S_MONTH_APR,        "APR")
TR(S_MONTH_MAY,        "MAY")
TR(S_MONTH_JUN,        "JUN")
TR(S_MONTH_JUL,        "JUL")
TR(S_MONTH_AUG,        "AUG")
TR(S_MONTH_SEP,        "SEP")
TR(S_MONTH_OCT,        "OCT")
TR(S_MONTH_NOV,        "NOV")
TR(S_MONTH_DEC,        "DEC")

// ---- OLED: propagation ----
TR(S_PROPAGATION,      "PROPAGATION")
TR(S_BAND,             "BAND")
TR(S_DAY,              "DAY")
TR(S_NIGHT,            "NIGHT")
TR(S_COND_GOOD,        "GOOD")
TR(S_COND_FAIR,        "FAIR")
TR(S_COND_POOR,        "POOR")

// ---- OLED: PSKReporter ----
TR(S_HEARD_ME,         "HEARD ME: %d")
TR(S_NO_SPOTS,         "NO SPOTS")
TR(S_LAST_MIN,         "IN LAST %d MIN")
TR(S_MQTT_CONNECTING,  "MQTT: CONNECTING")
TR(S_TRANSMIT_HINT,    "GO ON THE AIR :)")
TR(S_MAP_AUTO,         "MAP: AUTO")
TR(S_MAP_WORLD,        "MAP: WORLD")
TR(S_MAP_EUROPE,       "MAP: EUROPE")
TR(S_MAP_CZECHIA,      "MAP: CZECHIA")
TR(S_SORT_KM,          "SORT: KM")
TR(S_SORT_TIME,        "SORT: TIME")
TR(S_ROTATE_ON,        "ROTATION ON")
TR(S_ROTATE_OFF,       "ROTATION OFF")

// ---- OLED: status screen ----
TR(S_STATUS,           "STATUS")
TR(S_NOT_CONNECTED,    "NOT CONNECTED")
TR(S_SPOTS,            "SPOTS %d")
TR(S_UPTIME,           "UP %luH %02luM")

// ---- web page (UTF-8) ----
TR(W_TITLE,            "microHAMCLOCK: setup")
TR(W_VERSION,          "version")
TR(W_LANGUAGE,         "Language")
TR(W_WIFI,             "Wi-Fi network")
TR(W_NET_OPEN,         ", no password")
TR(W_SCANNING,         "Searching for networks, reload the page in a moment.")
TR(W_RESCAN,           "Search for networks again")
TR(W_PASS,             "Wi-Fi password")
TR(W_PASS_KEEP,        "empty = keep the saved one")
TR(W_OPEN_NET,         "the network has no password")
TR(W_CALL,             "Callsign")
TR(W_CALL_HINT,        "Spots are also collected for the call with /P and /M.")
TR(W_LOC,              "Locator")
TR(W_TZ,               "Time zone")
TR(W_TZ_FIXED,         "Fixed offset (no daylight saving time)")
TR(W_TZ_HINT,          "Preselected from your phone. If your city isn't listed, pick one with the same time.")
TR(W_ROTATE,           "switch screens automatically (a double click on the button toggles it too)")
TR(W_SAVER,            "Screen saver after (minutes, 0 = never)")
TR(W_SAVER_MODE,       "Screen saver")
TR(W_SAVER_OFF,        "turn the display off")
TR(W_SAVER_LIFE,       "Game of Life")
TR(W_SAVER_DIM,        "dim and shift the picture")
TR(W_SAVER_SPOT,       "a new spot wakes the display (counts as activity)")
TR(W_SAVER_LED,        "briefly flash the LED when a spot wakes the display")
TR(W_NIGHT,            "Night (local time)")
TR(W_NIGHT_FROM,       "from")
TR(W_NIGHT_TO,         "to")
TR(W_NIGHT_HINT,       "The display is dimmed at night. The same hour twice = no night.")
TR(W_NIGHT_MODE,       "At night")
TR(W_NIGHT_BUTTON,     "only the button wakes the display")
TR(W_NIGHT_SPOTS,      "spots wake the display too")
TR(W_NIGHT_DARK,       "the display stays off")
TR(W_ADVANCED,         "Advanced")
TR(W_ROTATE_SEC,       "Automatic screen switching: seconds per screen")
TR(W_BRIGHT,           "Display brightness")
TR(W_BRIGHT_DAY,       "Day")
TR(W_BRIGHT_NIGHT,     "Night")
TR(W_BRIGHT_DIM,       "Screen saver: dim and shift")
TR(W_BRIGHT_LIFE,      "Screen saver: Game of Life")
TR(W_BRIGHT_HINT,      "Moving a slider shows that brightness on the display for a few seconds. High brightness wears an OLED out faster.")
TR(W_NVIS_MARGIN,      "NVIS: margin below foF2 (%)")
TR(W_NVIS_60,          "Recommend the 60 m band for NVIS too")
TR(W_NVIS_HINT,        "The recommended NVIS band is the highest band below foF2 reduced by this margin. 0 % = right below foF2; the classic optimum working frequency (FOT) is 15 % below.")
TR(W_IONO,             "Ionosonde")
TR(W_IONO_AUTO,        "nearest")
TR(W_IONO_HINT,        "Leave empty to use the nearest ionosonde with a fresh measurement within 1500 km. Or enter a GIRO station code (for example PQ052), see the map at <a href='https://prop.kc2g.com/'>prop.kc2g.com</a>.")
TR(W_ERR_SAVER,        "The screen saver time must be 0 to 240 minutes.")
TR(W_ERR_IONO,         "An ionosonde code has at most 7 letters, digits or underscores (for example PQ052).")
TR(W_ERR_TZ,           "Choose a time zone.")
TR(W_SAVE,             "Save and restart")
TR(W_LEAVE,            "Leave without saving")
TR(W_ERR_SSID,         "Enter the Wi-Fi network name.")
TR(W_ERR_PASS_LEN,     "A Wi-Fi password has 8 to 63 characters.")
TR(W_ERR_PASS_NEW,     "Enter the password for the new network, or tick that it has none.")
TR(W_ERR_CALL,         "A callsign has 3 to 11 characters: letters, digits and slash.")
TR(W_ERR_LOC,          "A locator looks like JO70 or JO70va.")
TR(W_SAVED,            "Saved. microHAMCLOCK is restarting and will connect to <b>%s</b>. The hotspot turns off, you can disconnect.")
TR(W_NOCHANGE,         "Nothing changed, microHAMCLOCK is returning to normal operation.")
